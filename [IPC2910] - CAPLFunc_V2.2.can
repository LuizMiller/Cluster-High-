/*@!Encoding:1252*/
//Changelog
//07.12.2020 - Added Test Functions "ResetCCAN", "ResetBHCAN", "CCANMissingMessage", "BHCANMissingMessage", "CCANBusOff" and "BHCANBusOff" (A.Andrade) 
//16.08.2021 - Upgraded AddInspectionImageToReport() (E.Baptistucci)
//26.11.2021 - Changed in the RunInspection and LoadInspection functions, the time value "result = TestWaitForSysVar(sysvar::Test::iCommand, 10000)" to 60000
//22.12.2021 - Added function (CheckStepResultCameraNegativeText) to test NEGATIVE CASES with text indications. works as previous function but with inverted output (E. Baptistucci/R. Lira)
//06.04.2023 - Added CAPL function "ECU_time_stamps_RAM" for DiagnoseFunctional test. (R.JordÃ£o)
//07.06.2024  - Added case 5 to function Search_Menu. (DANTAS)
includes
{
 #include "VBAIResults_V1.0.can"
}

variables
{
  
  char ExcelColumnVals[10000];
  char RelativeInspPath[200]="VBAI Scripts\\Camera\\Inspections";
  char RelativeXmlLangPath[200]="Project Specific Scripts\\XMLLang";  
  char StepName[1000];
  const delay = 500;
  const delay_time = 1000;
  const delay_time2 = 6000;
  float i;
  float daye;
  int dayr;
  int Monthr;
  int ECU_TimeStampValue[5];
  int Result_Time = 0;
  int First_Value = 0;
  int Second_Value = 0;
  message DIAGNOSTIC_REQUEST_IPC DIAGNOSTIC_REQUEST_IPC_msg;
  dword MMKey;
  dword MMSeed;
  dword Day;
  dword Year1;
  dword Year2;
  dword Month;
  dword MMdata;
  char buffer[100];  
  diagrequest * allreq;
  diagresponse * allres;
  diagRequest Magneti_Marelli_IPC_Instrument_Panel_Cluster_P598_DXXXX.Seat_belt_warning_enablement_Read rq_sbr_status;
  diagRequest Magneti_Marelli_IPC_Instrument_Panel_Cluster_P598_DXXXX.Seat_belt_warning_enablement_Write rq_sbr_write;
  char LastInspName[200];
  char InspName[200];
  char Resultchar[200];
  int Increase_Speed_20_200 = 0;
  float decrease_1_day = 1;
  float decrease_2_days = 2;
  float decrease_3_days = 3;
  float decrease_4_days = 4;
  float decrease_5_days = 5;
  float decrease_10_days = 10;
  float decrease_15_days = 15;
  float decrease_20_days = 20;
  float decrease_25_days = 25;
  float decrease_30_days = 30;
  float decrease_34_days = 34;
  float decrease_35_days = 35;
  float decrease_40_days = 40;
  float decrease_45_days = 45;
  float decrease_50_days = 50;
  float decrease_53_days = 53;
  float decrease_55_days = 55;
  float decrease_60_days = 60;
  float decrease_65_days = 65;
  float decrease_66_days = 66;
  float decrease_70_days = 70;
  float decrease_71_days = 71;
  float decrease_75_days = 75;
  float decrease_80_days = 80;
  float decrease_85_days = 85;
  float decrease_90_days = 90;
  float decrease_95_days = 95;
  float decrease_100_days = 100;
  float decrease_335_days = 335;
  float decrease_365_days = 365;
  float Increase_1km = 18000;
  float Increase_2km = 36000;
  float Increase_3km = 54000;
  float Increase_4km = 72000;
  float Increase_5km = 90000;
  float Increase_10km = 190000;
  float Increase_100km = 3600000;
  float Increase_200km = 7200000;
  float Increase_201km = 7236000;
  float Increase_499km = 1796400;
  float Increase_1500km = 54000000;  
}
export testfunction AutomationCrosstalkSide_2910()
{
  CrosstalkSide_2910();
  
}  

void CrosstalkSide_2910()
{
  //COMANDO PARA ENVIAR CÓDIGO DO BACKLIGHT
  //lembrando que a mensagem tem 8 bytes, por isso precisa ser uma mensagem extended
  DIAGNOSTIC_REQUEST_IPC_msg.id=0x18DA60F1x; //ID do comando DIAGNOSTIC_REQUEST_IPC (ver no Trace Network)
  DIAGNOSTIC_REQUEST_IPC_msg.dlc = 8;
  DIAGNOSTIC_REQUEST_IPC_msg.byte(0) = 0x10; //código para categorizar como first frame
  DIAGNOSTIC_REQUEST_IPC_msg.byte(1) = 0x08;
  DIAGNOSTIC_REQUEST_IPC_msg.byte(2) = 0x31;
  DIAGNOSTIC_REQUEST_IPC_msg.byte(3) = 0x01;
  DIAGNOSTIC_REQUEST_IPC_msg.byte(4) = 0x00;
  DIAGNOSTIC_REQUEST_IPC_msg.byte(5) = 0x84;
  DIAGNOSTIC_REQUEST_IPC_msg.byte(6) = 0x01;
  DIAGNOSTIC_REQUEST_IPC_msg.byte(7) = 0x04;
  output(DIAGNOSTIC_REQUEST_IPC_msg);
  testWaitForMessage(CCAN::IPC::DIAGNOSTIC_RESPONSE_IPC, 2000); 
  DIAGNOSTIC_REQUEST_IPC_msg.id=0x18DA60F1x; //ID do comando DIAGNOSTIC_REQUEST_IPC (ver no Trace Network)
  DIAGNOSTIC_REQUEST_IPC_msg.dlc = 1;
  DIAGNOSTIC_REQUEST_IPC_msg.byte(0) = 0x20; // código para categorizar como consecutive frame
  output( DIAGNOSTIC_REQUEST_IPC_msg ); 
  DIAGNOSTIC_REQUEST_IPC_msg.id=0x18DA60F1x; //ID do comando DIAGNOSTIC_REQUEST_IPC (ver no Trace Network)
  DIAGNOSTIC_REQUEST_IPC_msg.dlc = 8;
  DIAGNOSTIC_REQUEST_IPC_msg.byte(0) = 0x21; // código para categorizar como consecutive frame
  DIAGNOSTIC_REQUEST_IPC_msg.byte(1) = 0xFF; 
  DIAGNOSTIC_REQUEST_IPC_msg.byte(2) = 0xFF;
  DIAGNOSTIC_REQUEST_IPC_msg.byte(3) = 0x00;
  DIAGNOSTIC_REQUEST_IPC_msg.byte(4) = 0x00;
  DIAGNOSTIC_REQUEST_IPC_msg.byte(5) = 0x00;
  DIAGNOSTIC_REQUEST_IPC_msg.byte(6) = 0x00;
  DIAGNOSTIC_REQUEST_IPC_msg.byte(7) = 0x00;
  output( DIAGNOSTIC_REQUEST_IPC_msg ); 
  testWaitForTimeout(2000);
 

  //COMANDO PARA ENVIAR CÓDIGO DO CROSSTALK
  DIAGNOSTIC_REQUEST_IPC_msg.id=0x18DA60F1x; //ID do comando DIAGNOSTIC_REQUEST_IPC (ver no Trace Network)
  DIAGNOSTIC_REQUEST_IPC_msg.dlc = 8;
  DIAGNOSTIC_REQUEST_IPC_msg.byte(0) = 0x07; 
  DIAGNOSTIC_REQUEST_IPC_msg.byte(1) = 0x31;
  DIAGNOSTIC_REQUEST_IPC_msg.byte(2) = 0x01;
  DIAGNOSTIC_REQUEST_IPC_msg.byte(3) = 0x00;
  DIAGNOSTIC_REQUEST_IPC_msg.byte(4) = 0x80;
  DIAGNOSTIC_REQUEST_IPC_msg.byte(5) = 0x11;
  DIAGNOSTIC_REQUEST_IPC_msg.byte(6) = 0x00;
  DIAGNOSTIC_REQUEST_IPC_msg.byte(7) = 0x0B;
  output(DIAGNOSTIC_REQUEST_IPC_msg);
  testWaitForTimeout(200);
}
export testfunction Hold_OK()
{
  sysSetVariableInt(sysvar::RoadMap::EnterKeyStuck, 1);
  testWaitForTimeout (3000);
  sysSetVariableInt(sysvar::RoadMap::EnterKeyStuck, 0);
}

// Set language to italian and then english

export testfunction Set_language_english()
{
	testModuleTitle("LanguageSelection_Italian>English");
	write("LanguageSelection_Italian>English");
    sysSetVariableInt(sysvar::RoadMap::LanguageSelection_Req,0);
    testWaitForTimeout (500);
    sysSetVariableInt(sysvar::RoadMap::SendVehicleSetup,1);
    testWaitForTimeout (150);
    sysSetVariableInt(sysvar::RoadMap::SendVehicleSetup,0);
    testWaitForTimeout (500);
	sysSetVariableInt(sysvar::RoadMap::LanguageSelection_Req,2);
    testWaitForTimeout (500);
    sysSetVariableInt(sysvar::RoadMap::SendVehicleSetup,1);
    testWaitForTimeout (150);
    sysSetVariableInt(sysvar::RoadMap::SendVehicleSetup,0);
    testWaitForTimeout (500);
}
export testfunction Show_Screen_name()
{
    sysSetVariableInt(sysvar::RoadMap::EnterKeyStuck, 1);
    testWaitForTimeout (50);
    sysSetVariableInt(sysvar::RoadMap::EnterKeyStuck, 0);

//Set operational Modes
}
export testfunction Operational_Mode_Ignition_On ()
{
  int operationalmode = 0;
  operationalmode = sysGetVariableInt(sysvar::RoadMap::OperationalModeSts);
  testModuleTitle("Operational_Mode_Ignition_On");
  testModuleTitle("CmdIgnSts = RUN");
  write("Operational_Mode_Ignition_On");
  write("CmdIgnSts = RUN");
  switch(operationalmode)
  {
    case 2:
      testWaitForTimeout(delay_time);
      sysSetVariableInt(sysvar::RoadMap::OperationalModeSts,4);
      sysSetVariableInt(sysvar::RoadMap::CmdIgnSts,4);
    break;

    case 3:
      testWaitForTimeout(delay_time);
      sysSetVariableInt(sysvar::RoadMap::OperationalModeSts,4);
      sysSetVariableInt(sysvar::RoadMap::CmdIgnSts,4);
    break;
            
    case 4:
	  sysSetVariableInt(sysvar::RoadMap::OperationalModeSts,4);
    sysSetVariableInt(sysvar::RoadMap::CmdIgnSts,4);
    break;
    
	case 5:
	  sysSetVariableInt(sysvar::RoadMap::OperationalModeSts,4);
    sysSetVariableInt(sysvar::RoadMap::CmdIgnSts,4);
    break;
	
	case 6:
	  sysSetVariableInt(sysvar::RoadMap::OperationalModeSts,4);
    sysSetVariableInt(sysvar::RoadMap::CmdIgnSts,4);
    break;

    case 7:
	  sysSetVariableInt(sysvar::RoadMap::OperationalModeSts,4);
    sysSetVariableInt(sysvar::RoadMap::CmdIgnSts,4);
    break;

    case 8:
	  sysSetVariableInt(sysvar::RoadMap::OperationalModeSts,4);
    sysSetVariableInt(sysvar::RoadMap::CmdIgnSts,4);
    break;
    	
  }    
}

export testfunction Operational_Mode_Ignition_PreStart()
{
  int operationalmode = 0;
  operationalmode = sysGetVariableInt(sysvar::RoadMap::OperationalModeSts);
  testModuleTitle("Operational_Mode_Ignition_Start");
  testModuleTitle("CmdIgnSts = RUN");
  write("Operational_Mode_Ignition_Start");
  write("CmdIgnSts = RUN");
  switch(operationalmode)
  {
    case 2:
      testWaitForTimeout (delay);
      sysSetVariableInt(sysvar::RoadMap::OperationalModeSts,4);
      sysSetVariableInt(sysvar::RoadMap::CmdIgnSts,4);
      testWaitForTimeout (delay);
      sysSetVariableInt(sysvar::RoadMap::OperationalModeSts,5);
      sysSetVariableInt(sysvar::RoadMap::CmdIgnSts,4);
    break;

    case 3:
      testWaitForTimeout (delay);
      sysSetVariableInt(sysvar::RoadMap::OperationalModeSts,4);
      testWaitForTimeout (delay);
      sysSetVariableInt(sysvar::RoadMap::OperationalModeSts,5);
      sysSetVariableInt(sysvar::RoadMap::CmdIgnSts,4);
    break;
            
    case 4:
      testWaitForTimeout (delay);
      sysSetVariableInt(sysvar::RoadMap::OperationalModeSts,5);
      sysSetVariableInt(sysvar::RoadMap::CmdIgnSts,4);
    break;
      
    case 5:
      sysSetVariableInt(sysvar::RoadMap::OperationalModeSts,5);
      sysSetVariableInt(sysvar::RoadMap::CmdIgnSts,4);
    break;
      
    case 6:
	  testWaitForTimeout (delay);
      sysSetVariableInt(sysvar::RoadMap::OperationalModeSts,5);
      sysSetVariableInt(sysvar::RoadMap::CmdIgnSts,4);
    break;
      
    case 7:
	  testWaitForTimeout (delay);
      sysSetVariableInt(sysvar::RoadMap::OperationalModeSts,5);
      sysSetVariableInt(sysvar::RoadMap::CmdIgnSts,4);
    break;
      
    case 8:
	  testWaitForTimeout (delay);
      sysSetVariableInt(sysvar::RoadMap::OperationalModeSts,5);
      sysSetVariableInt(sysvar::RoadMap::CmdIgnSts,4);
    break;
	
  }
}

export testfunction Operational_Mode_Ignition_Start ()
{
  int operationalmode = 0;
  operationalmode = sysGetVariableInt(sysvar::RoadMap::OperationalModeSts);
  testModuleTitle("Operational_Mode_Ignition_Start");
  testModuleTitle("CmdIgnSts = RUN");
  write("Operational_Mode_Ignition_Start");
  write("CmdIgnSts = RUN");
  switch(operationalmode)
  {
    case 2:
      testWaitForTimeout (delay);
      sysSetVariableInt(sysvar::RoadMap::OperationalModeSts,4);
      sysSetVariableInt(sysvar::RoadMap::CmdIgnSts,4);
      testWaitForTimeout (delay);
      sysSetVariableInt(sysvar::RoadMap::OperationalModeSts,5);
      sysSetVariableInt(sysvar::RoadMap::CmdIgnSts,4);
      testWaitForTimeout (delay);
      sysSetVariableInt(sysvar::RoadMap::OperationalModeSts,6);
      sysSetVariableInt(sysvar::RoadMap::CmdIgnSts,4);
    break;
      
    case 3:
      testWaitForTimeout (delay);
      sysSetVariableInt(sysvar::RoadMap::OperationalModeSts,4);
      sysSetVariableInt(sysvar::RoadMap::CmdIgnSts,4);
      testWaitForTimeout (delay);
      sysSetVariableInt(sysvar::RoadMap::OperationalModeSts,5);
      sysSetVariableInt(sysvar::RoadMap::CmdIgnSts,4);
      testWaitForTimeout (delay);
      sysSetVariableInt(sysvar::RoadMap::OperationalModeSts,6);
      sysSetVariableInt(sysvar::RoadMap::CmdIgnSts,4);
    break;
      
    case 4:
      testWaitForTimeout (delay);
      sysSetVariableInt(sysvar::RoadMap::OperationalModeSts,5);
      sysSetVariableInt(sysvar::RoadMap::CmdIgnSts,4);
      testWaitForTimeout (delay);
      sysSetVariableInt(sysvar::RoadMap::OperationalModeSts,6);  
      sysSetVariableInt(sysvar::RoadMap::CmdIgnSts,4);
    break;
      
    case 5:
      testWaitForTimeout (delay);
      sysSetVariableInt(sysvar::RoadMap::OperationalModeSts,6);  
      sysSetVariableInt(sysvar::RoadMap::CmdIgnSts,4);
    break;
      
    case 7:
      testWaitForTimeout (delay);
      sysSetVariableInt(sysvar::RoadMap::OperationalModeSts,6);  
      sysSetVariableInt(sysvar::RoadMap::CmdIgnSts,4);
    break;
      
    case 8:
      testWaitForTimeout (delay);
      sysSetVariableInt(sysvar::RoadMap::OperationalModeSts,6);  
      sysSetVariableInt(sysvar::RoadMap::CmdIgnSts,4);
    break;
	
  }
}

export testfunction Operational_Mode_Ignition_Cranking ()
{
  int operationalmode = 0;
  operationalmode = sysGetVariableInt(sysvar::RoadMap::OperationalModeSts);
  testModuleTitle("Operational_Mode_Ignition_Cranking");
  testModuleTitle("CmdIgnSts = RUN");
  write("Operational_Mode_Ignition_Cranking");
  write("CmdIgnSts = RUN");
  switch(operationalmode)
  {
    case 2:
        testWaitForTimeout (delay);
        sysSetVariableInt(sysvar::RoadMap::OperationalModeSts,4);
        testWaitForTimeout (delay);
        sysSetVariableInt(sysvar::RoadMap::OperationalModeSts,5);
        testWaitForTimeout (delay);
        sysSetVariableInt(sysvar::RoadMap::OperationalModeSts,6);
        testWaitForTimeout (delay);
        sysSetVariableInt(sysvar::RoadMap::OperationalModeSts,7);
        sysSetVariableInt(sysvar::RoadMap::CmdIgnSts,4);
        testWaitForTimeout (delay);
    break;
    
    case 3:
		testWaitForTimeout (delay);
        sysSetVariableInt(sysvar::RoadMap::OperationalModeSts,4);
        testWaitForTimeout (delay);
        sysSetVariableInt(sysvar::RoadMap::OperationalModeSts,5);
        testWaitForTimeout (delay);
        sysSetVariableInt(sysvar::RoadMap::OperationalModeSts,6);
        testWaitForTimeout (delay);
        sysSetVariableInt(sysvar::RoadMap::OperationalModeSts,7);
      sysSetVariableInt(sysvar::RoadMap::CmdIgnSts,4);
        testWaitForTimeout (delay);
    break;
    
    case 4:
        testWaitForTimeout (delay);
        sysSetVariableInt(sysvar::RoadMap::OperationalModeSts,5);
        testWaitForTimeout (delay);
        sysSetVariableInt(sysvar::RoadMap::OperationalModeSts,6);
        testWaitForTimeout (delay);
        sysSetVariableInt(sysvar::RoadMap::OperationalModeSts,7);
      sysSetVariableInt(sysvar::RoadMap::CmdIgnSts,4);
        testWaitForTimeout (delay);
    break;
      
    case 5:
        testWaitForTimeout (delay);
        sysSetVariableInt(sysvar::RoadMap::OperationalModeSts,6);
        testWaitForTimeout (delay);
        sysSetVariableInt(sysvar::RoadMap::OperationalModeSts,7);
      sysSetVariableInt(sysvar::RoadMap::CmdIgnSts,4);
        testWaitForTimeout (delay);
    break;
      
    case 6:
        testWaitForTimeout (delay);
        sysSetVariableInt(sysvar::RoadMap::OperationalModeSts,7);
      sysSetVariableInt(sysvar::RoadMap::CmdIgnSts,4);
        testWaitForTimeout (delay);
    break; 

    case 7:
        testWaitForTimeout (delay);
        sysSetVariableInt(sysvar::RoadMap::OperationalModeSts,7);
      sysSetVariableInt(sysvar::RoadMap::CmdIgnSts,4);
	break;
	
	case 8:
		testWaitForTimeout (delay);
		sysSetVariableInt(sysvar::RoadMap::OperationalModeSts,7);
      sysSetVariableInt(sysvar::RoadMap::CmdIgnSts,4);
	break;
	
  }
}

export testfunction Operational_Mode_Ignition_OnEngOn ()
{
  int operationalmode = 0;
  operationalmode = sysGetVariableInt(sysvar::RoadMap::OperationalModeSts);
  testModuleTitle("Operational_Mode_Ignition_OnEngOn");
  testModuleTitle("CmdIgnSts = START");
  write("Operational_Mode_Ignition_OnEngOn");
  write("CmdIgnSts = START");
  switch(operationalmode)
  {
    case 2:
      testWaitForTimeout (delay);
      sysSetVariableInt(sysvar::RoadMap::OperationalModeSts,4);
      testWaitForTimeout (delay);
      sysSetVariableInt(sysvar::RoadMap::OperationalModeSts,5);
      testWaitForTimeout (delay);
      sysSetVariableInt(sysvar::RoadMap::OperationalModeSts,6);
      testWaitForTimeout (delay);
      sysSetVariableInt(sysvar::RoadMap::OperationalModeSts,7);
      testWaitForTimeout (delay);
      sysSetVariableInt(sysvar::RoadMap::OperationalModeSts,8);
      sysSetVariableInt(sysvar::RoadMap::CmdIgnSts,5);
    break;

    case 3:
      testWaitForTimeout (delay);
      sysSetVariableInt(sysvar::RoadMap::OperationalModeSts,4);
      testWaitForTimeout (delay);
      sysSetVariableInt(sysvar::RoadMap::OperationalModeSts,5);
      testWaitForTimeout (delay);
      sysSetVariableInt(sysvar::RoadMap::OperationalModeSts,6);
      testWaitForTimeout (delay);
      sysSetVariableInt(sysvar::RoadMap::OperationalModeSts,7);
      testWaitForTimeout (delay);
      sysSetVariableInt(sysvar::RoadMap::OperationalModeSts,8);
      sysSetVariableInt(sysvar::RoadMap::CmdIgnSts,5);
    break;
            
    case 4:
      testWaitForTimeout (delay);
      sysSetVariableInt(sysvar::RoadMap::OperationalModeSts,5);
      testWaitForTimeout (delay);
      sysSetVariableInt(sysvar::RoadMap::OperationalModeSts,6);
      testWaitForTimeout (delay);
      sysSetVariableInt(sysvar::RoadMap::OperationalModeSts,7);
      testWaitForTimeout (delay);
      sysSetVariableInt(sysvar::RoadMap::OperationalModeSts,8);
      sysSetVariableInt(sysvar::RoadMap::CmdIgnSts,5);
    break;
      
    case 5:
      testWaitForTimeout (delay);
      sysSetVariableInt(sysvar::RoadMap::OperationalModeSts,6);
      testWaitForTimeout (delay);
      sysSetVariableInt(sysvar::RoadMap::OperationalModeSts,7);
      testWaitForTimeout (delay);
      sysSetVariableInt(sysvar::RoadMap::OperationalModeSts,8);
      sysSetVariableInt(sysvar::RoadMap::CmdIgnSts,5);
    break;
      
    case 6:
      testWaitForTimeout (delay);
      sysSetVariableInt(sysvar::RoadMap::OperationalModeSts,7);
      testWaitForTimeout (delay);
      sysSetVariableInt(sysvar::RoadMap::OperationalModeSts,8);
      sysSetVariableInt(sysvar::RoadMap::CmdIgnSts,5);
    break;
      
    case 7:
      testWaitForTimeout (delay);
      sysSetVariableInt(sysvar::RoadMap::OperationalModeSts,8);
      sysSetVariableInt(sysvar::RoadMap::CmdIgnSts,5);
    break;
      
    case 8:
      testWaitForTimeout (delay);
      sysSetVariableInt(sysvar::RoadMap::OperationalModeSts,8);
      sysSetVariableInt(sysvar::RoadMap::CmdIgnSts,5);
    break;
	
  }
}

export testfunction Operational_Mode_Ignition_Pre_Acc()
{
  testModuleTitle("Operational_Mode_Ignition_Pre_Acc");
  write("Operational_Mode_Ignition_Pre_Acc");
  testWaitForTimeout(delay);
  sysSetVariableInt(sysvar::RoadMap::OperationalModeSts,9);
  
}

export testfunction Operational_Mode_Ignition_Acc()
{
  testModuleTitle("Operational_Mode_Ignition_Acc");
  testModuleTitle("CmdIgnSts = ACC");
  write("Operational_Mode_Ignition_Acc");
  write("CmdIgnSts = ACC");
  testWaitForTimeout(delay);
  sysSetVariableInt(sysvar::RoadMap::OperationalModeSts,9);
  testWaitForTimeout(delay);
  sysSetVariableInt(sysvar::RoadMap::OperationalModeSts,3);
  sysSetVariableInt(sysvar::RoadMap::CmdIgnSts,3);
}

export testfunction Operational_Mode_Ignition_PreOff ()
{
  testModuleTitle("Operational_Mode_Ignition_PreOff");
  write("Operational_Mode_Ignition_PreOff");
  testWaitForTimeout (delay);
  sysSetVariableInt(sysvar::RoadMap::OperationalModeSts,10);
}

export testfunction Operational_Mode_Ignition_Off ()
{
  testModuleTitle("Operational_Mode_Ignition_Off");
  testModuleTitle("CmdIgnSts = IGN_LK");
  write("Operational_Mode_Ignition_Off");
  write("CmdIgnSts = IGN_LK");
  testWaitForTimeout (delay);
  sysSetVariableInt(sysvar::RoadMap::OperationalModeSts,10);
  testWaitForTimeout (delay);
  sysSetVariableInt(sysvar::RoadMap::OperationalModeSts,2);
  sysSetVariableInt(sysvar::RoadMap::CmdIgnSts,1);
}

//This Function is used for switch between Menu Screens for Project 226 FIAT
export testfunction MENU_CONTROL (float Nexec, float direct)
{
  testModuleTitle("MENU_CONTROL");
  write("MENU_CONTROL");
  testcasecomment("Nexec=nÃºmero de execuÃ§Ãµes e direct= 1-UP 2-right 3-down 4-left 0 enter 5-VeryLongPressure 6-UptButtonStuck 7-DownButtonStuck");
            if (direct == 1)
            {
              for (i=1; i<=Nexec; i++)
              {
                sysSetVariableInt(sysvar::RoadMap::UPKeyStuck,1);
                testWaitForTimeout (50);
                sysSetVariableInt(sysvar::RoadMap::UPKeyStuck,0);
                testWaitForTimeout (500);
              }
            }
            
             else if (direct == 6)
            {
              for (i=1; i<=Nexec; i++)
              {
                sysSetVariableInt(sysvar::RoadMap::UPKeyStuck,1);
                testWaitForTimeout (10000);
                sysSetVariableInt(sysvar::RoadMap::UPKeyStuck,0);
                testWaitForTimeout (500);
              }
            }
            
            else if (direct == 0)
            {
              for (i=1; i<=Nexec; i++)
              {
                sysSetVariableInt(sysvar::RoadMap::EnterKeyStuck,1);
                testWaitForTimeout (50);
                sysSetVariableInt(sysvar::RoadMap::EnterKeyStuck,0);
                testWaitForTimeout (500);
              }
            }
            
            else if (direct == 5)
            {
              for (i=1; i<=Nexec; i++)
              {
                sysSetVariableInt(sysvar::RoadMap::EnterKeyStuck,1);
                testWaitForTimeout (6000);
                sysSetVariableInt(sysvar::RoadMap::EnterKeyStuck,0);
                testWaitForTimeout (500);
              }
            }
            else if (direct == 2)
            {
              for (i=1; i<=Nexec; i++)
              {
                sysSetVariableInt(sysvar::RoadMap::RightKeyStuck,1);
                testWaitForTimeout (50);
                sysSetVariableInt(sysvar::RoadMap::RightKeyStuck,0);
                testWaitForTimeout (500);
              }
            }
            
            else if (direct == 3)
            {
              for (i=1; i<=Nexec; i++)
              {
                sysSetVariableInt(sysvar::RoadMap::DownKeyStuck,1);
                testWaitForTimeout (50);
                sysSetVariableInt(sysvar::RoadMap::DownKeyStuck,0);
                testWaitForTimeout (500);
              }
            }
            
            else if (direct == 7)
            {
              for (i=1; i<=Nexec; i++)
              {
                sysSetVariableInt(sysvar::RoadMap::DownKeyStuck,1);
                testWaitForTimeout (10000);
                sysSetVariableInt(sysvar::RoadMap::DownKeyStuck,0);
                testWaitForTimeout (500);
              }
            }
            
            else if (direct == 4)
            {
              for (i=1; i<=Nexec; i++)
              {
                sysSetVariableInt(sysvar::RoadMap::LeftKeyStuck,1);
                testWaitForTimeout (50);
                sysSetVariableInt(sysvar::RoadMap::LeftKeyStuck,0);
                testWaitForTimeout (500);
              }
            }
            
            else if (direct == 8)
            {
              for (i=1; i<=Nexec; i++)
              {
                sysSetVariableInt(sysvar::RoadMap::HomeKeyStuck,1);
                testWaitForTimeout (50);
                sysSetVariableInt(sysvar::RoadMap::HomeKeyStuck,0);
                testWaitForTimeout (500);
              }
            }
  
}

export testfunction SendTime_OneMinute()
{
  testModuleTitle("OneMinute");
  //write("OneMinute");
             
              for (i=0; i<=12; i++)
              {
                sysSetVariableInt(sysvar::RoadMap::Hour1_TLM_Master,2);
                sysSetVariableInt(sysvar::RoadMap::Hour2_TLM_Master,3);
                sysSetVariableInt(sysvar::RoadMap::Minute1_TLM_Master,5);
                sysSetVariableInt(sysvar::RoadMap::Minute2_TLM_Master,9);
                testWaitForTimeout (500);
                sysSetVariableInt(sysvar::RoadMap::SEND_TIMEDATE_AUTO_MASTER,1);
                testWaitForTimeout (500);
                sysSetVariableInt(sysvar::RoadMap::SEND_TIMEDATE_AUTO_MASTER,0);
                testWaitForTimeout (4000);
               
              }
}

export testfunction SendTime_OneMin()
{
  testModuleTitle("OneMinute");
  //write("OneMinute");
  {
    int r = 12;
    
    do{
      r=r+1;
      
      sysSetVariableInt(sysvar::RoadMap::Hour1_TLM_Master,2);
      sysSetVariableInt(sysvar::RoadMap::Hour2_TLM_Master,3);
      sysSetVariableInt(sysvar::RoadMap::Minute1_TLM_Master,5);
      sysSetVariableInt(sysvar::RoadMap::Minute2_TLM_Master,9);
      testWaitForTimeout (500);
      sysSetVariableInt(sysvar::RoadMap::SEND_TIMEDATE_AUTO_MASTER,1);
      testWaitForTimeout (500);
      sysSetVariableInt(sysvar::RoadMap::SEND_TIMEDATE_AUTO_MASTER,0);
      testWaitForTimeout (4000);
      
    }while(r<13);
    
      sysSetVariableInt(sysvar::RoadMap::Hour1_TLM_Master,0);
      sysSetVariableInt(sysvar::RoadMap::Hour2_TLM_Master,0);
      sysSetVariableInt(sysvar::RoadMap::Minute1_TLM_Master,0);
      sysSetVariableInt(sysvar::RoadMap::Minute2_TLM_Master,0);
      testWaitForTimeout (500);
      sysSetVariableInt(sysvar::RoadMap::SEND_TIMEDATE_AUTO_MASTER,1);
      testWaitForTimeout (500);
      sysSetVariableInt(sysvar::RoadMap::SEND_TIMEDATE_AUTO_MASTER,0);
      testWaitForTimeout (4000);
  }
}

export testfunction KL_30_OFF ()
{
  testModuleTitle("KL_30_OFF");
  sysSetVariableInt(sysvar::VTSystem::KL30,0);
  testWaitForTimeout (500);
}

export testfunction KL_30_ON ()
{
  testModuleTitle("KL_30_ON");
  sysSetVariableInt(sysvar::VTSystem::KL30,1);
  testWaitForTimeout (500);
}

void SA226MCA()
{
  DiagSetTarget( "Magneti_Marelli_IPC_Instrument_Panel_Cluster_P226MCA_D2971");
  testWaitForTimeout(200);
	SessionMM();
  testWaitForTimeout(200);
	SessionMM();
	testWaitForTimeout(200);
	RequestSeed();
  testWaitForTimeout(200);
  diagGetLastResponse(allres);
}

export testfunction SA_598()
{
  DiagSetTarget( "Magneti_Marelli_IPC_Instrument_Panel_Cluster_P598_DXXXX");
  testWaitForTimeout(200);
	SessionMM();
  testWaitForTimeout(200);
	SessionMM();
	testWaitForTimeout(200);
	RequestSeed();
  testWaitForTimeout(200);
  diagGetLastResponse(allres);
}
export testfunction ExtendDiagnosticStart()
{
Tester_Present();
ExtendDiagnostic_Start();
}

export testfunction SA_226MCA()
{
  DiagSetTarget( "Magneti_Marelli_IPC_Instrument_Panel_Cluster_P226MCA_D2971");
  testWaitForTimeout(200);
	SessionMM();
  testWaitForTimeout(200);
	SessionMM();
	testWaitForTimeout(200);
	RequestSeed();
  testWaitForTimeout(200);
  diagGetLastResponse(allres);
}

SBR_Write_Enabled()
{
  DIAGNOSTIC_REQUEST_IPC_msg.id=0x18DA60F1x;
	DIAGNOSTIC_REQUEST_IPC_msg.dlc = 4;
	DIAGNOSTIC_REQUEST_IPC_msg.byte(0) = 0x2E; 
	DIAGNOSTIC_REQUEST_IPC_msg.byte(1) = 0x28;
	DIAGNOSTIC_REQUEST_IPC_msg.byte(2) = 0x05;
	DIAGNOSTIC_REQUEST_IPC_msg.byte(3) = 0x01;
	output(DIAGNOSTIC_REQUEST_IPC_msg);
	testWaitForTimeout(200);
}

SBR_Write_Disabled()
{
  DIAGNOSTIC_REQUEST_IPC_msg.id=0x18DA60F1x;
	DIAGNOSTIC_REQUEST_IPC_msg.dlc = 4;
	DIAGNOSTIC_REQUEST_IPC_msg.byte(0) = 0x2E; 
	DIAGNOSTIC_REQUEST_IPC_msg.byte(1) = 0x28;
	DIAGNOSTIC_REQUEST_IPC_msg.byte(2) = 0x05;
	DIAGNOSTIC_REQUEST_IPC_msg.byte(3) = 0x00;
	output(DIAGNOSTIC_REQUEST_IPC_msg);
	testWaitForTimeout(200);
}

export testfunction SBR_STATUS()
{
  DiagSetTarget( "Magneti_Marelli_IPC_Instrument_Panel_Cluster_P598_DXXXX");
  rq_sbr_status.SendRequest();
  // waits until request is completely sent
  if (TestWaitForDiagRequestSent(rq_sbr_status, 2000)== 0)
    TestStepPass("Request was sent successfully, DISABLE!");
    //write(" ");
  else
    //TestStepFail("Request could not be sent!");
    TestWaitForDiagResponse(rq_sbr_status, 2000);
    Tester_Present();
    testWaitForTimeout(200);
    //ExtendDiagnostic_Start();
    testWaitForTimeout(200);
    SBR_Write_Enabled();
    
  //diagStartTesterPresent();
    //diagsendrequest(req1);
    //diagsendrequest(req2);  
    //testWaitForDiagRequestSent(req, 2000);
  
}

export testfunction SBR_STATUS1()
{
  DiagSetTarget( "Magneti_Marelli_IPC_Instrument_Panel_Cluster_P598_DXXXX");
  rq_sbr_status.SendRequest();
  // waits until request is completely sent
  if (TestWaitForDiagRequestSent(rq_sbr_status, 2000)== 1)
    TestStepPass("Request was sent successfully!, ENABLED");
    //write(" ");
  else
    //TestStepFail("Request could not be sent!");
    TestWaitForDiagResponse(rq_sbr_status, 2000);
    Tester_Present();
    testWaitForTimeout(200);
    //ExtendDiagnostic_Start();
    testWaitForTimeout(200);
    SBR_Write_Disabled();
    
  //diagStartTesterPresent();
    //diagsendrequest(req1);
    //diagsendrequest(req2);  
    //testWaitForDiagRequestSent(req, 2000);
  
}

export testfunction ECU_time_stamps_RAM ()
{
DIAGNOSTIC_REQUEST_IPC_msg.id=0x18DA60F1x;
DIAGNOSTIC_REQUEST_IPC_msg.dlc = 4;
DIAGNOSTIC_REQUEST_IPC_msg.byte(0) = 0x03;
DIAGNOSTIC_REQUEST_IPC_msg.byte(1) = 0x22;
DIAGNOSTIC_REQUEST_IPC_msg.byte(2) = 0x10;
DIAGNOSTIC_REQUEST_IPC_msg.byte(3) = 0x08;
output(DIAGNOSTIC_REQUEST_IPC_msg);
testWaitForTimeout(200);
First_Value = sysGetVariableInt(sysvar::RoadMap::time1);
//  write ("First_Value: %i",First_Value);
  
testWaitForTimeout(60000);

DIAGNOSTIC_REQUEST_IPC_msg.id=0x18DA60F1x;
DIAGNOSTIC_REQUEST_IPC_msg.dlc = 4;
DIAGNOSTIC_REQUEST_IPC_msg.byte(0) = 0x03;
DIAGNOSTIC_REQUEST_IPC_msg.byte(1) = 0x22;
DIAGNOSTIC_REQUEST_IPC_msg.byte(2) = 0x10;
DIAGNOSTIC_REQUEST_IPC_msg.byte(3) = 0x08;

output(DIAGNOSTIC_REQUEST_IPC_msg);
testWaitForTimeout(200);
  
Second_Value = sysGetVariableInt(sysvar::RoadMap::time1);
//  write ("Second_Value:",Second_Value);
TestStep("","First value: %i", First_Value);
TestStep("","Second value: %i", Second_Value);

  if ((++First_Value) == Second_Value)
  {
    testStepPass();
  }
  else
  testStepFail();
}

on message DIAGNOSTIC_RESPONSE_IPC
{
int i;
if(this.byte(1) == 0x62 && this.byte(2) == 0x10 && this.byte(3) == 0x08)
{
for(i = 0; i < 5; i++)
{
ECU_TimeStampValue[i] = (this.byte(i+3));
Result_Time *= 256;
Result_Time += ECU_TimeStampValue[i];
}
//write("Value of Response: %i", Result_Time);
  if (Result_Time >= 0){
    SysSetVariableInt(sysvar::RoadMap::time1,Result_Time);
  }
}
}

on diagResponse *
{

	byte data[4096];
	long size;

	diagGetLastResponse(allres);
	size=this.GetPrimitiveSize();
	this.GetPrimitiveData(data, elcount(data));
	if((data [0]== 0x67)&(data [1]== 0x61))
	{
//		write("Response : %x %x %x %x %x %x", data[0],data[1],data[2],data[3],data[4],data[5]);
//		write(" ");
		MMSeed = ( ( ((dword)data[2] * (dword)256) + (dword)data[3]) * (dword)256 + (dword)data[4]) * (dword)256 + (dword)data[5];
//		write ("Seed : %x", MMSeed);
//		write(" ");
		MMKey = CalcKey(MMSeed);
//		write ("Key : %x", MMKey);
//		write(" ");
		SendKey();
	}
	
	if((data [0]== 0x62)&(data [1]== 0xF1)&(data [2]== 0x85))
	{
    write("Response -> %x %x %x %x %x %x %x %x %x %x %x %x %x %x %x %x ",data[0], data[1],data[2],data[3],data[4],data[5],data[6] ,data[7] ,data[8] ,data[9] ,data[10] ,data[11] ,data[12] ,data[13] ,data[14],data[15]);
  	write(" Date Day %x",data[15]);
    write(" Date Month %x",data[14]);
    write(" Date Year %x%x",data[12],data[13]);
    Day = data[15];
    Month = data[14];
    Year1 =  data[12];
    Year2 =  data[13];
    
    //snprintf(buffer,elcount(buffer),"%d",);
  }										 
}

void RequestSeed()
{
	DIAGNOSTIC_REQUEST_IPC_msg.id=0x18DA60F1x;
	DIAGNOSTIC_REQUEST_IPC_msg.dlc = 3;
	DIAGNOSTIC_REQUEST_IPC_msg.byte(0) = 0x02;
	DIAGNOSTIC_REQUEST_IPC_msg.byte(1) = 0x27;
	DIAGNOSTIC_REQUEST_IPC_msg.byte(2) = 0x61;
	output(DIAGNOSTIC_REQUEST_IPC_msg);
	testWaitForTimeout(200);
}

void SendKey()
{
	DIAGNOSTIC_REQUEST_IPC_msg.id=0x18DA60F1x;
	DIAGNOSTIC_REQUEST_IPC_msg.dlc = 7;
	DIAGNOSTIC_REQUEST_IPC_msg.byte(0) = 0x06;
	DIAGNOSTIC_REQUEST_IPC_msg.byte(1) = 0x27;
	DIAGNOSTIC_REQUEST_IPC_msg.byte(2) = 0x62;
	DIAGNOSTIC_REQUEST_IPC_msg.byte(3) = (MMKey>>24)&0xFF;
	DIAGNOSTIC_REQUEST_IPC_msg.byte(4) = (MMKey>>16)&0xFF;
	DIAGNOSTIC_REQUEST_IPC_msg.byte(5) = (MMKey>> 8)&0xFF;
	DIAGNOSTIC_REQUEST_IPC_msg.byte(6) = (MMKey    )&0xFF;
//	write("check : %x %x %x %x %x %x", DIAGNOSTIC_REQUEST_IPC_msg.byte(1),DIAGNOSTIC_REQUEST_IPC_msg.byte(2),DIAGNOSTIC_REQUEST_IPC_msg.byte(3),DIAGNOSTIC_REQUEST_IPC_msg.byte(4),DIAGNOSTIC_REQUEST_IPC_msg.byte(5),DIAGNOSTIC_REQUEST_IPC_msg.byte(6));
	output(DIAGNOSTIC_REQUEST_IPC_msg);
//	write(" ");
//	write("Security Access - MM");
//	write(" ");
}

dword CalcKey (dword MMSeed)
{
	dword		Seed2KeyValue;
	byte		LoopValue;
	byte		SlideValue;
	dword		XorValue;

	XorValue = 0x17890714/*598*/;
  //06016944- 521
	Seed2KeyValue = MMSeed;
	LoopValue     = 5;
	SlideValue    = 0;

	while (LoopValue > 0)
	{
		if (((dword)0x80000000 & Seed2KeyValue) != 0)
		{
			SlideValue = 1;
			Seed2KeyValue ^= 0x80000000;
		}
		else
		{
			SlideValue = 0;
		}

		Seed2KeyValue <<= 1;
		if (SlideValue != 0)
		{
			Seed2KeyValue++;
			Seed2KeyValue = Seed2KeyValue ^ XorValue;
		}
		 LoopValue--;
	}
	return (Seed2KeyValue); 
}

void SessionMM()
{
	DIAGNOSTIC_REQUEST_IPC_msg.id=0x18DA60F1x;
	DIAGNOSTIC_REQUEST_IPC_msg.dlc = 3;
	DIAGNOSTIC_REQUEST_IPC_msg.byte(0) = 0x02; 
	DIAGNOSTIC_REQUEST_IPC_msg.byte(1) = 0x10;
	DIAGNOSTIC_REQUEST_IPC_msg.byte(2) = 0x60;
	output(DIAGNOSTIC_REQUEST_IPC_msg);
//	write(" ");
//	write("Session - MM");
//	write(" ");
	testWaitForTimeout(200);
}

void HardReset()
{
	DIAGNOSTIC_REQUEST_IPC_msg.id=0x18DA60F1x;
	DIAGNOSTIC_REQUEST_IPC_msg.dlc = 3;
	DIAGNOSTIC_REQUEST_IPC_msg.byte(0) = 0x02; 
	DIAGNOSTIC_REQUEST_IPC_msg.byte(1) = 0x11;
	DIAGNOSTIC_REQUEST_IPC_msg.byte(2) = 0x01;
	output(DIAGNOSTIC_REQUEST_IPC_msg);
	testWaitForDiagResponse(2000);
}

void Tester_Present()
{
	DIAGNOSTIC_REQUEST_IPC_msg.id=0x18DA60F1x;
	DIAGNOSTIC_REQUEST_IPC_msg.dlc = 3;
	DIAGNOSTIC_REQUEST_IPC_msg.byte(0) = 0x02; 
	DIAGNOSTIC_REQUEST_IPC_msg.byte(1) = 0x3E;
	DIAGNOSTIC_REQUEST_IPC_msg.byte(2) = 0x00;
	output(DIAGNOSTIC_REQUEST_IPC_msg);
	testWaitForDiagResponse(2000);
}

void ExtendDiagnostic_Start()
{
	DIAGNOSTIC_REQUEST_IPC_msg.id=0x18DA60F1x;
	DIAGNOSTIC_REQUEST_IPC_msg.dlc = 3;
	DIAGNOSTIC_REQUEST_IPC_msg.byte(0) = 0x02; 
	DIAGNOSTIC_REQUEST_IPC_msg.byte(1) = 0x10;
	DIAGNOSTIC_REQUEST_IPC_msg.byte(2) = 0x03;
	output(DIAGNOSTIC_REQUEST_IPC_msg);
	testWaitForDiagResponse(2000);
}

void Reset_Service_Information_Reset_IOLI5569()
{
	DIAGNOSTIC_REQUEST_IPC_msg.id=0x18DA60F1x;
	DIAGNOSTIC_REQUEST_IPC_msg.dlc = 4;
	DIAGNOSTIC_REQUEST_IPC_msg.byte(0) = 0x2F; 
	DIAGNOSTIC_REQUEST_IPC_msg.byte(1) = 0x55;
	DIAGNOSTIC_REQUEST_IPC_msg.byte(2) = 0x69;
	DIAGNOSTIC_REQUEST_IPC_msg.byte(2) = 0x01;
	output(DIAGNOSTIC_REQUEST_IPC_msg);
	testWaitForDiagResponse(2000);
}

void Total_OdometerReset() 
{
  DIAGNOSTIC_REQUEST_IPC_msg.id=0x18DA60F1x;
	DIAGNOSTIC_REQUEST_IPC_msg.dlc = 6;
	DIAGNOSTIC_REQUEST_IPC_msg.byte(0) = 0x05; 
	DIAGNOSTIC_REQUEST_IPC_msg.byte(1) = 0x31;
	DIAGNOSTIC_REQUEST_IPC_msg.byte(2) = 0x01;
    DIAGNOSTIC_REQUEST_IPC_msg.byte(3) = 0x00;
    DIAGNOSTIC_REQUEST_IPC_msg.byte(4) = 0x3F;
    DIAGNOSTIC_REQUEST_IPC_msg.byte(5) = 0x01;
	output(DIAGNOSTIC_REQUEST_IPC_msg);
	testWaitForDiagResponse(2000);
}

export testfunction INIT_DONE_PRESENT () //Set INIT DONE parameter to "01" (exclusive for VF230)
  
  //It’s necessary to check the Memory ID for INIT DONE in “EOL_CONFIGURATION_IPC_2910” document
{
	DIAGNOSTIC_REQUEST_IPC_msg.id=0x18DA60F1x;
	DIAGNOSTIC_REQUEST_IPC_msg.dlc = 8;
	DIAGNOSTIC_REQUEST_IPC_msg.byte(0) = 0x10;
	DIAGNOSTIC_REQUEST_IPC_msg.byte(1) = 0x08;
	DIAGNOSTIC_REQUEST_IPC_msg.byte(2) = 0x31;
	DIAGNOSTIC_REQUEST_IPC_msg.byte(3) = 0x01;
	DIAGNOSTIC_REQUEST_IPC_msg.byte(4) = 0x00;
	DIAGNOSTIC_REQUEST_IPC_msg.byte(5) = 0x61;
	DIAGNOSTIC_REQUEST_IPC_msg.byte(6) = 0x81;
	DIAGNOSTIC_REQUEST_IPC_msg.byte(7) = 0x01; //INIT DONE Memory ID
	output( DIAGNOSTIC_REQUEST_IPC_msg );
	testWaitForTimeout(200);
 	DIAGNOSTIC_REQUEST_IPC_msg.id=0x18DA60F1x;
	DIAGNOSTIC_REQUEST_IPC_msg.dlc = 6;
	DIAGNOSTIC_REQUEST_IPC_msg.byte(0) = 0x21;
	DIAGNOSTIC_REQUEST_IPC_msg.byte(1) = 0xCE; //INIT DONE Memory ID
	DIAGNOSTIC_REQUEST_IPC_msg.byte(2) = 0x00;
	DIAGNOSTIC_REQUEST_IPC_msg.byte(3) = 0x00;
  DIAGNOSTIC_REQUEST_IPC_msg.byte(4) = 0x00;
  DIAGNOSTIC_REQUEST_IPC_msg.byte(5) = 0x01;
  output( DIAGNOSTIC_REQUEST_IPC_msg ); 
  testWaitForTimeout(200);
  
  DIAGNOSTIC_REQUEST_IPC_msg.id=0x18DA60F1x;
	DIAGNOSTIC_REQUEST_IPC_msg.dlc = 5;
	DIAGNOSTIC_REQUEST_IPC_msg.byte(0) = 0x04; 
	DIAGNOSTIC_REQUEST_IPC_msg.byte(1) = 0x31;
	DIAGNOSTIC_REQUEST_IPC_msg.byte(2) = 0x03;
  DIAGNOSTIC_REQUEST_IPC_msg.byte(3) = 0x00;
  DIAGNOSTIC_REQUEST_IPC_msg.byte(4) = 0x61;
	output(DIAGNOSTIC_REQUEST_IPC_msg);
	testWaitForTimeout(200);
}


export testfunction IOLI5569()
 {
  Tester_Present();
  testWaitForTimeout(2000);
  ExtendDiagnostic_Start();
  testWaitForTimeout(500);
  Reset_Service_Information_Reset_IOLI5569();
  testWaitForTimeout(500);
 }



export testfunction TotalOdometerReset() //Reset Total Odometer value to 0 and active the letter H presentation
{
	DIAGNOSTIC_REQUEST_IPC_msg.id=0x18DA60F1x;
	DIAGNOSTIC_REQUEST_IPC_msg.dlc = 6;
	DIAGNOSTIC_REQUEST_IPC_msg.byte(0) = 0x05; 
	DIAGNOSTIC_REQUEST_IPC_msg.byte(1) = 0x31;
	DIAGNOSTIC_REQUEST_IPC_msg.byte(2) = 0x01;
	DIAGNOSTIC_REQUEST_IPC_msg.byte(3) = 0x00;
	DIAGNOSTIC_REQUEST_IPC_msg.byte(4) = 0x3F;
	DIAGNOSTIC_REQUEST_IPC_msg.byte(5) = 0x01;
	output(DIAGNOSTIC_REQUEST_IPC_msg);
	testWaitForTimeout(200);
}

export testfunction TotalOdometer_Reset()
{
  SA_598();
  write("SA_598");
  testWaitForTimeout(1000);
  Tester_Present();
  Total_OdometerReset();
  testWaitForTimeout(1000);
  HardReset();
  testWaitForTimeout(2000);
}

export testfunction TotalOdometer_H_Present()
{
  
	 
// 3101006181 0231 00

	DIAGNOSTIC_REQUEST_IPC_msg.id=0x18DA60F1x;
	DIAGNOSTIC_REQUEST_IPC_msg.dlc = 8;
	DIAGNOSTIC_REQUEST_IPC_msg.byte(0) = 0x10;
	DIAGNOSTIC_REQUEST_IPC_msg.byte(1) = 0x08;
	DIAGNOSTIC_REQUEST_IPC_msg.byte(2) = 0x31;
	DIAGNOSTIC_REQUEST_IPC_msg.byte(3) = 0x01;
	DIAGNOSTIC_REQUEST_IPC_msg.byte(4) = 0x00;
	DIAGNOSTIC_REQUEST_IPC_msg.byte(5) = 0x61;
	DIAGNOSTIC_REQUEST_IPC_msg.byte(6) = 0x81;
	DIAGNOSTIC_REQUEST_IPC_msg.byte(7) = 0x02;//SWCODOMETERRESETDONE Memory ID
	output( DIAGNOSTIC_REQUEST_IPC_msg );
  testWaitForTimeout(100);
  
  DIAGNOSTIC_REQUEST_IPC_msg.id=0x18DA60F1x;
	DIAGNOSTIC_REQUEST_IPC_msg.dlc = 1;
	DIAGNOSTIC_REQUEST_IPC_msg.byte(0) = 0x24;
	output( DIAGNOSTIC_REQUEST_IPC_msg );
	testWaitForTimeout(100);
  
	DIAGNOSTIC_REQUEST_IPC_msg.id=0x18DA60F1x;
	DIAGNOSTIC_REQUEST_IPC_msg.dlc = 3;
	DIAGNOSTIC_REQUEST_IPC_msg.byte(0) = 0x21;
	DIAGNOSTIC_REQUEST_IPC_msg.byte(1) = 0x31;//SWCODOMETERRESETDONE Memory ID
	DIAGNOSTIC_REQUEST_IPC_msg.byte(2) = 0x00;
	output( DIAGNOSTIC_REQUEST_IPC_msg );
	testWaitForTimeout(200);
	
 }
 
void SWCTOTALODO()

 {
	 
	DIAGNOSTIC_REQUEST_IPC_msg.id=0x18DA60F1x;
	DIAGNOSTIC_REQUEST_IPC_msg.dlc = 8;
	DIAGNOSTIC_REQUEST_IPC_msg.byte(0) = 0x10;
	DIAGNOSTIC_REQUEST_IPC_msg.byte(1) = 0x0B;
	DIAGNOSTIC_REQUEST_IPC_msg.byte(2) = 0x31;
	DIAGNOSTIC_REQUEST_IPC_msg.byte(3) = 0x01;
	DIAGNOSTIC_REQUEST_IPC_msg.byte(4) = 0x00;
	DIAGNOSTIC_REQUEST_IPC_msg.byte(5) = 0x61;
	DIAGNOSTIC_REQUEST_IPC_msg.byte(6) = 0x81;
	DIAGNOSTIC_REQUEST_IPC_msg.byte(7) = 0x02;//SWCTOTALODO Memory ID
	output( DIAGNOSTIC_REQUEST_IPC_msg );
  
	testWaitForTimeout(100);
	DIAGNOSTIC_REQUEST_IPC_msg.id=0x18DA60F1x;
	DIAGNOSTIC_REQUEST_IPC_msg.dlc = 6;
	DIAGNOSTIC_REQUEST_IPC_msg.byte(0) = 0x21;
	DIAGNOSTIC_REQUEST_IPC_msg.byte(1) = 0x32;//SWCTOTALODO Memory ID
	DIAGNOSTIC_REQUEST_IPC_msg.byte(2) = 0x00;
	DIAGNOSTIC_REQUEST_IPC_msg.byte(3) = 0x00;
	DIAGNOSTIC_REQUEST_IPC_msg.byte(4) = 0x00;
	DIAGNOSTIC_REQUEST_IPC_msg.byte(5) = 0x00;
	output( DIAGNOSTIC_REQUEST_IPC_msg ); 
	testWaitForTimeout(200);
 }
		 
void SWCODO()

 {
	
	DIAGNOSTIC_REQUEST_IPC_msg.id=0x18DA60F1x;
	DIAGNOSTIC_REQUEST_IPC_msg.dlc = 8;
	DIAGNOSTIC_REQUEST_IPC_msg.byte(0) = 0x10;
	DIAGNOSTIC_REQUEST_IPC_msg.byte(1) = 0x27;
	DIAGNOSTIC_REQUEST_IPC_msg.byte(2) = 0x31;
	DIAGNOSTIC_REQUEST_IPC_msg.byte(3) = 0x01;
	DIAGNOSTIC_REQUEST_IPC_msg.byte(4) = 0x00;
	DIAGNOSTIC_REQUEST_IPC_msg.byte(5) = 0x61;
	DIAGNOSTIC_REQUEST_IPC_msg.byte(6) = 0x81;
	DIAGNOSTIC_REQUEST_IPC_msg.byte(7) = 0x02; //SWCODO Memory ID
	output( DIAGNOSTIC_REQUEST_IPC_msg );
	testWaitForTimeout(100);
	
	DIAGNOSTIC_REQUEST_IPC_msg.id=0x18DA60F1x;
	DIAGNOSTIC_REQUEST_IPC_msg.dlc = 1;
	DIAGNOSTIC_REQUEST_IPC_msg.byte(0) = 0x2A; 
	output( DIAGNOSTIC_REQUEST_IPC_msg ); 
	testWaitForTimeout(100);
		
	DIAGNOSTIC_REQUEST_IPC_msg.id=0x18DA60F1x;
	DIAGNOSTIC_REQUEST_IPC_msg.dlc = 8;
	DIAGNOSTIC_REQUEST_IPC_msg.byte(0) = 0x21;
	DIAGNOSTIC_REQUEST_IPC_msg.byte(1) = 0x33; //SWCODO Memory ID
	DIAGNOSTIC_REQUEST_IPC_msg.byte(2) = 0x1A;
	DIAGNOSTIC_REQUEST_IPC_msg.byte(3) = 0x6F;
	DIAGNOSTIC_REQUEST_IPC_msg.byte(4) = 0xE1;
	DIAGNOSTIC_REQUEST_IPC_msg.byte(5) = 0x88;
	DIAGNOSTIC_REQUEST_IPC_msg.byte(6) = 0xAE;
	DIAGNOSTIC_REQUEST_IPC_msg.byte(7) = 0xF6;
	output( DIAGNOSTIC_REQUEST_IPC_msg ); 
	testWaitForTimeout(100);
	
	DIAGNOSTIC_REQUEST_IPC_msg.id=0x18DA60F1x;
	DIAGNOSTIC_REQUEST_IPC_msg.dlc = 8;
	DIAGNOSTIC_REQUEST_IPC_msg.byte(0) = 0x22;
	DIAGNOSTIC_REQUEST_IPC_msg.byte(1) = 0x00;
	DIAGNOSTIC_REQUEST_IPC_msg.byte(2) = 0x06;
	DIAGNOSTIC_REQUEST_IPC_msg.byte(3) = 0x4A;
	DIAGNOSTIC_REQUEST_IPC_msg.byte(4) = 0x95;
	DIAGNOSTIC_REQUEST_IPC_msg.byte(5) = 0xCF;
	DIAGNOSTIC_REQUEST_IPC_msg.byte(6) = 0xAF;
	DIAGNOSTIC_REQUEST_IPC_msg.byte(7) = 0x4D;
	output( DIAGNOSTIC_REQUEST_IPC_msg ); 
	testWaitForTimeout(100);
	
	DIAGNOSTIC_REQUEST_IPC_msg.id=0x18DA60F1x;
	DIAGNOSTIC_REQUEST_IPC_msg.dlc = 8;
	DIAGNOSTIC_REQUEST_IPC_msg.byte(0) = 0x23;
	DIAGNOSTIC_REQUEST_IPC_msg.byte(1) = 0x7B;
	DIAGNOSTIC_REQUEST_IPC_msg.byte(2) = 0xAC;
	DIAGNOSTIC_REQUEST_IPC_msg.byte(3) = 0x6F;
	DIAGNOSTIC_REQUEST_IPC_msg.byte(4) = 0x00;
	DIAGNOSTIC_REQUEST_IPC_msg.byte(5) = 0x00;
	DIAGNOSTIC_REQUEST_IPC_msg.byte(6) = 0x00;
	DIAGNOSTIC_REQUEST_IPC_msg.byte(7) = 0x00;
	output( DIAGNOSTIC_REQUEST_IPC_msg ); 
	testWaitForTimeout(100);
	
	DIAGNOSTIC_REQUEST_IPC_msg.id=0x18DA60F1x;
	DIAGNOSTIC_REQUEST_IPC_msg.dlc = 8;
	DIAGNOSTIC_REQUEST_IPC_msg.byte(0) = 0x24;
	DIAGNOSTIC_REQUEST_IPC_msg.byte(1) = 0x00;
	DIAGNOSTIC_REQUEST_IPC_msg.byte(2) = 0x05;
	DIAGNOSTIC_REQUEST_IPC_msg.byte(3) = 0x00;
	DIAGNOSTIC_REQUEST_IPC_msg.byte(4) = 0x00;
	DIAGNOSTIC_REQUEST_IPC_msg.byte(5) = 0x00;
	DIAGNOSTIC_REQUEST_IPC_msg.byte(6) = 0x00;
	DIAGNOSTIC_REQUEST_IPC_msg.byte(7) = 0x00;
	output( DIAGNOSTIC_REQUEST_IPC_msg ); 
	testWaitForTimeout(100);
	
	DIAGNOSTIC_REQUEST_IPC_msg.id=0x18DA60F1x;
	DIAGNOSTIC_REQUEST_IPC_msg.dlc = 6;
	DIAGNOSTIC_REQUEST_IPC_msg.byte(0) = 0x25;
	DIAGNOSTIC_REQUEST_IPC_msg.byte(1) = 0x00;
	DIAGNOSTIC_REQUEST_IPC_msg.byte(2) = 0x00;
	DIAGNOSTIC_REQUEST_IPC_msg.byte(3) = 0x00;
	DIAGNOSTIC_REQUEST_IPC_msg.byte(4) = 0x00;
	DIAGNOSTIC_REQUEST_IPC_msg.byte(5) = 0x00;
	output( DIAGNOSTIC_REQUEST_IPC_msg ); 
	testWaitForTimeout(300);
 }
	 
void SWCBACKUPODO()

 {
	
	DIAGNOSTIC_REQUEST_IPC_msg.id=0x18DA60F1x;
	DIAGNOSTIC_REQUEST_IPC_msg.dlc = 8;
	DIAGNOSTIC_REQUEST_IPC_msg.byte(0) = 0x10;
	DIAGNOSTIC_REQUEST_IPC_msg.byte(1) = 0x27;
	DIAGNOSTIC_REQUEST_IPC_msg.byte(2) = 0x31;
	DIAGNOSTIC_REQUEST_IPC_msg.byte(3) = 0x01;
	DIAGNOSTIC_REQUEST_IPC_msg.byte(4) = 0x00;
	DIAGNOSTIC_REQUEST_IPC_msg.byte(5) = 0x61;
	DIAGNOSTIC_REQUEST_IPC_msg.byte(6) = 0x81;
	DIAGNOSTIC_REQUEST_IPC_msg.byte(7) = 0x02; //SWCBACKUPODO Memory ID
	output( DIAGNOSTIC_REQUEST_IPC_msg );
	testWaitForTimeout(100);
	
	DIAGNOSTIC_REQUEST_IPC_msg.id=0x18DA60F1x;
	DIAGNOSTIC_REQUEST_IPC_msg.dlc = 1;
	DIAGNOSTIC_REQUEST_IPC_msg.byte(0) = 0x2A; 
	output( DIAGNOSTIC_REQUEST_IPC_msg ); 
	testWaitForTimeout(100);
		
	DIAGNOSTIC_REQUEST_IPC_msg.id=0x18DA60F1x;
	DIAGNOSTIC_REQUEST_IPC_msg.dlc = 8;
	DIAGNOSTIC_REQUEST_IPC_msg.byte(0) = 0x21;
	DIAGNOSTIC_REQUEST_IPC_msg.byte(1) = 0x81; //SWCBACKUPODO Memory ID
	DIAGNOSTIC_REQUEST_IPC_msg.byte(2) = 0x1A;
	DIAGNOSTIC_REQUEST_IPC_msg.byte(3) = 0x6F;
	DIAGNOSTIC_REQUEST_IPC_msg.byte(4) = 0xE1;
	DIAGNOSTIC_REQUEST_IPC_msg.byte(5) = 0x88;
	DIAGNOSTIC_REQUEST_IPC_msg.byte(6) = 0xAE;
	DIAGNOSTIC_REQUEST_IPC_msg.byte(7) = 0xF6;
	output( DIAGNOSTIC_REQUEST_IPC_msg ); 
	testWaitForTimeout(100);
	
	DIAGNOSTIC_REQUEST_IPC_msg.id=0x18DA60F1x;
	DIAGNOSTIC_REQUEST_IPC_msg.dlc = 8;
	DIAGNOSTIC_REQUEST_IPC_msg.byte(0) = 0x22;
	DIAGNOSTIC_REQUEST_IPC_msg.byte(1) = 0x00;
	DIAGNOSTIC_REQUEST_IPC_msg.byte(2) = 0x06;
	DIAGNOSTIC_REQUEST_IPC_msg.byte(3) = 0x4A;
	DIAGNOSTIC_REQUEST_IPC_msg.byte(4) = 0x95;
	DIAGNOSTIC_REQUEST_IPC_msg.byte(5) = 0xCF;
	DIAGNOSTIC_REQUEST_IPC_msg.byte(6) = 0xAF;
	DIAGNOSTIC_REQUEST_IPC_msg.byte(7) = 0x4D;
	output( DIAGNOSTIC_REQUEST_IPC_msg ); 
	testWaitForTimeout(100);
	
	DIAGNOSTIC_REQUEST_IPC_msg.id=0x18DA60F1x;
	DIAGNOSTIC_REQUEST_IPC_msg.dlc = 8;
	DIAGNOSTIC_REQUEST_IPC_msg.byte(0) = 0x23;
	DIAGNOSTIC_REQUEST_IPC_msg.byte(1) = 0x7B;
	DIAGNOSTIC_REQUEST_IPC_msg.byte(2) = 0xAC;
	DIAGNOSTIC_REQUEST_IPC_msg.byte(3) = 0x6F;
	DIAGNOSTIC_REQUEST_IPC_msg.byte(4) = 0x1A;
	DIAGNOSTIC_REQUEST_IPC_msg.byte(5) = 0x6F;
	DIAGNOSTIC_REQUEST_IPC_msg.byte(6) = 0xE1;
	DIAGNOSTIC_REQUEST_IPC_msg.byte(7) = 0x88;
	output( DIAGNOSTIC_REQUEST_IPC_msg ); 
	testWaitForTimeout(100);
	
	DIAGNOSTIC_REQUEST_IPC_msg.id=0x18DA60F1x;
	DIAGNOSTIC_REQUEST_IPC_msg.dlc = 8;
	DIAGNOSTIC_REQUEST_IPC_msg.byte(0) = 0x24;
	DIAGNOSTIC_REQUEST_IPC_msg.byte(1) = 0xAE;
	DIAGNOSTIC_REQUEST_IPC_msg.byte(2) = 0xF6;
	DIAGNOSTIC_REQUEST_IPC_msg.byte(3) = 0x00;
	DIAGNOSTIC_REQUEST_IPC_msg.byte(4) = 0x06;
	DIAGNOSTIC_REQUEST_IPC_msg.byte(5) = 0x4A;
	DIAGNOSTIC_REQUEST_IPC_msg.byte(6) = 0x95;
	DIAGNOSTIC_REQUEST_IPC_msg.byte(7) = 0xCF;
	output( DIAGNOSTIC_REQUEST_IPC_msg ); 
	testWaitForTimeout(100);
	
	DIAGNOSTIC_REQUEST_IPC_msg.id=0x18DA60F1x;
	DIAGNOSTIC_REQUEST_IPC_msg.dlc = 6;
	DIAGNOSTIC_REQUEST_IPC_msg.byte(0) = 0x25;
	DIAGNOSTIC_REQUEST_IPC_msg.byte(1) = 0xAF;
	DIAGNOSTIC_REQUEST_IPC_msg.byte(2) = 0x4D;
	DIAGNOSTIC_REQUEST_IPC_msg.byte(3) = 0x7B;
	DIAGNOSTIC_REQUEST_IPC_msg.byte(4) = 0xAC;
	DIAGNOSTIC_REQUEST_IPC_msg.byte(5) = 0x6F;
	output( DIAGNOSTIC_REQUEST_IPC_msg ); 
	testWaitForTimeout(200);
 }
 
 void ODOMETER_MIRROR_A()

 {
	 
	DIAGNOSTIC_REQUEST_IPC_msg.id=0x18DA60F1x;
	DIAGNOSTIC_REQUEST_IPC_msg.dlc = 8;
	DIAGNOSTIC_REQUEST_IPC_msg.byte(0) = 0x10;
	DIAGNOSTIC_REQUEST_IPC_msg.byte(1) = 0x0B;
	DIAGNOSTIC_REQUEST_IPC_msg.byte(2) = 0x31;
	DIAGNOSTIC_REQUEST_IPC_msg.byte(3) = 0x01;
	DIAGNOSTIC_REQUEST_IPC_msg.byte(4) = 0x00;
	DIAGNOSTIC_REQUEST_IPC_msg.byte(5) = 0x61;
	DIAGNOSTIC_REQUEST_IPC_msg.byte(6) = 0x81;
	DIAGNOSTIC_REQUEST_IPC_msg.byte(7) = 0x02; //ODOMETER_MIRROR_A Memory ID
	output( DIAGNOSTIC_REQUEST_IPC_msg );
	testWaitForTimeout(100);
	
	DIAGNOSTIC_REQUEST_IPC_msg.id=0x18DA60F1x;
	DIAGNOSTIC_REQUEST_IPC_msg.dlc = 1;
	DIAGNOSTIC_REQUEST_IPC_msg.byte(0) = 0x2A;
	output( DIAGNOSTIC_REQUEST_IPC_msg ); 
	testWaitForTimeout(100);
	
	DIAGNOSTIC_REQUEST_IPC_msg.id=0x18DA60F1x;
	DIAGNOSTIC_REQUEST_IPC_msg.dlc = 6;
	DIAGNOSTIC_REQUEST_IPC_msg.byte(0) = 0x21;
	DIAGNOSTIC_REQUEST_IPC_msg.byte(1) = 0x97; //ODOMETER_MIRROR_A Memory ID
	DIAGNOSTIC_REQUEST_IPC_msg.byte(2) = 0xFF;
	DIAGNOSTIC_REQUEST_IPC_msg.byte(3) = 0xFF;
	DIAGNOSTIC_REQUEST_IPC_msg.byte(4) = 0xFF;
	DIAGNOSTIC_REQUEST_IPC_msg.byte(5) = 0xFF;
	output( DIAGNOSTIC_REQUEST_IPC_msg ); 
	testWaitForTimeout(200);
 }
 
 void ODOMETER_MIRROR_B()

 {
	 
	DIAGNOSTIC_REQUEST_IPC_msg.id=0x18DA60F1x;
	DIAGNOSTIC_REQUEST_IPC_msg.dlc = 8;
	DIAGNOSTIC_REQUEST_IPC_msg.byte(0) = 0x10;
	DIAGNOSTIC_REQUEST_IPC_msg.byte(1) = 0x0B;
	DIAGNOSTIC_REQUEST_IPC_msg.byte(2) = 0x31;
	DIAGNOSTIC_REQUEST_IPC_msg.byte(3) = 0x01;
	DIAGNOSTIC_REQUEST_IPC_msg.byte(4) = 0x00;
	DIAGNOSTIC_REQUEST_IPC_msg.byte(5) = 0x61;
	DIAGNOSTIC_REQUEST_IPC_msg.byte(6) = 0x81;
	DIAGNOSTIC_REQUEST_IPC_msg.byte(7) = 0x02; //ODOMETER_MIRROR_B Memory ID
	output( DIAGNOSTIC_REQUEST_IPC_msg );
	testWaitForTimeout(100);
	
	DIAGNOSTIC_REQUEST_IPC_msg.id=0x18DA60F1x;
	DIAGNOSTIC_REQUEST_IPC_msg.dlc = 1;
	DIAGNOSTIC_REQUEST_IPC_msg.byte(0) = 0x2A;
	output( DIAGNOSTIC_REQUEST_IPC_msg ); 
	testWaitForTimeout(100);
	
	DIAGNOSTIC_REQUEST_IPC_msg.id=0x18DA60F1x;
	DIAGNOSTIC_REQUEST_IPC_msg.dlc = 6;
	DIAGNOSTIC_REQUEST_IPC_msg.byte(0) = 0x21;
	DIAGNOSTIC_REQUEST_IPC_msg.byte(1) = 0x98; //ODOMETER_MIRROR_B Memory ID
	DIAGNOSTIC_REQUEST_IPC_msg.byte(2) = 0xFF;
	DIAGNOSTIC_REQUEST_IPC_msg.byte(3) = 0xFF;
	DIAGNOSTIC_REQUEST_IPC_msg.byte(4) = 0xFF;
	DIAGNOSTIC_REQUEST_IPC_msg.byte(5) = 0xFF;
	output( DIAGNOSTIC_REQUEST_IPC_msg ); 
	testWaitForTimeout(200);
 }
 
 // 3101006181 0233 1A 6F E1 88 AE F6 00 06 4A 95 CF AF 4D 7B AC 6F 00 00 00 00 00 05 00 00 00 00 00 00 00 00 00 00 OK
// 3101006181 0281 1A 6F E1 88 AE F6 00 06 4A 95 CF AF 4D 7B AC 6F 1A 6F E1 88 AE F6 00 06 4A 95 CF AF 4D 7B AC 6F
// 3101006181 0297 FF FF FF FF OK
// 3101006181 0298 FFFFFFFF OK
// 3101006181 0231 00
 
 
 export testfunction EngineHours4km_HIGH() //Set Engine Hours value to 4km (exclusive for VF686)
  
  //It’s necessary to check the Memory ID for ENHM_ENGINE_HOURS in “EOL_CONFIGURATION_IPC_226_HIGH” document
{
	DIAGNOSTIC_REQUEST_IPC_msg.id=0x18DA60F1x;
	DIAGNOSTIC_REQUEST_IPC_msg.dlc = 8;
	DIAGNOSTIC_REQUEST_IPC_msg.byte(0) = 0x10;
	DIAGNOSTIC_REQUEST_IPC_msg.byte(1) = 0x0B;
	DIAGNOSTIC_REQUEST_IPC_msg.byte(2) = 0x31;
	DIAGNOSTIC_REQUEST_IPC_msg.byte(3) = 0x01;
	DIAGNOSTIC_REQUEST_IPC_msg.byte(4) = 0x00;
	DIAGNOSTIC_REQUEST_IPC_msg.byte(5) = 0x61;
	DIAGNOSTIC_REQUEST_IPC_msg.byte(6) = 0x81;
	DIAGNOSTIC_REQUEST_IPC_msg.byte(7) = 0x01; //ENHM_ENGINE_HOURS Memory ID
	output( DIAGNOSTIC_REQUEST_IPC_msg );
	testWaitForTimeout(200);
 	DIAGNOSTIC_REQUEST_IPC_msg.id=0x18DA60F1x;
	DIAGNOSTIC_REQUEST_IPC_msg.dlc = 6;
	DIAGNOSTIC_REQUEST_IPC_msg.byte(0) = 0x21;
	DIAGNOSTIC_REQUEST_IPC_msg.byte(1) = 0xB4; //ENHM_ENGINE_HOURS Memory ID
	DIAGNOSTIC_REQUEST_IPC_msg.byte(2) = 0x00;
	DIAGNOSTIC_REQUEST_IPC_msg.byte(3) = 0x00;
	DIAGNOSTIC_REQUEST_IPC_msg.byte(4) = 0x01;
 	DIAGNOSTIC_REQUEST_IPC_msg.byte(5) = 0x00;
	output( DIAGNOSTIC_REQUEST_IPC_msg ); 
  testWaitForTimeout(200);
  }

export testfunction TargetGearStrategy_HIGH() //Set Strategy Gear to "Target Gear" (exclusive for VF200)
  
  //It’s necessary to check the Memory ID for STRATEGY_GEAR in “EOL_CONFIGURATION_IPC_226_HIGH” document
{
	DIAGNOSTIC_REQUEST_IPC_msg.id=0x18DA60F1x;
	DIAGNOSTIC_REQUEST_IPC_msg.dlc = 8;
	DIAGNOSTIC_REQUEST_IPC_msg.byte(0) = 0x10;
	DIAGNOSTIC_REQUEST_IPC_msg.byte(1) = 0x08;
	DIAGNOSTIC_REQUEST_IPC_msg.byte(2) = 0x31;
	DIAGNOSTIC_REQUEST_IPC_msg.byte(3) = 0x01;
	DIAGNOSTIC_REQUEST_IPC_msg.byte(4) = 0x00;
	DIAGNOSTIC_REQUEST_IPC_msg.byte(5) = 0x61;
	DIAGNOSTIC_REQUEST_IPC_msg.byte(6) = 0x81;
	DIAGNOSTIC_REQUEST_IPC_msg.byte(7) = 0x01; //STRATEGY_GEAR Memory ID
	output( DIAGNOSTIC_REQUEST_IPC_msg );
	testWaitForTimeout(200);
 	DIAGNOSTIC_REQUEST_IPC_msg.id=0x18DA60F1x;
	DIAGNOSTIC_REQUEST_IPC_msg.dlc = 3;
	DIAGNOSTIC_REQUEST_IPC_msg.byte(0) = 0x21;
	DIAGNOSTIC_REQUEST_IPC_msg.byte(1) = 0x0D; //STRATEGY_GEAR Memory ID
	DIAGNOSTIC_REQUEST_IPC_msg.byte(2) = 0x01;
	output( DIAGNOSTIC_REQUEST_IPC_msg ); 
  testWaitForTimeout(200);
  
  DIAGNOSTIC_REQUEST_IPC_msg.id=0x18DA60F1x;
	DIAGNOSTIC_REQUEST_IPC_msg.dlc = 5;
	DIAGNOSTIC_REQUEST_IPC_msg.byte(0) = 0x04; 
	DIAGNOSTIC_REQUEST_IPC_msg.byte(1) = 0x31;
	DIAGNOSTIC_REQUEST_IPC_msg.byte(2) = 0x03;
  DIAGNOSTIC_REQUEST_IPC_msg.byte(3) = 0x00;
  DIAGNOSTIC_REQUEST_IPC_msg.byte(4) = 0x61;
	output(DIAGNOSTIC_REQUEST_IPC_msg);
	testWaitForTimeout(200);
}

export testfunction TargetGearStrategy_BASE() //Set Strategy Gear to "Target Gear" (exclusive for VF200)
  
  //It’s necessary to check the Memory ID for STRATEGY_GEAR in “EOL_CONFIGURATION_IPC_226_BASE” document
{
	DIAGNOSTIC_REQUEST_IPC_msg.id=0x18DA60F1x;
	DIAGNOSTIC_REQUEST_IPC_msg.dlc = 8;
	DIAGNOSTIC_REQUEST_IPC_msg.byte(0) = 0x10;
	DIAGNOSTIC_REQUEST_IPC_msg.byte(1) = 0x08;
	DIAGNOSTIC_REQUEST_IPC_msg.byte(2) = 0x31;
	DIAGNOSTIC_REQUEST_IPC_msg.byte(3) = 0x01;
	DIAGNOSTIC_REQUEST_IPC_msg.byte(4) = 0x00;
	DIAGNOSTIC_REQUEST_IPC_msg.byte(5) = 0x61;
	DIAGNOSTIC_REQUEST_IPC_msg.byte(6) = 0x81;
	DIAGNOSTIC_REQUEST_IPC_msg.byte(7) = 0x01; //STRATEGY_GEAR Memory ID
	output( DIAGNOSTIC_REQUEST_IPC_msg );
	testWaitForTimeout(200);
 	DIAGNOSTIC_REQUEST_IPC_msg.id=0x18DA60F1x;
	DIAGNOSTIC_REQUEST_IPC_msg.dlc = 3;
	DIAGNOSTIC_REQUEST_IPC_msg.byte(0) = 0x21;
	DIAGNOSTIC_REQUEST_IPC_msg.byte(1) = 0x55; //STRATEGY_GEAR Memory ID
	DIAGNOSTIC_REQUEST_IPC_msg.byte(2) = 0x01;
	output( DIAGNOSTIC_REQUEST_IPC_msg ); 
  testWaitForTimeout(200);
  
  DIAGNOSTIC_REQUEST_IPC_msg.id=0x18DA60F1x;
	DIAGNOSTIC_REQUEST_IPC_msg.dlc = 5;
	DIAGNOSTIC_REQUEST_IPC_msg.byte(0) = 0x04; 
	DIAGNOSTIC_REQUEST_IPC_msg.byte(1) = 0x31;
	DIAGNOSTIC_REQUEST_IPC_msg.byte(2) = 0x03;
  DIAGNOSTIC_REQUEST_IPC_msg.byte(3) = 0x00;
  DIAGNOSTIC_REQUEST_IPC_msg.byte(4) = 0x61;
	output(DIAGNOSTIC_REQUEST_IPC_msg);
	testWaitForTimeout(200);
}

export testfunction CurrentGearStrategy_HIGH() //Set Strategy Gear to "Current Gear" (exclusive for VF200)
  
  //It’s necessary to check the Memory ID for STRATEGY_GEAR in “EOL_CONFIGURATION_IPC_226_HIGH” document
{
	DIAGNOSTIC_REQUEST_IPC_msg.id=0x18DA60F1x;
	DIAGNOSTIC_REQUEST_IPC_msg.dlc = 8;
	DIAGNOSTIC_REQUEST_IPC_msg.byte(0) = 0x10;
	DIAGNOSTIC_REQUEST_IPC_msg.byte(1) = 0x08;
	DIAGNOSTIC_REQUEST_IPC_msg.byte(2) = 0x31;
	DIAGNOSTIC_REQUEST_IPC_msg.byte(3) = 0x01;
	DIAGNOSTIC_REQUEST_IPC_msg.byte(4) = 0x00;
	DIAGNOSTIC_REQUEST_IPC_msg.byte(5) = 0x61;
	DIAGNOSTIC_REQUEST_IPC_msg.byte(6) = 0x81;
	DIAGNOSTIC_REQUEST_IPC_msg.byte(7) = 0x01; //STRATEGY_GEAR Memory ID
	output( DIAGNOSTIC_REQUEST_IPC_msg );
	testWaitForTimeout(200);
 	DIAGNOSTIC_REQUEST_IPC_msg.id=0x18DA60F1x;
	DIAGNOSTIC_REQUEST_IPC_msg.dlc = 3;
	DIAGNOSTIC_REQUEST_IPC_msg.byte(0) = 0x21;
	DIAGNOSTIC_REQUEST_IPC_msg.byte(1) = 0x0D; //STRATEGY_GEAR Memory ID
	DIAGNOSTIC_REQUEST_IPC_msg.byte(2) = 0x00;
	output( DIAGNOSTIC_REQUEST_IPC_msg ); 
  testWaitForTimeout(200);
  
  DIAGNOSTIC_REQUEST_IPC_msg.id=0x18DA60F1x;
	DIAGNOSTIC_REQUEST_IPC_msg.dlc = 5;
	DIAGNOSTIC_REQUEST_IPC_msg.byte(0) = 0x04; 
	DIAGNOSTIC_REQUEST_IPC_msg.byte(1) = 0x31;
	DIAGNOSTIC_REQUEST_IPC_msg.byte(2) = 0x03;
  DIAGNOSTIC_REQUEST_IPC_msg.byte(3) = 0x00;
  DIAGNOSTIC_REQUEST_IPC_msg.byte(4) = 0x61;
	output(DIAGNOSTIC_REQUEST_IPC_msg);
	testWaitForTimeout(200);
}

export testfunction CurrentGearStrategy_BASE() //Set Strategy Gear to "Current Gear" (exclusive for VF200)
  
  //It’s necessary to check the Memory ID for STRATEGY_GEAR in “EOL_CONFIGURATION_IPC_226_BASE” document
{
	DIAGNOSTIC_REQUEST_IPC_msg.id=0x18DA60F1x;
	DIAGNOSTIC_REQUEST_IPC_msg.dlc = 8;
	DIAGNOSTIC_REQUEST_IPC_msg.byte(0) = 0x10;
	DIAGNOSTIC_REQUEST_IPC_msg.byte(1) = 0x08;
	DIAGNOSTIC_REQUEST_IPC_msg.byte(2) = 0x31;
	DIAGNOSTIC_REQUEST_IPC_msg.byte(3) = 0x01;
	DIAGNOSTIC_REQUEST_IPC_msg.byte(4) = 0x00;
	DIAGNOSTIC_REQUEST_IPC_msg.byte(5) = 0x61;
	DIAGNOSTIC_REQUEST_IPC_msg.byte(6) = 0x81;
	DIAGNOSTIC_REQUEST_IPC_msg.byte(7) = 0x01; //STRATEGY_GEAR Memory ID
	output( DIAGNOSTIC_REQUEST_IPC_msg );
	testWaitForTimeout(200);
 	DIAGNOSTIC_REQUEST_IPC_msg.id=0x18DA60F1x;
	DIAGNOSTIC_REQUEST_IPC_msg.dlc = 3;
	DIAGNOSTIC_REQUEST_IPC_msg.byte(0) = 0x21;
	DIAGNOSTIC_REQUEST_IPC_msg.byte(1) = 0x55; //STRATEGY_GEAR Memory ID
	DIAGNOSTIC_REQUEST_IPC_msg.byte(2) = 0x00;
	output( DIAGNOSTIC_REQUEST_IPC_msg ); 
  testWaitForTimeout(200);
  
  DIAGNOSTIC_REQUEST_IPC_msg.id=0x18DA60F1x;
	DIAGNOSTIC_REQUEST_IPC_msg.dlc = 5;
	DIAGNOSTIC_REQUEST_IPC_msg.byte(0) = 0x04; 
	DIAGNOSTIC_REQUEST_IPC_msg.byte(1) = 0x31;
	DIAGNOSTIC_REQUEST_IPC_msg.byte(2) = 0x03;
  DIAGNOSTIC_REQUEST_IPC_msg.byte(3) = 0x00;
  DIAGNOSTIC_REQUEST_IPC_msg.byte(4) = 0x61;
	output(DIAGNOSTIC_REQUEST_IPC_msg);
	testWaitForTimeout(200);
}

export testfunction MileageCounterReset_HIGH() //Reset VIN_ODOMETER counter (exclusive for VF607)
  
  //It’s necessary to check the Memory ID for VIN_ODOMETER in “EOL_CONFIGURATION_IPC_226_HIGH” document
{
	DIAGNOSTIC_REQUEST_IPC_msg.id=0x18DA60F1x;
	DIAGNOSTIC_REQUEST_IPC_msg.dlc = 8;
	DIAGNOSTIC_REQUEST_IPC_msg.byte(0) = 0x10;
	DIAGNOSTIC_REQUEST_IPC_msg.byte(1) = 0x08;
	DIAGNOSTIC_REQUEST_IPC_msg.byte(2) = 0x31;
	DIAGNOSTIC_REQUEST_IPC_msg.byte(3) = 0x01;
	DIAGNOSTIC_REQUEST_IPC_msg.byte(4) = 0x00;
	DIAGNOSTIC_REQUEST_IPC_msg.byte(5) = 0x61;
	DIAGNOSTIC_REQUEST_IPC_msg.byte(6) = 0x81;
	DIAGNOSTIC_REQUEST_IPC_msg.byte(7) = 0x00; //VIN_ODOMETER Memory ID
	output( DIAGNOSTIC_REQUEST_IPC_msg );
	testWaitForTimeout(200);
 	DIAGNOSTIC_REQUEST_IPC_msg.id=0x18DA60F1x;
	DIAGNOSTIC_REQUEST_IPC_msg.dlc = 3;
	DIAGNOSTIC_REQUEST_IPC_msg.byte(0) = 0x21;
	DIAGNOSTIC_REQUEST_IPC_msg.byte(1) = 0x1E; //VIN_ODOMETER Memory ID
	DIAGNOSTIC_REQUEST_IPC_msg.byte(2) = 0x00;
	output( DIAGNOSTIC_REQUEST_IPC_msg ); 
  testWaitForTimeout(200);
  
  DIAGNOSTIC_REQUEST_IPC_msg.id=0x18DA60F1x;
	DIAGNOSTIC_REQUEST_IPC_msg.dlc = 5;
	DIAGNOSTIC_REQUEST_IPC_msg.byte(0) = 0x04; 
	DIAGNOSTIC_REQUEST_IPC_msg.byte(1) = 0x31;
	DIAGNOSTIC_REQUEST_IPC_msg.byte(2) = 0x03;
  DIAGNOSTIC_REQUEST_IPC_msg.byte(3) = 0x00;
  DIAGNOSTIC_REQUEST_IPC_msg.byte(4) = 0x61;
	output(DIAGNOSTIC_REQUEST_IPC_msg);
	testWaitForTimeout(200);
}

export testfunction MileageCounterReset_BASE() //Reset VIN_ODOMETER counter (exclusive for VF607)
  
  //It’s necessary to check the Memory ID for VIN_ODOMETER in “EOL_CONFIGURATION_IPC_226_BASE” document
{
	DIAGNOSTIC_REQUEST_IPC_msg.id=0x18DA60F1x;
	DIAGNOSTIC_REQUEST_IPC_msg.dlc = 8;
	DIAGNOSTIC_REQUEST_IPC_msg.byte(0) = 0x10;
	DIAGNOSTIC_REQUEST_IPC_msg.byte(1) = 0x08;
	DIAGNOSTIC_REQUEST_IPC_msg.byte(2) = 0x31;
	DIAGNOSTIC_REQUEST_IPC_msg.byte(3) = 0x01;
	DIAGNOSTIC_REQUEST_IPC_msg.byte(4) = 0x00;
	DIAGNOSTIC_REQUEST_IPC_msg.byte(5) = 0x61;
	DIAGNOSTIC_REQUEST_IPC_msg.byte(6) = 0x81;
	DIAGNOSTIC_REQUEST_IPC_msg.byte(7) = 0x00; //VIN_ODOMETER Memory ID
	output( DIAGNOSTIC_REQUEST_IPC_msg );
	testWaitForTimeout(200);
 	DIAGNOSTIC_REQUEST_IPC_msg.id=0x18DA60F1x;
	DIAGNOSTIC_REQUEST_IPC_msg.dlc = 3;
	DIAGNOSTIC_REQUEST_IPC_msg.byte(0) = 0x21;
	DIAGNOSTIC_REQUEST_IPC_msg.byte(1) = 0x1E; //VIN_ODOMETER Memory ID
	DIAGNOSTIC_REQUEST_IPC_msg.byte(2) = 0x00;
	output( DIAGNOSTIC_REQUEST_IPC_msg ); 
  testWaitForTimeout(200);
  
  DIAGNOSTIC_REQUEST_IPC_msg.id=0x18DA60F1x;
	DIAGNOSTIC_REQUEST_IPC_msg.dlc = 5;
	DIAGNOSTIC_REQUEST_IPC_msg.byte(0) = 0x04; 
	DIAGNOSTIC_REQUEST_IPC_msg.byte(1) = 0x31;
	DIAGNOSTIC_REQUEST_IPC_msg.byte(2) = 0x03;
  DIAGNOSTIC_REQUEST_IPC_msg.byte(3) = 0x00;
  DIAGNOSTIC_REQUEST_IPC_msg.byte(4) = 0x61;
	output(DIAGNOSTIC_REQUEST_IPC_msg);
	testWaitForTimeout(200);
}

export testfunction VINLockedbyDiagCommand() //VIN is locked by diag command (exclusive for VF607)
  
{ 
  DIAGNOSTIC_REQUEST_IPC_msg.id=0x18DA60F1x;
	DIAGNOSTIC_REQUEST_IPC_msg.dlc = 5;
	DIAGNOSTIC_REQUEST_IPC_msg.byte(0) = 0x04; 
	DIAGNOSTIC_REQUEST_IPC_msg.byte(1) = 0x31;
	DIAGNOSTIC_REQUEST_IPC_msg.byte(2) = 0x01;
  DIAGNOSTIC_REQUEST_IPC_msg.byte(3) = 0x20;
  DIAGNOSTIC_REQUEST_IPC_msg.byte(4) = 0x00;
	output(DIAGNOSTIC_REQUEST_IPC_msg);
	testWaitForTimeout(200);
}

export testfunction VINUnlockedbyDiagCommand() //VIN is unlocked by diag command (exclusive for VF607)
  
{ 
  DIAGNOSTIC_REQUEST_IPC_msg.id=0x18DA60F1x;
	DIAGNOSTIC_REQUEST_IPC_msg.dlc = 5;
	DIAGNOSTIC_REQUEST_IPC_msg.byte(0) = 0x04; 
	DIAGNOSTIC_REQUEST_IPC_msg.byte(1) = 0x31;
	DIAGNOSTIC_REQUEST_IPC_msg.byte(2) = 0x01;
  DIAGNOSTIC_REQUEST_IPC_msg.byte(3) = 0x20;
  DIAGNOSTIC_REQUEST_IPC_msg.byte(4) = 0x01;
	output(DIAGNOSTIC_REQUEST_IPC_msg);
	testWaitForTimeout(200);
}





export testfunction WRITE_PROXI ()//This Function is used for write proxi by diagnose tool.
{
  testModuleTitle("Writeproxi");
  write("Writeproxi");
  
                sysSetVariableInt(sysvar::SysVar_PROXI::DIAG_eLoadAll,1);
                testWaitForTimeout (200);
                sysSetVariableInt(sysvar::SysVar_PROXI::DIAG_eLoadAll,0);
                testWaitForTimeout (1000);
			        	sysSetVariableInt(sysvar::SysVar_PROXI::DIAG_eSendProxi,1);
                testWaitForTimeout (200);
                sysSetVariableInt(sysvar::SysVar_PROXI::DIAG_eSendProxi,0);
                testWaitForTimeout (200);
              	testModuleTitle("LanguageSelection_Italian>English");
              	write("LanguageSelection_Italian>English");
                sysSetVariableInt(sysvar::RoadMap::LanguageSelection_Req,0);
                testWaitForTimeout (500);
                sysSetVariableInt(sysvar::RoadMap::SendVehicleSetup,1);
                testWaitForTimeout (150);
                sysSetVariableInt(sysvar::RoadMap::SendVehicleSetup,0);
                testWaitForTimeout (500);
            	  sysSetVariableInt(sysvar::RoadMap::LanguageSelection_Req,2);
                testWaitForTimeout (500);
                sysSetVariableInt(sysvar::RoadMap::SendVehicleSetup,1);
                testWaitForTimeout (150);
                sysSetVariableInt(sysvar::RoadMap::SendVehicleSetup,0);
                testWaitForTimeout (500);
}
export testfunction READ_PROXI ()//This Function is used for Read proxi by diagnose tool.
{
  testModuleTitle("Readproxi");
  write("Readproxi");
  
                sysSetVariableInt(sysvar::SysVar_PROXI::DIAG_ProxiLesen,1);
                testWaitForTimeout (200);
                sysSetVariableInt(sysvar::SysVar_PROXI::DIAG_ProxiLesen,0);
                testWaitForTimeout (200);
}

//This Function is used for Send Time and date throw Telematic Control for Project 226 FIAT
export testfunction MENU_Send_TimeDate ()
{
  testModuleTitle("SendTimeDate");
  write("SendTimeDate");
  
                sysSetVariableInt(sysvar::RoadMap::SendTimeDate,1);
                testWaitForTimeout (500);
                sysSetVariableInt(sysvar::RoadMap::SendTimeDate,0);
                testWaitForTimeout (500);
          
}

export testfunction Send_Telematic()
{
  testModuleTitle("Send_Telematic");
  write("Send_Telematic");
  
                sysSetVariableInt(sysvar::RoadMap::SendVehicleSetup,1);
                testWaitForTimeout (500);
                sysSetVariableInt(sysvar::RoadMap::SendVehicleSetup,0);
                testWaitForTimeout (500);
}

export testfunction SEND_TIMEDATE_AUTOMATIC1 ()
{
  testModuleTitle("SEND_TIMEDATE_AUTOMATIC");
  //write("SEND_TIMEDATE_AUTOMATIC");
  
                //sysSetVariableInt(sysvar::RoadMap::SEND_TIMEDATE_AUTOMATIC,1);
                sysSetVariableInt(sysvar::RoadMap::SendTimeDate1,1);
                testWaitForTimeout (200);
                //sysSetVariableInt(sysvar::RoadMap::SEND_TIMEDATE_AUTOMATIC,0);
                sysSetVariableInt(sysvar::RoadMap::SendTimeDate1,0);
                testWaitForTimeout (200);
          
}

export testfunction SEND_TIMEDATE_AUTO_MASTER ()
{
  testModuleTitle("SSEND_TIMEDATE_AUTO_MASTER");
  //write("SEND_TIMEDATE_AUTO_MASTER");
  
                sysSetVariableInt(sysvar::RoadMap::SEND_TIMEDATE_AUTO_MASTER,1);
                testWaitForTimeout (200);
                sysSetVariableInt(sysvar::RoadMap::SEND_TIMEDATE_AUTO_MASTER,0);
                testWaitForTimeout (200);
          
}

export testfunction SendVehicleSetup()
{
  testModuleTitle("SendVehicleSetup");
  write("SendVehicleSetup");
  
                sysSetVariableInt(sysvar::RoadMap::SendVehicleSetup,1);
                testWaitForTimeout (200);
                sysSetVariableInt(sysvar::RoadMap::SendVehicleSetup,0);
                testWaitForTimeout (200);
}

export testfunction SendNavInfo()
{
  testModuleTitle("SendNavInfo");
  write("SendNavInfo");
  
                sysSetVariableInt(sysvar::RoadMap::SendNav_info,1);
                testWaitForTimeout (200);
                sysSetVariableInt(sysvar::RoadMap::SendNav_info,0);
                testWaitForTimeout (200);
} 

export testfunction DistanceUnit_km()
{
  testModuleTitle("DistanceUnit_km");
  sysSetVariableInt(sysvar::RoadMap::DistanceUnit_Req,0);
  testWaitForTimeout (200);
  sysSetVariableInt(sysvar::RoadMap::SendVehicleSetup,1);
  testWaitForTimeout (200);
  sysSetVariableInt(sysvar::RoadMap::SendVehicleSetup,0);
  testWaitForTimeout (200);
}

export testfunction DistanceUnit_Miles()
{
  testModuleTitle("DistanceUnit_Miles");
  sysSetVariableInt(sysvar::RoadMap::DistanceUnit_Req,1);
  sysSetVariableInt(sysvar::RoadMap::ConsumptionUnit_Req,1);
  sysSetVariableInt(sysvar::RoadMap::LanguageSelection_Req,2);
  testWaitForTimeout (200);
  sysSetVariableInt(sysvar::RoadMap::SendVehicleSetup,1);
  testWaitForTimeout (200);
  sysSetVariableInt(sysvar::RoadMap::SendVehicleSetup,0);
  testWaitForTimeout (200);
}

export testfunction TemperatureUnit_C()
{
  testModuleTitle("TemperatureUnit_C");
  write("TemperatureUnit_C");
  
                sysSetVariableInt(sysvar::RoadMap::TemperatureUnit_Req,0);
                testWaitForTimeout (500);
                sysSetVariableInt(sysvar::RoadMap::SendVehicleSetup,1);
                testWaitForTimeout (500);
                sysSetVariableInt(sysvar::RoadMap::SendVehicleSetup,0);
                testWaitForTimeout (500);
}

export testfunction TemperatureUnit_F()
{
  testModuleTitle("TemperatureUnit_F");
  write("TemperatureUnit_F");
  
                sysSetVariableInt(sysvar::RoadMap::TemperatureUnit_Req,1);
                testWaitForTimeout (500);
                sysSetVariableInt(sysvar::RoadMap::SendVehicleSetup,1);
                testWaitForTimeout (500);
                sysSetVariableInt(sysvar::RoadMap::SendVehicleSetup,0);
                testWaitForTimeout (500);
}

export testfunction KOF_KON ()
{
  testModuleTitle("KOF_KON");
    sysSetVariableInt(sysvar::RoadMap::OperationalModeSts,1);
    testWaitForTimeout (delay);
    sysSetVariableInt(sysvar::RoadMap::OperationalModeSts,10);
    testWaitForTimeout (delay);
    sysSetVariableInt(sysvar::RoadMap::OperationalModeSts,2);
    testWaitForTimeout (delay);  
    sysSetVariableInt(sysvar::RoadMap::OperationalModeSts,4);
    testWaitForTimeout (500);
}

export testfunction INT_Info_Not_active ()
{
  testModuleTitle("INT_Info_Not_active");
  //write("INT_Info_Not_active");
  
                SysSetVariableInt(sysvar::RoadMap::KL15,0);
                testWaitForTimeout (500);
}

export testfunction Send_Km_AND_Day()
{
  testModuleTitle("Send_Km_AND_Day");
  write("Send_Km_AND_Day");
             
                sysSetVariableInt(sysvar::RoadMap::Hour1_TLM,2);
                sysSetVariableInt(sysvar::RoadMap::Hour2_TLM,3);
                sysSetVariableInt(sysvar::RoadMap::Minute1_TLM,5);
                sysSetVariableInt(sysvar::RoadMap::Minute2_TLM,9);
                sysSetVariableInt(sysvar::RoadMap::SendTimeDate1,1);
                testWaitForTimeout (200);
                sysSetVariableInt(sysvar::RoadMap::SendTimeDate1,0);
                testWaitForTimeout (24000); 
                sysSetVariableInt(sysvar::RoadMap::EnableTravelDistance,1);
                sysSetVariableInt(sysvar::RoadMap::WC_Ignition_On_EngOn_AUTO,1);
                sysSetVariableFloat(sysvar::RoadMap::VehicleSpeedVSOSig,100);
                sysSetVariableInt(sysvar::RoadMap::EngineSpeed,3000);
                sysSetVariableFloat(sysvar::RoadMap::FuelLevel,50);
                sysSetVariableFloat(sysvar::RoadMap::FuelConsumption_GAG,12);
                testWaitForTimeout (36000); 
}

// Test Functions used by VF140 -Seat Belt Warning Management related by paragraph  1.11.2.2.1.1	SBR1Row Seat Warning Management
//Driver - DRV
export testfunction SBR1RowDriverWarning_Active1()
{
  testModuleTitle("SBR1RowDriverWarning_Active1");
  //write("SBR1RowDriverWarning_Active1");
  
                sysSetVariableInt(sysvar::RoadMap::SBR1RowDriverSeatConfigSts,1);
                sysSetVariableInt(sysvar::RoadMap::SBR1RowDriverSeatSts,1);
                sysSetVariableInt(sysvar::RoadMap::SBR1RowDriverSeatFailSts,0);
                               
}

export testfunction SBR1RowDriverWarning_Active2()
{
  testModuleTitle("SBR1RowDriverWarning_Active2");
  //write("SBR1RowDriverWarning_Active2");
  
                sysSetVariableInt(sysvar::RoadMap::SBR1RowDriverSeatConfigSts,1);
                sysSetVariableInt(sysvar::RoadMap::SBR1RowDriverSeatSts,1);
                sysSetVariableInt(sysvar::RoadMap::SBR1RowDriverSeatFailSts,3);
                               
}

export testfunction SBR1RowDriverWarning_Active3()
{
  testModuleTitle("SBR1RowDriverWarning_Active3");
  //write("SBR1RowDriverWarning_Active3");
  
                sysSetVariableInt(sysvar::RoadMap::SBR1RowDriverSeatConfigSts,1);
                sysSetVariableInt(sysvar::RoadMap::SBR1RowDriverSeatSts,0);
                sysSetVariableInt(sysvar::RoadMap::SBR1RowDriverSeatFailSts,1);
                               
}

export testfunction SBR1RowDriverWarning_Active4()
{
  testModuleTitle("SBR1RowDriverWarning_Active4");
  //write("SBR1RowDriverWarning_Active4");
  
                sysSetVariableInt(sysvar::RoadMap::SBR1RowDriverSeatConfigSts,1);
                sysSetVariableInt(sysvar::RoadMap::SBR1RowDriverSeatSts,1);
                sysSetVariableInt(sysvar::RoadMap::SBR1RowDriverSeatFailSts,1);
                               
}

export testfunction SBR1RowDriverWarning_Active5()
{
  testModuleTitle("SBR1RowDriverWarning_Active5");
  //write("SBR1RowDriverWarning_Active5");
  
                sysSetVariableInt(sysvar::RoadMap::SBR1RowDriverSeatConfigSts,1);
                sysSetVariableInt(sysvar::RoadMap::SBR1RowDriverSeatSts,3);
                sysSetVariableInt(sysvar::RoadMap::SBR1RowDriverSeatFailSts,1);
                               
}

export testfunction SBR1RowDriverWarning_Not_Active6()
{
  testModuleTitle("SBR1RowDriverWarning_Not_Active6");
  //write("SBR1RowDriverWarning_Not_Active6");
  
                sysSetVariableInt(sysvar::RoadMap::SBR1RowDriverSeatConfigSts,1);
                sysSetVariableInt(sysvar::RoadMap::SBR1RowDriverSeatSts,0);
                sysSetVariableInt(sysvar::RoadMap::SBR1RowDriverSeatFailSts,3);
                               
}

export testfunction SBR1RowDriverWarning_Not_Active7()
{
  testModuleTitle("SBR1RowDriverWarning_Not_Active7");
  //write("SBR1RowDriverWarning_Not_Active7");
  
                sysSetVariableInt(sysvar::RoadMap::SBR1RowDriverSeatConfigSts,1);
                sysSetVariableInt(sysvar::RoadMap::SBR1RowDriverSeatSts,0);
                sysSetVariableInt(sysvar::RoadMap::SBR1RowDriverSeatFailSts,0);
                               
}

export testfunction SBR1RowDriverWarning_Not_Active8()
{
  testModuleTitle("SBR1RowDriverWarning_Not_Active8");
  //write("SBR1RowDriverWarning_Not_Active8");
  
                sysSetVariableInt(sysvar::RoadMap::SBR1RowDriverSeatConfigSts,1);
                sysSetVariableInt(sysvar::RoadMap::SBR1RowDriverSeatSts,3);
                sysSetVariableInt(sysvar::RoadMap::SBR1RowDriverSeatFailSts,0);
                               
}

export testfunction SBR1RowDriverWarning_Not_Active9()
{
  testModuleTitle("SBR1RowDriverWarning_Not_Active9");
  //write("SBR1RowDriverWarning_Not_Active9");
  
                sysSetVariableInt(sysvar::RoadMap::SBR1RowDriverSeatConfigSts,1);
                sysSetVariableInt(sysvar::RoadMap::SBR1RowDriverSeatSts,3);
                sysSetVariableInt(sysvar::RoadMap::SBR1RowDriverSeatFailSts,3);
                               
}

export testfunction SBR1RowDriverWarning_Not_Active10()
{
  testModuleTitle("SBR1RowDriverWarning_Not_Active10");
  //write("SBR1RowDriverWarning_Not_Active10");
  
                sysSetVariableInt(sysvar::RoadMap::SBR1RowDriverSeatConfigSts,0);
                sysSetVariableInt(sysvar::RoadMap::SBR1RowDriverSeatSts,0);
                sysSetVariableInt(sysvar::RoadMap::SBR1RowDriverSeatFailSts,0);
                               
}

export testfunction SBR1RowDriverWarning_Not_Active11()
{
  testModuleTitle("SBR1RowDriverWarning_Not_Active11");
  //write("SBR1RowDriverWarning_Not_Active11");
  
                sysSetVariableInt(sysvar::RoadMap::SBR1RowDriverSeatConfigSts,0);
                sysSetVariableInt(sysvar::RoadMap::SBR1RowDriverSeatSts,1);
                sysSetVariableInt(sysvar::RoadMap::SBR1RowDriverSeatFailSts,1);
                               
}

export testfunction SBR1RowDriverWarning_Not_Active12()
{
  testModuleTitle("SBR1RowDriverWarning_Not_Active12");
  //write("SBR1RowDriverWarning_Not_Active12");
  
                sysSetVariableInt(sysvar::RoadMap::SBR1RowDriverSeatConfigSts,0);
                sysSetVariableInt(sysvar::RoadMap::SBR1RowDriverSeatSts,3);
                sysSetVariableInt(sysvar::RoadMap::SBR1RowDriverSeatFailSts,3);
                               
}

export testfunction SBR1RowDriverWarning_Not_Active()// SBR1RowDriverWarning_Not_Active15
{
  testModuleTitle("SBR1RowDriverWarning_Not_Active");
  //write("SBR1RowDriverWarning_Not_Active");
  
                sysSetVariableInt(sysvar::RoadMap::SBR1RowDriverSeatConfigSts,0);
                sysSetVariableInt(sysvar::RoadMap::SBR1RowDriverSeatSts,3);
                sysSetVariableInt(sysvar::RoadMap::SBR1RowDriverSeatFailSts,0);
                               
}

export testfunction SBR1RowDriverWarning_Not_Active13()
{
  testModuleTitle("SBR1RowDriverWarning_Not_Active13");
  //write("SBR1RowDriverWarning_Not_Active13");
  
                sysSetVariableInt(sysvar::RoadMap::SBR1RowDriverSeatConfigSts,0);
                sysSetVariableInt(sysvar::RoadMap::SBR1RowDriverSeatSts,1);
                sysSetVariableInt(sysvar::RoadMap::SBR1RowDriverSeatFailSts,0);
                               
}

export testfunction SBR1RowDriverWarning_Not_Active14()
{
  testModuleTitle("SBR1RowDriverWarning_Not_Active14");
  //write("SBR1RowDriverWarning_Not_Active14");
  
                sysSetVariableInt(sysvar::RoadMap::SBR1RowDriverSeatConfigSts,0);
                sysSetVariableInt(sysvar::RoadMap::SBR1RowDriverSeatSts,0);
                sysSetVariableInt(sysvar::RoadMap::SBR1RowDriverSeatFailSts,1);
                               
}

export testfunction SBR1RowDriverWarning_Not_Active16()
{
  testModuleTitle("SBR1RowDriverWarning_Not_Active16");
  //write("SBR1RowDriverWarning_Not_Active16");
  
                sysSetVariableInt(sysvar::RoadMap::SBR1RowDriverSeatConfigSts,0);
                sysSetVariableInt(sysvar::RoadMap::SBR1RowDriverSeatSts,0);
                sysSetVariableInt(sysvar::RoadMap::SBR1RowDriverSeatFailSts,3);
                               
}

export testfunction SBR1RowDriverWarning_Not_Active17()
{
  testModuleTitle("SBR1RowDriverWarning_Not_Active17");
  //write("SBR1RowDriverWarning_Not_Active17");
  
                sysSetVariableInt(sysvar::RoadMap::SBR1RowDriverSeatConfigSts,0);
                sysSetVariableInt(sysvar::RoadMap::SBR1RowDriverSeatSts,1);
                sysSetVariableInt(sysvar::RoadMap::SBR1RowDriverSeatFailSts,3);
                               
}

export testfunction SBR1RowDriverWarning_Not_Active18()
{
  testModuleTitle("SBR1RowDriverWarning_Not_Active18");
  //write("SBR1RowDriverWarning_Not_Active18");
  
                sysSetVariableInt(sysvar::RoadMap::SBR1RowDriverSeatConfigSts,0);
                sysSetVariableInt(sysvar::RoadMap::SBR1RowDriverSeatSts,3);
                sysSetVariableInt(sysvar::RoadMap::SBR1RowDriverSeatFailSts,1);
                               
}


// Passenger - PSNGR

export testfunction SBR1RowPSGNRWarning_Active1()
{
  testModuleTitle("SBR1RowPSGNRWarning_Active1");
  //write("SBR1RowPSGNRWarning_Active1");
  
                sysSetVariableInt(sysvar::RoadMap::SBR1RowPsngrSeatConfigSts,1);
                sysSetVariableInt(sysvar::RoadMap::SBR1RowPsngrSeatSts,3);
                sysSetVariableInt(sysvar::RoadMap::SBR1RowPsngrSeatPPDFailSts,0);
                sysSetVariableInt(sysvar::RoadMap::SBR1RowPsngrSeatBuckleFailSts,0);  
                
}

export testfunction SBR1RowPSGNRWarning_Active2()
{
  testModuleTitle("SBR1RowPSGNRWarning_Active2");
  //write("SBR1RowPSGNRWarning_Active2");
  
                sysSetVariableInt(sysvar::RoadMap::SBR1RowPsngrSeatConfigSts,1);
                sysSetVariableInt(sysvar::RoadMap::SBR1RowPsngrSeatSts,3);
                sysSetVariableInt(sysvar::RoadMap::SBR1RowPsngrSeatPPDFailSts,3);
                sysSetVariableInt(sysvar::RoadMap::SBR1RowPsngrSeatBuckleFailSts,3);  
                
}

export testfunction SBR1RowPSGNRWarning_Active3()
{
  testModuleTitle("SBR1RowPSGNRWarning_Active3");
  //write("SBR1RowPSGNRWarning_Active3");
  
                sysSetVariableInt(sysvar::RoadMap::SBR1RowPsngrSeatConfigSts,1);
                sysSetVariableInt(sysvar::RoadMap::SBR1RowPsngrSeatSts,3);
                sysSetVariableInt(sysvar::RoadMap::SBR1RowPsngrSeatPPDFailSts,0);
                sysSetVariableInt(sysvar::RoadMap::SBR1RowPsngrSeatBuckleFailSts,3);  
                
}

export testfunction SBR1RowPSGNRWarning_Active4()
{
  testModuleTitle("SBR1RowPSGNRWarning_Active4");
  //write("SBR1RowPSGNRWarning_Active4");
  
                sysSetVariableInt(sysvar::RoadMap::SBR1RowPsngrSeatConfigSts,1);
                sysSetVariableInt(sysvar::RoadMap::SBR1RowPsngrSeatSts,3);
                sysSetVariableInt(sysvar::RoadMap::SBR1RowPsngrSeatPPDFailSts,3);
                sysSetVariableInt(sysvar::RoadMap::SBR1RowPsngrSeatBuckleFailSts,0);  
                
}

export testfunction SBR1RowPSGNRWarning_Active5()
{
  testModuleTitle("SBR1RowPSGNRWarning_Active5");
  //write("SBR1RowPSGNRWarning_Active5");
  
                sysSetVariableInt(sysvar::RoadMap::SBR1RowPsngrSeatConfigSts,1);
                sysSetVariableInt(sysvar::RoadMap::SBR1RowPsngrSeatSts,0);
                sysSetVariableInt(sysvar::RoadMap::SBR1RowPsngrSeatPPDFailSts,0);
                sysSetVariableInt(sysvar::RoadMap::SBR1RowPsngrSeatBuckleFailSts,1);  
                
}

export testfunction SBR1RowPSGNRWarning_Active6()
{
  testModuleTitle("SBR1RowPSGNRWarning_Active6");
  //write("SBR1RowPSGNRWarning_Active6");
  
                sysSetVariableInt(sysvar::RoadMap::SBR1RowPsngrSeatConfigSts,1);
                sysSetVariableInt(sysvar::RoadMap::SBR1RowPsngrSeatSts,1);
                sysSetVariableInt(sysvar::RoadMap::SBR1RowPsngrSeatPPDFailSts,0);
                sysSetVariableInt(sysvar::RoadMap::SBR1RowPsngrSeatBuckleFailSts,1);  
                
}

export testfunction SBR1RowPSGNRWarning_Active7()
{
  testModuleTitle("SBR1RowPSGNRWarning_Active7");
  //write("SBR1RowPSGNRWarning_Active7");
  
                sysSetVariableInt(sysvar::RoadMap::SBR1RowPsngrSeatConfigSts,1);
                sysSetVariableInt(sysvar::RoadMap::SBR1RowPsngrSeatSts,2);
                sysSetVariableInt(sysvar::RoadMap::SBR1RowPsngrSeatPPDFailSts,0);
                sysSetVariableInt(sysvar::RoadMap::SBR1RowPsngrSeatBuckleFailSts,1);  
                
}

export testfunction SBR1RowPSGNRWarning_Active8()
{
  testModuleTitle("SBR1RowPSGNRWarning_Active8");
  //write("SBR1RowPSGNRWarning_Active8");
  
                sysSetVariableInt(sysvar::RoadMap::SBR1RowPsngrSeatConfigSts,1);
                sysSetVariableInt(sysvar::RoadMap::SBR1RowPsngrSeatSts,3);
                sysSetVariableInt(sysvar::RoadMap::SBR1RowPsngrSeatPPDFailSts,0);
                sysSetVariableInt(sysvar::RoadMap::SBR1RowPsngrSeatBuckleFailSts,1);  
                
}

export testfunction SBR1RowPSGNRWarning_Active9()
{
  testModuleTitle("SBR1RowPSGNRWarning_Active9");
  //write("SBR1RowPSGNRWarning_Active9");
  
                sysSetVariableInt(sysvar::RoadMap::SBR1RowPsngrSeatConfigSts,1);
                sysSetVariableInt(sysvar::RoadMap::SBR1RowPsngrSeatSts,7);
                sysSetVariableInt(sysvar::RoadMap::SBR1RowPsngrSeatPPDFailSts,0);
                sysSetVariableInt(sysvar::RoadMap::SBR1RowPsngrSeatBuckleFailSts,1);  
                
}

export testfunction SBR1RowPSGNRWarning_Active10()
{
  testModuleTitle("SBR1RowPSGNRWarning_Active10");
  //write("SBR1RowPSGNRWarning_Active10");
  
                sysSetVariableInt(sysvar::RoadMap::SBR1RowPsngrSeatConfigSts,1);
                sysSetVariableInt(sysvar::RoadMap::SBR1RowPsngrSeatSts,0);
                sysSetVariableInt(sysvar::RoadMap::SBR1RowPsngrSeatPPDFailSts,3);
                sysSetVariableInt(sysvar::RoadMap::SBR1RowPsngrSeatBuckleFailSts,1);  
                
}

export testfunction SBR1RowPSGNRWarning_Active11()
{
  testModuleTitle("SBR1RowPSGNRWarning_Active11");
  //write("SBR1RowPSGNRWarning_Active11");
  
                sysSetVariableInt(sysvar::RoadMap::SBR1RowPsngrSeatConfigSts,1);
                sysSetVariableInt(sysvar::RoadMap::SBR1RowPsngrSeatSts,1);
                sysSetVariableInt(sysvar::RoadMap::SBR1RowPsngrSeatPPDFailSts,3);
                sysSetVariableInt(sysvar::RoadMap::SBR1RowPsngrSeatBuckleFailSts,1);  
                
}

export testfunction SBR1RowPSGNRWarning_Active12()
{
  testModuleTitle("SBR1RowPSGNRWarning_Active12");
  //write("SBR1RowPSGNRWarning_Active12");
  
                sysSetVariableInt(sysvar::RoadMap::SBR1RowPsngrSeatConfigSts,1);
                sysSetVariableInt(sysvar::RoadMap::SBR1RowPsngrSeatSts,2);
                sysSetVariableInt(sysvar::RoadMap::SBR1RowPsngrSeatPPDFailSts,3);
                sysSetVariableInt(sysvar::RoadMap::SBR1RowPsngrSeatBuckleFailSts,1);  
                
}

export testfunction SBR1RowPSGNRWarning_Active13()
{
  testModuleTitle("SBR1RowPSGNRWarning_Active13");
  //write("SBR1RowPSGNRWarning_Active13");
  
                sysSetVariableInt(sysvar::RoadMap::SBR1RowPsngrSeatConfigSts,1);
                sysSetVariableInt(sysvar::RoadMap::SBR1RowPsngrSeatSts,3);
                sysSetVariableInt(sysvar::RoadMap::SBR1RowPsngrSeatPPDFailSts,3);
                sysSetVariableInt(sysvar::RoadMap::SBR1RowPsngrSeatBuckleFailSts,1);  
                
}

export testfunction SBR1RowPSGNRWarning_Active14()
{
  testModuleTitle("SBR1RowPSGNRWarning_Active14");
  //write("SBR1RowPSGNRWarning_Active14");
  
                sysSetVariableInt(sysvar::RoadMap::SBR1RowPsngrSeatConfigSts,1);
                sysSetVariableInt(sysvar::RoadMap::SBR1RowPsngrSeatSts,7);
                sysSetVariableInt(sysvar::RoadMap::SBR1RowPsngrSeatPPDFailSts,3);
                sysSetVariableInt(sysvar::RoadMap::SBR1RowPsngrSeatBuckleFailSts,1);  
                
}
export testfunction SBR1RowPSGNRWarning_Not_Active15()
{
  testModuleTitle("SBR1RowPSGNRWarning_Not_Active15");
  //write("SBR1RowPSGNRWarning_Not_Active15");
  
                sysSetVariableInt(sysvar::RoadMap::SBR1RowPsngrSeatConfigSts,1);
                sysSetVariableInt(sysvar::RoadMap::SBR1RowPsngrSeatSts,2);
                sysSetVariableInt(sysvar::RoadMap::SBR1RowPsngrSeatPPDFailSts,0);
                sysSetVariableInt(sysvar::RoadMap::SBR1RowPsngrSeatBuckleFailSts,0);  
                
}

export testfunction SBR1RowPSGNRWarning_Not_Active16()
{
  testModuleTitle("SBR1RowPSGNRWarning_Not_Active16");
  //write("SBR1RowPSGNRWarning_Not_Active16");
  
                sysSetVariableInt(sysvar::RoadMap::SBR1RowPsngrSeatConfigSts,1);
                sysSetVariableInt(sysvar::RoadMap::SBR1RowPsngrSeatSts,2);
                sysSetVariableInt(sysvar::RoadMap::SBR1RowPsngrSeatPPDFailSts,3);
                sysSetVariableInt(sysvar::RoadMap::SBR1RowPsngrSeatBuckleFailSts,3);  
                
}

export testfunction SBR1RowPSGNRWarning_Not_Active17()
{
  testModuleTitle("SBR1RowPSGNRWarning_Not_Active17");
  //write("SBR1RowPSGNRWarning_Not_Active17");
  
                sysSetVariableInt(sysvar::RoadMap::SBR1RowPsngrSeatConfigSts,1);
                sysSetVariableInt(sysvar::RoadMap::SBR1RowPsngrSeatSts,2);
                sysSetVariableInt(sysvar::RoadMap::SBR1RowPsngrSeatPPDFailSts,0);
                sysSetVariableInt(sysvar::RoadMap::SBR1RowPsngrSeatBuckleFailSts,3);  
                
}

export testfunction SBR1RowPSGNRWarning_Not_Active18()
{
  testModuleTitle("SBR1RowPSGNRWarning_Not_Active18");
  //write("SBR1RowPSGNRWarning_Not_Active18");
  
                sysSetVariableInt(sysvar::RoadMap::SBR1RowPsngrSeatConfigSts,1);
                sysSetVariableInt(sysvar::RoadMap::SBR1RowPsngrSeatSts,2);
                sysSetVariableInt(sysvar::RoadMap::SBR1RowPsngrSeatPPDFailSts,3);
                sysSetVariableInt(sysvar::RoadMap::SBR1RowPsngrSeatBuckleFailSts,0);  
                
}

export testfunction SBR1RowPSGNRWarning_Not_Active19()
{
  testModuleTitle("SBR1RowPSGNRWarning_Not_Active19");
  //write("SBR1RowPSGNRWarning_Not_Active19");
  
                sysSetVariableInt(sysvar::RoadMap::SBR1RowPsngrSeatConfigSts,1);
                sysSetVariableInt(sysvar::RoadMap::SBR1RowPsngrSeatSts,7);
                sysSetVariableInt(sysvar::RoadMap::SBR1RowPsngrSeatPPDFailSts,0);
                sysSetVariableInt(sysvar::RoadMap::SBR1RowPsngrSeatBuckleFailSts,0);  
                
}

export testfunction SBR1RowPSGNRWarning_Not_Active20()
{
  testModuleTitle("SBR1RowPSGNRWarning_Not_Active20");
  //write("SBR1RowPSGNRWarning_Not_Active20");
  
                sysSetVariableInt(sysvar::RoadMap::SBR1RowPsngrSeatConfigSts,1);
                sysSetVariableInt(sysvar::RoadMap::SBR1RowPsngrSeatSts,7);
                sysSetVariableInt(sysvar::RoadMap::SBR1RowPsngrSeatPPDFailSts,3);
                sysSetVariableInt(sysvar::RoadMap::SBR1RowPsngrSeatBuckleFailSts,3);  
                
}

export testfunction SBR1RowPSGNRWarning_Not_Active21()
{
  testModuleTitle("SBR1RowPSGNRWarning_Not_Active21");
  //write("SBR1RowPSGNRWarning_Not_Active21");
  
                sysSetVariableInt(sysvar::RoadMap::SBR1RowPsngrSeatConfigSts,1);
                sysSetVariableInt(sysvar::RoadMap::SBR1RowPsngrSeatSts,7);
                sysSetVariableInt(sysvar::RoadMap::SBR1RowPsngrSeatPPDFailSts,0);
                sysSetVariableInt(sysvar::RoadMap::SBR1RowPsngrSeatBuckleFailSts,3);  
                
}

export testfunction SBR1RowPSGNRWarning_Not_Active22()
{
  testModuleTitle("SBR1RowPSGNRWarning_Not_Active22");
  //write("SBR1RowPSGNRWarning_Not_Active22");
  
                sysSetVariableInt(sysvar::RoadMap::SBR1RowPsngrSeatConfigSts,1);
                sysSetVariableInt(sysvar::RoadMap::SBR1RowPsngrSeatSts,7);
                sysSetVariableInt(sysvar::RoadMap::SBR1RowPsngrSeatPPDFailSts,3);
                sysSetVariableInt(sysvar::RoadMap::SBR1RowPsngrSeatBuckleFailSts,0);  
                
}

export testfunction SBR1RowPSGNRWarning_Not_Active23()
{
  testModuleTitle("SBR1RowPSGNRWarning_Not_Active23");
  //write("SBR1RowPSGNRWarning_Not_Active23");
  
                sysSetVariableInt(sysvar::RoadMap::SBR1RowPsngrSeatConfigSts,0);
                sysSetVariableInt(sysvar::RoadMap::SBR1RowPsngrSeatSts,0);
                sysSetVariableInt(sysvar::RoadMap::SBR1RowPsngrSeatPPDFailSts,0);
                sysSetVariableInt(sysvar::RoadMap::SBR1RowPsngrSeatBuckleFailSts,0);  
                
}

export testfunction SBR1RowPSGNRWarning_Not_Active24()
{
  testModuleTitle("SBR1RowPSGNRWarning_Not_Active24");
  //write("SBR1RowPSGNRWarning_Not_Active24");
  
                sysSetVariableInt(sysvar::RoadMap::SBR1RowPsngrSeatConfigSts,0);
                sysSetVariableInt(sysvar::RoadMap::SBR1RowPsngrSeatSts,1);
                sysSetVariableInt(sysvar::RoadMap::SBR1RowPsngrSeatPPDFailSts,0);
                sysSetVariableInt(sysvar::RoadMap::SBR1RowPsngrSeatBuckleFailSts,0);  
                
}

export testfunction SBR1RowPSGNRWarning_Not_Active25()
{
  testModuleTitle("SBR1RowPSGNRWarning_Not_Active25");
  //write("SBR1RowPSGNRWarning_Not_Active25");
  
                sysSetVariableInt(sysvar::RoadMap::SBR1RowPsngrSeatConfigSts,0);
                sysSetVariableInt(sysvar::RoadMap::SBR1RowPsngrSeatSts,2);
                sysSetVariableInt(sysvar::RoadMap::SBR1RowPsngrSeatPPDFailSts,0);
                sysSetVariableInt(sysvar::RoadMap::SBR1RowPsngrSeatBuckleFailSts,0);  
                
}

export testfunction SBR1RowPSGNRWarning_Not_Active26()
{
  testModuleTitle("SBR1RowPSGNRWarning_Not_Active26");
  //write("SBR1RowPSGNRWarning_Not_Active26");
  
                sysSetVariableInt(sysvar::RoadMap::SBR1RowPsngrSeatConfigSts,0);
                sysSetVariableInt(sysvar::RoadMap::SBR1RowPsngrSeatSts,3);
                sysSetVariableInt(sysvar::RoadMap::SBR1RowPsngrSeatPPDFailSts,0);
                sysSetVariableInt(sysvar::RoadMap::SBR1RowPsngrSeatBuckleFailSts,0);  
                
}

export testfunction SBR1RowPSGNRWarning_Not_Active27()
{
  testModuleTitle("SBR1RowPSGNRWarning_Not_Active27");
  //write("SBR1RowPSGNRWarning_Not_Active27");
  
                sysSetVariableInt(sysvar::RoadMap::SBR1RowPsngrSeatConfigSts,0);
                sysSetVariableInt(sysvar::RoadMap::SBR1RowPsngrSeatSts,7);
                sysSetVariableInt(sysvar::RoadMap::SBR1RowPsngrSeatPPDFailSts,0);
                sysSetVariableInt(sysvar::RoadMap::SBR1RowPsngrSeatBuckleFailSts,0);  
                
}

export testfunction SBR1RowPSGNRWarning_Not_Active28()
{
  testModuleTitle("SBR1RowPSGNRWarning_Not_Active28");
  //write("SBR1RowPSGNRWarning_Not_Active28");
  
                sysSetVariableInt(sysvar::RoadMap::SBR1RowPsngrSeatConfigSts,0);
                sysSetVariableInt(sysvar::RoadMap::SBR1RowPsngrSeatSts,0);
                sysSetVariableInt(sysvar::RoadMap::SBR1RowPsngrSeatPPDFailSts,1);
                sysSetVariableInt(sysvar::RoadMap::SBR1RowPsngrSeatBuckleFailSts,1);  
                
}

export testfunction SBR1RowPSGNRWarning_Not_Active29()
{
  testModuleTitle("SBR1RowPSGNRWarning_Not_Active29");
  //write("SBR1RowPSGNRWarning_Not_Active29");
  
                sysSetVariableInt(sysvar::RoadMap::SBR1RowPsngrSeatConfigSts,0);
                sysSetVariableInt(sysvar::RoadMap::SBR1RowPsngrSeatSts,1);
                sysSetVariableInt(sysvar::RoadMap::SBR1RowPsngrSeatPPDFailSts,1);
                sysSetVariableInt(sysvar::RoadMap::SBR1RowPsngrSeatBuckleFailSts,1);  
                
}

export testfunction SBR1RowPSGNRWarning_Not_Active30()
{
  testModuleTitle("SBR1RowPSGNRWarning_Not_Active30");
  //write("SBR1RowPSGNRWarning_Not_Active30");
  
                sysSetVariableInt(sysvar::RoadMap::SBR1RowPsngrSeatConfigSts,0);
                sysSetVariableInt(sysvar::RoadMap::SBR1RowPsngrSeatSts,2);
                sysSetVariableInt(sysvar::RoadMap::SBR1RowPsngrSeatPPDFailSts,1);
                sysSetVariableInt(sysvar::RoadMap::SBR1RowPsngrSeatBuckleFailSts,1);  
                
}

export testfunction SBR1RowPSGNRWarning_Not_Active31()
{
  testModuleTitle("SBR1RowPSGNRWarning_Not_Active31");
  //write("SBR1RowPSGNRWarning_Not_Active31");
  
                sysSetVariableInt(sysvar::RoadMap::SBR1RowPsngrSeatConfigSts,0);
                sysSetVariableInt(sysvar::RoadMap::SBR1RowPsngrSeatSts,3);
                sysSetVariableInt(sysvar::RoadMap::SBR1RowPsngrSeatPPDFailSts,1);
                sysSetVariableInt(sysvar::RoadMap::SBR1RowPsngrSeatBuckleFailSts,1);  
                
}

export testfunction SBR1RowPSGNRWarning_Not_Active32()
{
  testModuleTitle("SBR1RowPSGNRWarning_Not_Active32");
  //write("SBR1RowPSGNRWarning_Not_Active32");
  
                sysSetVariableInt(sysvar::RoadMap::SBR1RowPsngrSeatConfigSts,0);
                sysSetVariableInt(sysvar::RoadMap::SBR1RowPsngrSeatSts,7);
                sysSetVariableInt(sysvar::RoadMap::SBR1RowPsngrSeatPPDFailSts,1);
                sysSetVariableInt(sysvar::RoadMap::SBR1RowPsngrSeatBuckleFailSts,1);  
                
}

export testfunction SBR1RowPSGNRWarning_Not_Active33()
{
  testModuleTitle("SBR1RowPSGNRWarning_Not_Active33");
  //write("SBR1RowPSGNRWarning_Not_Active33");
  
                sysSetVariableInt(sysvar::RoadMap::SBR1RowPsngrSeatConfigSts,0);
                sysSetVariableInt(sysvar::RoadMap::SBR1RowPsngrSeatSts,0);
                sysSetVariableInt(sysvar::RoadMap::SBR1RowPsngrSeatPPDFailSts,3);
                sysSetVariableInt(sysvar::RoadMap::SBR1RowPsngrSeatBuckleFailSts,3);  
                
}

export testfunction SBR1RowPSGNRWarning_Not_Active34()
{
  testModuleTitle("SBR1RowPSGNRWarning_Not_Active34");
  //write("SBR1RowPSGNRWarning_Not_Active34");
  
                sysSetVariableInt(sysvar::RoadMap::SBR1RowPsngrSeatConfigSts,0);
                sysSetVariableInt(sysvar::RoadMap::SBR1RowPsngrSeatSts,1);
                sysSetVariableInt(sysvar::RoadMap::SBR1RowPsngrSeatPPDFailSts,3);
                sysSetVariableInt(sysvar::RoadMap::SBR1RowPsngrSeatBuckleFailSts,3);  
                
}

export testfunction SBR1RowPSGNRWarning_Not_Active35()
{
  testModuleTitle("SBR1RowPSGNRWarning_Not_Active35");
  //write("SBR1RowPSGNRWarning_Not_Active35");
  
                sysSetVariableInt(sysvar::RoadMap::SBR1RowPsngrSeatConfigSts,0);
                sysSetVariableInt(sysvar::RoadMap::SBR1RowPsngrSeatSts,2);
                sysSetVariableInt(sysvar::RoadMap::SBR1RowPsngrSeatPPDFailSts,3);
                sysSetVariableInt(sysvar::RoadMap::SBR1RowPsngrSeatBuckleFailSts,3);  
                
}

export testfunction SBR1RowPSGNRWarning_Not_Active36()
{
  testModuleTitle("SBR1RowPSGNRWarning_Not_Active36");
  //write("SBR1RowPSGNRWarning_Not_Active36");
  
                sysSetVariableInt(sysvar::RoadMap::SBR1RowPsngrSeatConfigSts,0);
                sysSetVariableInt(sysvar::RoadMap::SBR1RowPsngrSeatSts,2);
                sysSetVariableInt(sysvar::RoadMap::SBR1RowPsngrSeatPPDFailSts,3);
                sysSetVariableInt(sysvar::RoadMap::SBR1RowPsngrSeatBuckleFailSts,3);  
                
}

export testfunction SBR1RowPSGNRWarning_Not_Active37()
{
  testModuleTitle("SBR1RowPSGNRWarning_Not_Active37");
  //write("SBR1RowPSGNRWarning_Not_Active37");
  
                sysSetVariableInt(sysvar::RoadMap::SBR1RowPsngrSeatConfigSts,0);
                sysSetVariableInt(sysvar::RoadMap::SBR1RowPsngrSeatSts,7);
                sysSetVariableInt(sysvar::RoadMap::SBR1RowPsngrSeatPPDFailSts,3);
                sysSetVariableInt(sysvar::RoadMap::SBR1RowPsngrSeatBuckleFailSts,3);  
                
}

export testfunction SBR1RowPSGNRWarning_Not_Active38()
{
  testModuleTitle("SBR1RowPSGNRWarning_Not_Active38");
  //write("SBR1RowPSGNRWarning_Not_Active38");
  
                sysSetVariableInt(sysvar::RoadMap::SBR1RowPsngrSeatConfigSts,0);
                sysSetVariableInt(sysvar::RoadMap::SBR1RowPsngrSeatSts,0);
                sysSetVariableInt(sysvar::RoadMap::SBR1RowPsngrSeatPPDFailSts,0);
                sysSetVariableInt(sysvar::RoadMap::SBR1RowPsngrSeatBuckleFailSts,3);  
                
}

export testfunction SBR1RowPSGNRWarning_Not_Active39()
{
  testModuleTitle("SBR1RowPSGNRWarning_Not_Active39");
  //write("SBR1RowPSGNRWarning_Not_Active39");
  
                sysSetVariableInt(sysvar::RoadMap::SBR1RowPsngrSeatConfigSts,0);
                sysSetVariableInt(sysvar::RoadMap::SBR1RowPsngrSeatSts,1);
                sysSetVariableInt(sysvar::RoadMap::SBR1RowPsngrSeatPPDFailSts,0);
                sysSetVariableInt(sysvar::RoadMap::SBR1RowPsngrSeatBuckleFailSts,3);  
                
}

export testfunction SBR1RowPSGNRWarning_Not_Active40()
{
  testModuleTitle("SBR1RowPSGNRWarning_Not_Active40");
  //write("SBR1RowPSGNRWarning_Not_Active40");
  
                sysSetVariableInt(sysvar::RoadMap::SBR1RowPsngrSeatConfigSts,0);
                sysSetVariableInt(sysvar::RoadMap::SBR1RowPsngrSeatSts,2);
                sysSetVariableInt(sysvar::RoadMap::SBR1RowPsngrSeatPPDFailSts,0);
                sysSetVariableInt(sysvar::RoadMap::SBR1RowPsngrSeatBuckleFailSts,3);  
                
}

export testfunction SBR1RowPSGNRWarning_Not_Active41()
{
  testModuleTitle("SBR1RowPSGNRWarning_Not_Active41");
  //write("SBR1RowPSGNRWarning_Not_Active41");
  
                sysSetVariableInt(sysvar::RoadMap::SBR1RowPsngrSeatConfigSts,0);
                sysSetVariableInt(sysvar::RoadMap::SBR1RowPsngrSeatSts,3);
                sysSetVariableInt(sysvar::RoadMap::SBR1RowPsngrSeatPPDFailSts,0);
                sysSetVariableInt(sysvar::RoadMap::SBR1RowPsngrSeatBuckleFailSts,3);  
                
}

export testfunction SBR1RowPSGNRWarning_Not_Active42()
{
  testModuleTitle("SBR1RowPSGNRWarning_Not_Active42");
  //write("SBR1RowPSGNRWarning_Not_Active42");
  
                sysSetVariableInt(sysvar::RoadMap::SBR1RowPsngrSeatConfigSts,0);
                sysSetVariableInt(sysvar::RoadMap::SBR1RowPsngrSeatSts,7);
                sysSetVariableInt(sysvar::RoadMap::SBR1RowPsngrSeatPPDFailSts,0);
                sysSetVariableInt(sysvar::RoadMap::SBR1RowPsngrSeatBuckleFailSts,3);  
                
}

export testfunction SBR1RowPSGNRWarning_Not_Active43()
{
  testModuleTitle("SBR1RowPSGNRWarning_Not_Active43");
  //write("SBR1RowPSGNRWarning_Not_Active43");
  
                sysSetVariableInt(sysvar::RoadMap::SBR1RowPsngrSeatConfigSts,0);
                sysSetVariableInt(sysvar::RoadMap::SBR1RowPsngrSeatSts,0);
                sysSetVariableInt(sysvar::RoadMap::SBR1RowPsngrSeatPPDFailSts,1);
                sysSetVariableInt(sysvar::RoadMap::SBR1RowPsngrSeatBuckleFailSts,3);  
                
}

export testfunction SBR1RowPSGNRWarning_Not_Active44()
{
  testModuleTitle("SBR1RowPSGNRWarning_Not_Active44");
  //write("SBR1RowPSGNRWarning_Not_Active44");
  
                sysSetVariableInt(sysvar::RoadMap::SBR1RowPsngrSeatConfigSts,0);
                sysSetVariableInt(sysvar::RoadMap::SBR1RowPsngrSeatSts,1);
                sysSetVariableInt(sysvar::RoadMap::SBR1RowPsngrSeatPPDFailSts,1);
                sysSetVariableInt(sysvar::RoadMap::SBR1RowPsngrSeatBuckleFailSts,3);  
                
}

export testfunction SBR1RowPSGNRWarning_Not_Active45()
{
  testModuleTitle("SBR1RowPSGNRWarning_Not_Active45");
  //write("SBR1RowPSGNRWarning_Not_Active45");
  
                sysSetVariableInt(sysvar::RoadMap::SBR1RowPsngrSeatConfigSts,0);
                sysSetVariableInt(sysvar::RoadMap::SBR1RowPsngrSeatSts,2);
                sysSetVariableInt(sysvar::RoadMap::SBR1RowPsngrSeatPPDFailSts,1);
                sysSetVariableInt(sysvar::RoadMap::SBR1RowPsngrSeatBuckleFailSts,3);  
                
}

export testfunction SBR1RowPSGNRWarning_Not_Active46()
{
  testModuleTitle("SBR1RowPSGNRWarning_Not_Active46");
  //write("SBR1RowPSGNRWarning_Not_Active46");
  
                sysSetVariableInt(sysvar::RoadMap::SBR1RowPsngrSeatConfigSts,0);
                sysSetVariableInt(sysvar::RoadMap::SBR1RowPsngrSeatSts,3);
                sysSetVariableInt(sysvar::RoadMap::SBR1RowPsngrSeatPPDFailSts,1);
                sysSetVariableInt(sysvar::RoadMap::SBR1RowPsngrSeatBuckleFailSts,3);  
                
}

export testfunction SBR1RowPSGNRWarning_Not_Active47()
{
  testModuleTitle("SBR1RowPSGNRWarning_Not_Active47");
  //write("SBR1RowPSGNRWarning_Not_Active47");
  
                sysSetVariableInt(sysvar::RoadMap::SBR1RowPsngrSeatConfigSts,0);
                sysSetVariableInt(sysvar::RoadMap::SBR1RowPsngrSeatSts,7);
                sysSetVariableInt(sysvar::RoadMap::SBR1RowPsngrSeatPPDFailSts,1);
                sysSetVariableInt(sysvar::RoadMap::SBR1RowPsngrSeatBuckleFailSts,3);  
                
}

export testfunction SBR1RowPSGNRWarning_Not_Active48()
{
  testModuleTitle("SBR1RowPSGNRWarning_Not_Active48");
  //write("SBR1RowPSGNRWarning_Not_Active48");
  
                sysSetVariableInt(sysvar::RoadMap::SBR1RowPsngrSeatConfigSts,0);
                sysSetVariableInt(sysvar::RoadMap::SBR1RowPsngrSeatSts,0);
                sysSetVariableInt(sysvar::RoadMap::SBR1RowPsngrSeatPPDFailSts,3);
                sysSetVariableInt(sysvar::RoadMap::SBR1RowPsngrSeatBuckleFailSts,0);  
                
}

export testfunction SBR1RowPSGNRWarning_Not_Active49()
{
  testModuleTitle("SBR1RowPSGNRWarning_Not_Active49");
  //write("SBR1RowPSGNRWarning_Not_Active49");
  
                sysSetVariableInt(sysvar::RoadMap::SBR1RowPsngrSeatConfigSts,0);
                sysSetVariableInt(sysvar::RoadMap::SBR1RowPsngrSeatSts,1);
                sysSetVariableInt(sysvar::RoadMap::SBR1RowPsngrSeatPPDFailSts,3);
                sysSetVariableInt(sysvar::RoadMap::SBR1RowPsngrSeatBuckleFailSts,0);  
                
}

export testfunction SBR1RowPSGNRWarning_Not_Active50()
{
  testModuleTitle("SBR1RowPSGNRWarning_Not_Active50");
  //write("SBR1RowPSGNRWarning_Not_Active50");
  
                sysSetVariableInt(sysvar::RoadMap::SBR1RowPsngrSeatConfigSts,0);
                sysSetVariableInt(sysvar::RoadMap::SBR1RowPsngrSeatSts,2);
                sysSetVariableInt(sysvar::RoadMap::SBR1RowPsngrSeatPPDFailSts,3);
                sysSetVariableInt(sysvar::RoadMap::SBR1RowPsngrSeatBuckleFailSts,0);  
                
}

export testfunction SBR1RowPSGNRWarning_Not_Active51()
{
  testModuleTitle("SBR1RowPSGNRWarning_Not_Active51");
  //write("SBR1RowPSGNRWarning_Not_Active51");
  
                sysSetVariableInt(sysvar::RoadMap::SBR1RowPsngrSeatConfigSts,0);
                sysSetVariableInt(sysvar::RoadMap::SBR1RowPsngrSeatSts,3);
                sysSetVariableInt(sysvar::RoadMap::SBR1RowPsngrSeatPPDFailSts,3);
                sysSetVariableInt(sysvar::RoadMap::SBR1RowPsngrSeatBuckleFailSts,0);  
                
}

export testfunction SBR1RowPSGNRWarning_Not_Active52()
{
  testModuleTitle("SBR1RowPSGNRWarning_Not_Active52");
  //write("SBR1RowPSGNRWarning_Not_Active52");
  
                sysSetVariableInt(sysvar::RoadMap::SBR1RowPsngrSeatConfigSts,0);
                sysSetVariableInt(sysvar::RoadMap::SBR1RowPsngrSeatSts,7);
                sysSetVariableInt(sysvar::RoadMap::SBR1RowPsngrSeatPPDFailSts,3);
                sysSetVariableInt(sysvar::RoadMap::SBR1RowPsngrSeatBuckleFailSts,0);  
                
}

export testfunction SBR1RowPSGNRWarning_Not_Active53()
{
  testModuleTitle("SBR1RowPSGNRWarning_Not_Active53");
  //write("SBR1RowPSGNRWarning_Not_Active53");
  
                sysSetVariableInt(sysvar::RoadMap::SBR1RowPsngrSeatConfigSts,0);
                sysSetVariableInt(sysvar::RoadMap::SBR1RowPsngrSeatSts,0);
                sysSetVariableInt(sysvar::RoadMap::SBR1RowPsngrSeatPPDFailSts,3);
                sysSetVariableInt(sysvar::RoadMap::SBR1RowPsngrSeatBuckleFailSts,1);  
                
}

export testfunction SBR1RowPSGNRWarning_Not_Active54()
{
  testModuleTitle("SBR1RowPSGNRWarning_Not_Active54");
  //write("SBR1RowPSGNRWarning_Not_Active54");
  
                sysSetVariableInt(sysvar::RoadMap::SBR1RowPsngrSeatConfigSts,0);
                sysSetVariableInt(sysvar::RoadMap::SBR1RowPsngrSeatSts,1);
                sysSetVariableInt(sysvar::RoadMap::SBR1RowPsngrSeatPPDFailSts,3);
                sysSetVariableInt(sysvar::RoadMap::SBR1RowPsngrSeatBuckleFailSts,1);  
                
}

export testfunction SBR1RowPSGNRWarning_Not_Active55()
{
  testModuleTitle("SBR1RowPSGNRWarning_Not_Active55");
  //write("SBR1RowPSGNRWarning_Not_Active55");
  
                sysSetVariableInt(sysvar::RoadMap::SBR1RowPsngrSeatConfigSts,0);
                sysSetVariableInt(sysvar::RoadMap::SBR1RowPsngrSeatSts,2);
                sysSetVariableInt(sysvar::RoadMap::SBR1RowPsngrSeatPPDFailSts,3);
                sysSetVariableInt(sysvar::RoadMap::SBR1RowPsngrSeatBuckleFailSts,1);  
                
}

export testfunction SBR1RowPSGNRWarning_Not_Active56()
{
  testModuleTitle("SBR1RowPSGNRWarning_Not_Active56");
  //write("SBR1RowPSGNRWarning_Not_Active56");
  
                sysSetVariableInt(sysvar::RoadMap::SBR1RowPsngrSeatConfigSts,0);
                sysSetVariableInt(sysvar::RoadMap::SBR1RowPsngrSeatSts,3);
                sysSetVariableInt(sysvar::RoadMap::SBR1RowPsngrSeatPPDFailSts,3);
                sysSetVariableInt(sysvar::RoadMap::SBR1RowPsngrSeatBuckleFailSts,1);  
                
}

export testfunction SBR1RowPSGNRWarning_Not_Active57()
{
  testModuleTitle("SBR1RowPSGNRWarning_Not_Active57");
  //write("SBR1RowPSGNRWarning_Not_Active57");
  
                sysSetVariableInt(sysvar::RoadMap::SBR1RowPsngrSeatConfigSts,0);
                sysSetVariableInt(sysvar::RoadMap::SBR1RowPsngrSeatSts,7);
                sysSetVariableInt(sysvar::RoadMap::SBR1RowPsngrSeatPPDFailSts,3);
                sysSetVariableInt(sysvar::RoadMap::SBR1RowPsngrSeatBuckleFailSts,1);  
                
}

export testfunction SBR1RowPSGNRWarning_Not_Active58()
{
  testModuleTitle("SBR1RowPSGNRWarning_Not_Active58");
  //write("SBR1RowPSGNRWarning_Not_Active58");
  
                sysSetVariableInt(sysvar::RoadMap::SBR1RowPsngrSeatConfigSts,1);
                sysSetVariableInt(sysvar::RoadMap::SBR1RowPsngrSeatSts,0);
                sysSetVariableInt(sysvar::RoadMap::SBR1RowPsngrSeatPPDFailSts,1);
                sysSetVariableInt(sysvar::RoadMap::SBR1RowPsngrSeatBuckleFailSts,0);  
                
}

export testfunction SBR1RowPSGNRWarning_Not_Active59()
{
  testModuleTitle("SBR1RowPSGNRWarning_Not_Active59");
  //write("SBR1RowPSGNRWarning_Not_Active59");
  
                sysSetVariableInt(sysvar::RoadMap::SBR1RowPsngrSeatConfigSts,1);
                sysSetVariableInt(sysvar::RoadMap::SBR1RowPsngrSeatSts,1);
                sysSetVariableInt(sysvar::RoadMap::SBR1RowPsngrSeatPPDFailSts,1);
                sysSetVariableInt(sysvar::RoadMap::SBR1RowPsngrSeatBuckleFailSts,0);  
                
}

export testfunction SBR1RowPSGNRWarning_Not_Active60()
{
  testModuleTitle("SBR1RowPSGNRWarning_Not_Active60");
  //write("SBR1RowPSGNRWarning_Not_Active60");
  
                sysSetVariableInt(sysvar::RoadMap::SBR1RowPsngrSeatConfigSts,1);
                sysSetVariableInt(sysvar::RoadMap::SBR1RowPsngrSeatSts,2);
                sysSetVariableInt(sysvar::RoadMap::SBR1RowPsngrSeatPPDFailSts,1);
                sysSetVariableInt(sysvar::RoadMap::SBR1RowPsngrSeatBuckleFailSts,0);  
                
}

export testfunction SBR1RowPSGNRWarning_Not_Active61()
{
  testModuleTitle("SBR1RowPSGNRWarning_Not_Active61");
  //write("SBR1RowPSGNRWarning_Not_Active61");
  
                sysSetVariableInt(sysvar::RoadMap::SBR1RowPsngrSeatConfigSts,1);
                sysSetVariableInt(sysvar::RoadMap::SBR1RowPsngrSeatSts,3);
                sysSetVariableInt(sysvar::RoadMap::SBR1RowPsngrSeatPPDFailSts,1);
                sysSetVariableInt(sysvar::RoadMap::SBR1RowPsngrSeatBuckleFailSts,0);  
                
}

export testfunction SBR1RowPSGNRWarning_Not_Active62()
{
  testModuleTitle("SBR1RowPSGNRWarning_Not_Active62");
  //write("SBR1RowPSGNRWarning_Not_Active62");
  
                sysSetVariableInt(sysvar::RoadMap::SBR1RowPsngrSeatConfigSts,1);
                sysSetVariableInt(sysvar::RoadMap::SBR1RowPsngrSeatSts,7);
                sysSetVariableInt(sysvar::RoadMap::SBR1RowPsngrSeatPPDFailSts,1);
                sysSetVariableInt(sysvar::RoadMap::SBR1RowPsngrSeatBuckleFailSts,0);  
                
}

export testfunction SBR1RowPSGNRWarning_Not_Active63()
{
  testModuleTitle("SBR1RowPSGNRWarning_Not_Active63");
  //write("SBR1RowPSGNRWarning_Not_Active63");
  
                sysSetVariableInt(sysvar::RoadMap::SBR1RowPsngrSeatConfigSts,1);
                sysSetVariableInt(sysvar::RoadMap::SBR1RowPsngrSeatSts,0);
                sysSetVariableInt(sysvar::RoadMap::SBR1RowPsngrSeatPPDFailSts,1);
                sysSetVariableInt(sysvar::RoadMap::SBR1RowPsngrSeatBuckleFailSts,1);  
                
}

export testfunction SBR1RowPSGNRWarning_Not_Active64()
{
  testModuleTitle("SBR1RowPSGNRWarning_Not_Active64");
  //write("SBR1RowPSGNRWarning_Not_Active64");
  
                sysSetVariableInt(sysvar::RoadMap::SBR1RowPsngrSeatConfigSts,1);
                sysSetVariableInt(sysvar::RoadMap::SBR1RowPsngrSeatSts,1);
                sysSetVariableInt(sysvar::RoadMap::SBR1RowPsngrSeatPPDFailSts,1);
                sysSetVariableInt(sysvar::RoadMap::SBR1RowPsngrSeatBuckleFailSts,1);  
                
}

export testfunction SBR1RowPSGNRWarning_Not_Active65()
{
  testModuleTitle("SBR1RowPSGNRWarning_Not_Active65");
  //write("SBR1RowPSGNRWarning_Not_Active65");
  
                sysSetVariableInt(sysvar::RoadMap::SBR1RowPsngrSeatConfigSts,1);
                sysSetVariableInt(sysvar::RoadMap::SBR1RowPsngrSeatSts,2);
                sysSetVariableInt(sysvar::RoadMap::SBR1RowPsngrSeatPPDFailSts,1);
                sysSetVariableInt(sysvar::RoadMap::SBR1RowPsngrSeatBuckleFailSts,1);  
                
}

export testfunction SBR1RowPSGNRWarning_Not_Active66()
{
  testModuleTitle("SBR1RowPSGNRWarning_Not_Active66");
  //write("SBR1RowPSGNRWarning_Not_Active66");
  
                sysSetVariableInt(sysvar::RoadMap::SBR1RowPsngrSeatConfigSts,1);
                sysSetVariableInt(sysvar::RoadMap::SBR1RowPsngrSeatSts,3);
                sysSetVariableInt(sysvar::RoadMap::SBR1RowPsngrSeatPPDFailSts,1);
                sysSetVariableInt(sysvar::RoadMap::SBR1RowPsngrSeatBuckleFailSts,1);  
                
}

export testfunction SBR1RowPSGNRWarning_Not_Active67()
{
  testModuleTitle("SBR1RowPSGNRWarning_Not_Active67");
  //write("SBR1RowPSGNRWarning_Not_Active67");
  
                sysSetVariableInt(sysvar::RoadMap::SBR1RowPsngrSeatConfigSts,1);
                sysSetVariableInt(sysvar::RoadMap::SBR1RowPsngrSeatSts,7);
                sysSetVariableInt(sysvar::RoadMap::SBR1RowPsngrSeatPPDFailSts,1);
                sysSetVariableInt(sysvar::RoadMap::SBR1RowPsngrSeatBuckleFailSts,1);  
                
}

export testfunction SBR1RowPSGNRWarning_Not_Active68()
{
  testModuleTitle("SBR1RowPSGNRWarning_Not_Active68");
  //write("SBR1RowPSGNRWarning_Not_Active68");
  
                sysSetVariableInt(sysvar::RoadMap::SBR1RowPsngrSeatConfigSts,1);
                sysSetVariableInt(sysvar::RoadMap::SBR1RowPsngrSeatSts,0);
                sysSetVariableInt(sysvar::RoadMap::SBR1RowPsngrSeatPPDFailSts,1);
                sysSetVariableInt(sysvar::RoadMap::SBR1RowPsngrSeatBuckleFailSts,3);  
                
}

export testfunction SBR1RowPSGNRWarning_Not_Active69()
{
  testModuleTitle("SBR1RowPSGNRWarning_Not_Active69");
  //write("SBR1RowPSGNRWarning_Not_Active69");
  
                sysSetVariableInt(sysvar::RoadMap::SBR1RowPsngrSeatConfigSts,1);
                sysSetVariableInt(sysvar::RoadMap::SBR1RowPsngrSeatSts,1);
                sysSetVariableInt(sysvar::RoadMap::SBR1RowPsngrSeatPPDFailSts,1);
                sysSetVariableInt(sysvar::RoadMap::SBR1RowPsngrSeatBuckleFailSts,3);  
                
}

export testfunction SBR1RowPSGNRWarning_Not_Active70()
{
  testModuleTitle("SBR1RowPSGNRWarning_Not_Active70");
  //write("SBR1RowPSGNRWarning_Not_Active70");
  
                sysSetVariableInt(sysvar::RoadMap::SBR1RowPsngrSeatConfigSts,1);
                sysSetVariableInt(sysvar::RoadMap::SBR1RowPsngrSeatSts,2);
                sysSetVariableInt(sysvar::RoadMap::SBR1RowPsngrSeatPPDFailSts,1);
                sysSetVariableInt(sysvar::RoadMap::SBR1RowPsngrSeatBuckleFailSts,3);  
                
}

export testfunction SBR1RowPSGNRWarning_Not_Active71()
{
  testModuleTitle("SBR1RowPSGNRWarning_Not_Active71");
  //write("SBR1RowPSGNRWarning_Not_Active71");
  
                sysSetVariableInt(sysvar::RoadMap::SBR1RowPsngrSeatConfigSts,1);
                sysSetVariableInt(sysvar::RoadMap::SBR1RowPsngrSeatSts,3);
                sysSetVariableInt(sysvar::RoadMap::SBR1RowPsngrSeatPPDFailSts,1);
                sysSetVariableInt(sysvar::RoadMap::SBR1RowPsngrSeatBuckleFailSts,3);  
                
}

export testfunction SBR1RowPSGNRWarning_Not_Active72()
{
  testModuleTitle("SBR1RowPSGNRWarning_Not_Active72");
  //write("SBR1RowPSGNRWarning_Not_Active72");
  
                sysSetVariableInt(sysvar::RoadMap::SBR1RowPsngrSeatConfigSts,1);
                sysSetVariableInt(sysvar::RoadMap::SBR1RowPsngrSeatSts,7);
                sysSetVariableInt(sysvar::RoadMap::SBR1RowPsngrSeatPPDFailSts,1);
                sysSetVariableInt(sysvar::RoadMap::SBR1RowPsngrSeatBuckleFailSts,3);  
                
}

//CENTRAL - CNTRL
export testfunction SBR1RowCNTRLWarning_Active1()
{
  testModuleTitle("SBR1RowCNTRLWarning_Active1");
  //write("SBR1RowCNTRLWarning_Active1");
  
                sysSetVariableInt(sysvar::RoadMap::SBR1RowCentralSeatConfigSts,1);
                sysSetVariableInt(sysvar::RoadMap::SBR1RowCentralSeatSts,3);
                sysSetVariableInt(sysvar::RoadMap::SBR1RowCentralSeatPPDFailSts,0);
                sysSetVariableInt(sysvar::RoadMap::SBR1RowCentralSeatBuckleFailSts,0);  
                
}

export testfunction SBR1RowCNTRLWarning_Active2()
{
  testModuleTitle("SBR1RowCNTRLWarning_Active2");
  //write("SBR1RowCNTRLWarning_Active2");
  
                sysSetVariableInt(sysvar::RoadMap::SBR1RowCentralSeatConfigSts,1);
                sysSetVariableInt(sysvar::RoadMap::SBR1RowCentralSeatSts,3);
                sysSetVariableInt(sysvar::RoadMap::SBR1RowCentralSeatPPDFailSts,3);
                sysSetVariableInt(sysvar::RoadMap::SBR1RowCentralSeatBuckleFailSts,3);  
                
}

export testfunction SBR1RowCNTRLWarning_Active3()
{
  testModuleTitle("SBR1RowCNTRLWarning_Active3");
  //write("SBR1RowCNTRLWarning_Active3");
  
                sysSetVariableInt(sysvar::RoadMap::SBR1RowCentralSeatConfigSts,1);
                sysSetVariableInt(sysvar::RoadMap::SBR1RowCentralSeatSts,3);
                sysSetVariableInt(sysvar::RoadMap::SBR1RowCentralSeatPPDFailSts,0);
                sysSetVariableInt(sysvar::RoadMap::SBR1RowCentralSeatBuckleFailSts,3);  
                
}

export testfunction SBR1RowCNTRLWarning_Active4()
{
  testModuleTitle("SBR1RowCNTRLWarning_Active4");
  //write("SBR1RowCNTRLWarning_Active4");
  
                sysSetVariableInt(sysvar::RoadMap::SBR1RowCentralSeatConfigSts,1);
                sysSetVariableInt(sysvar::RoadMap::SBR1RowCentralSeatSts,3);
                sysSetVariableInt(sysvar::RoadMap::SBR1RowCentralSeatPPDFailSts,3);
                sysSetVariableInt(sysvar::RoadMap::SBR1RowCentralSeatBuckleFailSts,0);  
                
}

export testfunction SBR1RowCNTRLWarning_Active5()
{
  testModuleTitle("SBR1RowCNTRLWarning_Active5");
  //write("SBR1RowCNTRLWarning_Active5");
  
                sysSetVariableInt(sysvar::RoadMap::SBR1RowCentralSeatConfigSts,1);
                sysSetVariableInt(sysvar::RoadMap::SBR1RowCentralSeatSts,0);
                sysSetVariableInt(sysvar::RoadMap::SBR1RowCentralSeatPPDFailSts,0);
                sysSetVariableInt(sysvar::RoadMap::SBR1RowCentralSeatBuckleFailSts,1);  
                
}

export testfunction SBR1RowCNTRLWarning_Active6()
{
  testModuleTitle("SBR1RowCNTRLWarning_Active6");
  //write("SBR1RowCNTRLWarning_Active6");
  
                sysSetVariableInt(sysvar::RoadMap::SBR1RowCentralSeatConfigSts,1);
                sysSetVariableInt(sysvar::RoadMap::SBR1RowCentralSeatSts,1);
                sysSetVariableInt(sysvar::RoadMap::SBR1RowCentralSeatPPDFailSts,0);
                sysSetVariableInt(sysvar::RoadMap::SBR1RowCentralSeatBuckleFailSts,1);  
                
}

export testfunction SBR1RowCNTRLWarning_Active7()
{
  testModuleTitle("SBR1RowCNTRLWarning_Active7");
  //write("SBR1RowCNTRLWarning_Active7");
  
                sysSetVariableInt(sysvar::RoadMap::SBR1RowCentralSeatConfigSts,1);
                sysSetVariableInt(sysvar::RoadMap::SBR1RowCentralSeatSts,2);
                sysSetVariableInt(sysvar::RoadMap::SBR1RowCentralSeatPPDFailSts,0);
                sysSetVariableInt(sysvar::RoadMap::SBR1RowCentralSeatBuckleFailSts,1);  
                
}

export testfunction SBR1RowCNTRLWarning_Active8()
{
  testModuleTitle("SBR1RowCNTRLWarning_Active8");
  //write("SBR1RowCNTRLWarning_Active8");
  
                sysSetVariableInt(sysvar::RoadMap::SBR1RowCentralSeatConfigSts,1);
                sysSetVariableInt(sysvar::RoadMap::SBR1RowCentralSeatSts,3);
                sysSetVariableInt(sysvar::RoadMap::SBR1RowCentralSeatPPDFailSts,0);
                sysSetVariableInt(sysvar::RoadMap::SBR1RowCentralSeatBuckleFailSts,1);  
                
}

export testfunction SBR1RowCNTRLWarning_Active9()
{
  testModuleTitle("SBR1RowCNTRLWarning_Active9");
  //write("SBR1RowCNTRLWarning_Active9");
  
                sysSetVariableInt(sysvar::RoadMap::SBR1RowCentralSeatConfigSts,1);
                sysSetVariableInt(sysvar::RoadMap::SBR1RowCentralSeatSts,7);
                sysSetVariableInt(sysvar::RoadMap::SBR1RowCentralSeatPPDFailSts,0);
                sysSetVariableInt(sysvar::RoadMap::SBR1RowCentralSeatBuckleFailSts,1);  
                
}

export testfunction SBR1RowCNTRLWarning_Active10()
{
  testModuleTitle("SBR1RowCNTRLWarning_Active10");
  //write("SBR1RowCNTRLWarning_Active10");
  
                sysSetVariableInt(sysvar::RoadMap::SBR1RowCentralSeatConfigSts,1);
                sysSetVariableInt(sysvar::RoadMap::SBR1RowCentralSeatSts,0);
                sysSetVariableInt(sysvar::RoadMap::SBR1RowCentralSeatPPDFailSts,3);
                sysSetVariableInt(sysvar::RoadMap::SBR1RowCentralSeatBuckleFailSts,1);  
                
}

export testfunction SBR1RowCNTRLWarning_Active11()
{
  testModuleTitle("SBR1RowCNTRLWarning_Active11");
  //write("SBR1RowCNTRLWarning_Active11");
  
                sysSetVariableInt(sysvar::RoadMap::SBR1RowCentralSeatConfigSts,1);
                sysSetVariableInt(sysvar::RoadMap::SBR1RowCentralSeatSts,1);
                sysSetVariableInt(sysvar::RoadMap::SBR1RowCentralSeatPPDFailSts,3);
                sysSetVariableInt(sysvar::RoadMap::SBR1RowCentralSeatBuckleFailSts,1);  
                
}

export testfunction SBR1RowCNTRLWarning_Active12()
{
  testModuleTitle("SBR1RowCNTRLWarning_Active12");
  //write("SBR1RowCNTRLWarning_Active12");
  
                sysSetVariableInt(sysvar::RoadMap::SBR1RowCentralSeatConfigSts,1);
                sysSetVariableInt(sysvar::RoadMap::SBR1RowCentralSeatSts,2);
                sysSetVariableInt(sysvar::RoadMap::SBR1RowCentralSeatPPDFailSts,3);
                sysSetVariableInt(sysvar::RoadMap::SBR1RowCentralSeatBuckleFailSts,1);  
                
}

export testfunction SBR1RowCNTRLWarning_Active13()
{
  testModuleTitle("SBR1RowCNTRLWarning_Active13");
  //write("SBR1RowCNTRLWarning_Active13");
  
                sysSetVariableInt(sysvar::RoadMap::SBR1RowCentralSeatConfigSts,1);
                sysSetVariableInt(sysvar::RoadMap::SBR1RowCentralSeatSts,3);
                sysSetVariableInt(sysvar::RoadMap::SBR1RowCentralSeatPPDFailSts,3);
                sysSetVariableInt(sysvar::RoadMap::SBR1RowCentralSeatBuckleFailSts,1);  
                
}

export testfunction SBR1RowCNTRLWarning_Active14()
{
  testModuleTitle("SBR1RowCNTRLWarning_Active14");
  //write("SBR1RowCNTRLWarning_Active14");
  
                sysSetVariableInt(sysvar::RoadMap::SBR1RowCentralSeatConfigSts,1);
                sysSetVariableInt(sysvar::RoadMap::SBR1RowCentralSeatSts,7);
                sysSetVariableInt(sysvar::RoadMap::SBR1RowCentralSeatPPDFailSts,3);
                sysSetVariableInt(sysvar::RoadMap::SBR1RowCentralSeatBuckleFailSts,1);  
                
}
export testfunction SBR1RowCNTRLWarning_Not_Active15()
{
  testModuleTitle("SBR1RowCNTRLWarning_Not_Active15");
  //write("SBR1RowCNTRLWarning_Not_Active15");
  
                sysSetVariableInt(sysvar::RoadMap::SBR1RowCentralSeatConfigSts,1);
                sysSetVariableInt(sysvar::RoadMap::SBR1RowCentralSeatSts,2);
                sysSetVariableInt(sysvar::RoadMap::SBR1RowCentralSeatPPDFailSts,0);
                sysSetVariableInt(sysvar::RoadMap::SBR1RowCentralSeatBuckleFailSts,0);  
                
}

export testfunction SBR1RowCNTRLWarning_Not_Active16()
{
  testModuleTitle("SBR1RowCNTRLWarning_Not_Active16");
  //write("SBR1RowCNTRLWarning_Not_Active16");
  
                sysSetVariableInt(sysvar::RoadMap::SBR1RowCentralSeatConfigSts,1);
                sysSetVariableInt(sysvar::RoadMap::SBR1RowCentralSeatSts,2);
                sysSetVariableInt(sysvar::RoadMap::SBR1RowCentralSeatPPDFailSts,3);
                sysSetVariableInt(sysvar::RoadMap::SBR1RowCentralSeatBuckleFailSts,3);  
                
}

export testfunction SBR1RowCNTRLWarning_Not_Active17()
{
  testModuleTitle("SBR1RowCNTRLWarning_Not_Active17");
  //write("SBR1RowCNTRLWarning_Not_Active17");
  
                sysSetVariableInt(sysvar::RoadMap::SBR1RowCentralSeatConfigSts,1);
                sysSetVariableInt(sysvar::RoadMap::SBR1RowCentralSeatSts,2);
                sysSetVariableInt(sysvar::RoadMap::SBR1RowCentralSeatPPDFailSts,0);
                sysSetVariableInt(sysvar::RoadMap::SBR1RowCentralSeatBuckleFailSts,3);  
                
}

export testfunction SBR1RowCNTRLWarning_Not_Active18()
{
  testModuleTitle("SBR1RowCNTRLWarning_Not_Active18");
  //write("SBR1RowCNTRLWarning_Not_Active18");
  
                sysSetVariableInt(sysvar::RoadMap::SBR1RowCentralSeatConfigSts,1);
                sysSetVariableInt(sysvar::RoadMap::SBR1RowCentralSeatSts,2);
                sysSetVariableInt(sysvar::RoadMap::SBR1RowCentralSeatPPDFailSts,3);
                sysSetVariableInt(sysvar::RoadMap::SBR1RowCentralSeatBuckleFailSts,0);  
                
}

export testfunction SBR1RowCNTRLWarning_Not_Active19()
{
  testModuleTitle("SBR1RowCNTRLWarning_Not_Active19");
  //write("SBR1RowCNTRLWarning_Not_Active19");
  
                sysSetVariableInt(sysvar::RoadMap::SBR1RowCentralSeatConfigSts,1);
                sysSetVariableInt(sysvar::RoadMap::SBR1RowCentralSeatSts,7);
                sysSetVariableInt(sysvar::RoadMap::SBR1RowCentralSeatPPDFailSts,0);
                sysSetVariableInt(sysvar::RoadMap::SBR1RowCentralSeatBuckleFailSts,0);  
                
}

export testfunction SBR1RowCNTRLWarning_Not_Active20()
{
  testModuleTitle("SBR1RowCNTRLWarning_Not_Active20");
  //write("SBR1RowCNTRLWarning_Not_Active20");
  
                sysSetVariableInt(sysvar::RoadMap::SBR1RowCentralSeatConfigSts,1);
                sysSetVariableInt(sysvar::RoadMap::SBR1RowCentralSeatSts,7);
                sysSetVariableInt(sysvar::RoadMap::SBR1RowCentralSeatPPDFailSts,3);
                sysSetVariableInt(sysvar::RoadMap::SBR1RowCentralSeatBuckleFailSts,3);  
                
}

export testfunction SBR1RowCNTRLWarning_Not_Active21()
{
  testModuleTitle("SBR1RowCNTRLWarning_Not_Active21");
  //write("SBR1RowCNTRLWarning_Not_Active21");
  
                sysSetVariableInt(sysvar::RoadMap::SBR1RowCentralSeatConfigSts,1);
                sysSetVariableInt(sysvar::RoadMap::SBR1RowCentralSeatSts,7);
                sysSetVariableInt(sysvar::RoadMap::SBR1RowCentralSeatPPDFailSts,0);
                sysSetVariableInt(sysvar::RoadMap::SBR1RowCentralSeatBuckleFailSts,3);  
                
}

export testfunction SBR1RowCNTRLWarning_Not_Active22()
{
  testModuleTitle("SBR1RowCNTRLWarning_Not_Active22");
  //write("SBR1RowCNTRLWarning_Not_Active22");
  
                sysSetVariableInt(sysvar::RoadMap::SBR1RowCentralSeatConfigSts,1);
                sysSetVariableInt(sysvar::RoadMap::SBR1RowCentralSeatSts,7);
                sysSetVariableInt(sysvar::RoadMap::SBR1RowCentralSeatPPDFailSts,3);
                sysSetVariableInt(sysvar::RoadMap::SBR1RowCentralSeatBuckleFailSts,0);  
                
}

export testfunction SBR1RowCNTRLWarning_Not_Active23()
{
  testModuleTitle("SBR1RowCNTRLWarning_Not_Active23");
  //write("SBR1RowCNTRLWarning_Not_Active23");
  
                sysSetVariableInt(sysvar::RoadMap::SBR1RowCentralSeatConfigSts,0);
                sysSetVariableInt(sysvar::RoadMap::SBR1RowCentralSeatSts,0);
                sysSetVariableInt(sysvar::RoadMap::SBR1RowCentralSeatPPDFailSts,0);
                sysSetVariableInt(sysvar::RoadMap::SBR1RowCentralSeatBuckleFailSts,0);  
                
}

export testfunction SBR1RowCNTRLWarning_Not_Active24()
{
  testModuleTitle("SBR1RowCNTRLWarning_Not_Active24");
  //write("SBR1RowCNTRLWarning_Not_Active24");
  
                sysSetVariableInt(sysvar::RoadMap::SBR1RowCentralSeatConfigSts,0);
                sysSetVariableInt(sysvar::RoadMap::SBR1RowCentralSeatSts,1);
                sysSetVariableInt(sysvar::RoadMap::SBR1RowCentralSeatPPDFailSts,0);
                sysSetVariableInt(sysvar::RoadMap::SBR1RowCentralSeatBuckleFailSts,0);  
                
}

export testfunction SBR1RowCNTRLWarning_Not_Active25()
{
  testModuleTitle("SBR1RowCNTRLWarning_Not_Active25");
  //write("SBR1RowCNTRLWarning_Not_Active25");
  
                sysSetVariableInt(sysvar::RoadMap::SBR1RowCentralSeatConfigSts,0);
                sysSetVariableInt(sysvar::RoadMap::SBR1RowCentralSeatSts,2);
                sysSetVariableInt(sysvar::RoadMap::SBR1RowCentralSeatPPDFailSts,0);
                sysSetVariableInt(sysvar::RoadMap::SBR1RowCentralSeatBuckleFailSts,0);  
                
}

export testfunction SBR1RowCNTRLWarning_Not_Active26()
{
  testModuleTitle("SBR1RowCNTRLWarning_Not_Active26");
  //write("SBR1RowCNTRLWarning_Not_Active26");
  
                sysSetVariableInt(sysvar::RoadMap::SBR1RowCentralSeatConfigSts,0);
                sysSetVariableInt(sysvar::RoadMap::SBR1RowCentralSeatSts,3);
                sysSetVariableInt(sysvar::RoadMap::SBR1RowCentralSeatPPDFailSts,0);
                sysSetVariableInt(sysvar::RoadMap::SBR1RowCentralSeatBuckleFailSts,0);  
                
}

export testfunction SBR1RowCNTRLWarning_Not_Active27()
{
  testModuleTitle("SBR1RowCNTRLWarning_Not_Active27");
  //write("SBR1RowCNTRLWarning_Not_Active27");
  
                sysSetVariableInt(sysvar::RoadMap::SBR1RowCentralSeatConfigSts,0);
                sysSetVariableInt(sysvar::RoadMap::SBR1RowCentralSeatSts,7);
                sysSetVariableInt(sysvar::RoadMap::SBR1RowCentralSeatPPDFailSts,0);
                sysSetVariableInt(sysvar::RoadMap::SBR1RowCentralSeatBuckleFailSts,0);  
                
}

export testfunction SBR1RowCNTRLWarning_Not_Active28()
{
  testModuleTitle("SBR1RowCNTRLWarning_Not_Active28");
  //write("SBR1RowCNTRLWarning_Not_Active28");
  
                sysSetVariableInt(sysvar::RoadMap::SBR1RowCentralSeatConfigSts,0);
                sysSetVariableInt(sysvar::RoadMap::SBR1RowCentralSeatSts,0);
                sysSetVariableInt(sysvar::RoadMap::SBR1RowCentralSeatPPDFailSts,1);
                sysSetVariableInt(sysvar::RoadMap::SBR1RowCentralSeatBuckleFailSts,1);  
                
}

export testfunction SBR1RowCNTRLWarning_Not_Active29()
{
  testModuleTitle("SBR1RowCNTRLWarning_Not_Active29");
  //write("SBR1RowCNTRLWarning_Not_Active29");
  
                sysSetVariableInt(sysvar::RoadMap::SBR1RowCentralSeatConfigSts,0);
                sysSetVariableInt(sysvar::RoadMap::SBR1RowCentralSeatSts,1);
                sysSetVariableInt(sysvar::RoadMap::SBR1RowCentralSeatPPDFailSts,1);
                sysSetVariableInt(sysvar::RoadMap::SBR1RowCentralSeatBuckleFailSts,1);  
                
}

export testfunction SBR1RowCNTRLWarning_Not_Active30()
{
  testModuleTitle("SBR1RowCNTRLWarning_Not_Active30");
  //write("SBR1RowCNTRLWarning_Not_Active30");
  
                sysSetVariableInt(sysvar::RoadMap::SBR1RowCentralSeatConfigSts,0);
                sysSetVariableInt(sysvar::RoadMap::SBR1RowCentralSeatSts,2);
                sysSetVariableInt(sysvar::RoadMap::SBR1RowCentralSeatPPDFailSts,1);
                sysSetVariableInt(sysvar::RoadMap::SBR1RowCentralSeatBuckleFailSts,1);  
                
}

export testfunction SBR1RowCNTRLWarning_Not_Active31()
{
  testModuleTitle("SBR1RowCNTRLWarning_Not_Active31");
  //write("SBR1RowCNTRLWarning_Not_Active31");
  
                sysSetVariableInt(sysvar::RoadMap::SBR1RowCentralSeatConfigSts,0);
                sysSetVariableInt(sysvar::RoadMap::SBR1RowCentralSeatSts,3);
                sysSetVariableInt(sysvar::RoadMap::SBR1RowCentralSeatPPDFailSts,1);
                sysSetVariableInt(sysvar::RoadMap::SBR1RowCentralSeatBuckleFailSts,1);  
                
}

export testfunction SBR1RowCNTRLWarning_Not_Active32()
{
  testModuleTitle("SBR1RowCNTRLWarning_Not_Active32");
  //write("SBR1RowCNTRLWarning_Not_Active32");
  
                sysSetVariableInt(sysvar::RoadMap::SBR1RowCentralSeatConfigSts,0);
                sysSetVariableInt(sysvar::RoadMap::SBR1RowCentralSeatSts,7);
                sysSetVariableInt(sysvar::RoadMap::SBR1RowCentralSeatPPDFailSts,1);
                sysSetVariableInt(sysvar::RoadMap::SBR1RowCentralSeatBuckleFailSts,1);  
                
}

export testfunction SBR1RowCNTRLWarning_Not_Active33()
{
  testModuleTitle("SBR1RowCNTRLWarning_Not_Active33");
  //write("SBR1RowCNTRLWarning_Not_Active33");
  
                sysSetVariableInt(sysvar::RoadMap::SBR1RowCentralSeatConfigSts,0);
                sysSetVariableInt(sysvar::RoadMap::SBR1RowCentralSeatSts,0);
                sysSetVariableInt(sysvar::RoadMap::SBR1RowCentralSeatPPDFailSts,3);
                sysSetVariableInt(sysvar::RoadMap::SBR1RowCentralSeatBuckleFailSts,3);  
                
}

export testfunction SBR1RowCNTRLWarning_Not_Active34()
{
  testModuleTitle("SBR1RowCNTRLWarning_Not_Active34");
  //write("SBR1RowCNTRLWarning_Not_Active34");
  
                sysSetVariableInt(sysvar::RoadMap::SBR1RowCentralSeatConfigSts,0);
                sysSetVariableInt(sysvar::RoadMap::SBR1RowCentralSeatSts,1);
                sysSetVariableInt(sysvar::RoadMap::SBR1RowCentralSeatPPDFailSts,3);
                sysSetVariableInt(sysvar::RoadMap::SBR1RowCentralSeatBuckleFailSts,3);  
                
}

export testfunction SBR1RowCNTRLWarning_Not_Active35()
{
  testModuleTitle("SBR1RowCNTRLWarning_Not_Active35");
  //write("SBR1RowCNTRLWarning_Not_Active35");
  
                sysSetVariableInt(sysvar::RoadMap::SBR1RowCentralSeatConfigSts,0);
                sysSetVariableInt(sysvar::RoadMap::SBR1RowCentralSeatSts,2);
                sysSetVariableInt(sysvar::RoadMap::SBR1RowCentralSeatPPDFailSts,3);
                sysSetVariableInt(sysvar::RoadMap::SBR1RowCentralSeatBuckleFailSts,3);  
                
}

export testfunction SBR1RowCNTRLWarning_Not_Active36()
{
  testModuleTitle("SBR1RowCNTRLWarning_Not_Active36");
  //write("SBR1RowCNTRLWarning_Not_Active36");
  
                sysSetVariableInt(sysvar::RoadMap::SBR1RowCentralSeatConfigSts,0);
                sysSetVariableInt(sysvar::RoadMap::SBR1RowCentralSeatSts,2);
                sysSetVariableInt(sysvar::RoadMap::SBR1RowCentralSeatPPDFailSts,3);
                sysSetVariableInt(sysvar::RoadMap::SBR1RowCentralSeatBuckleFailSts,3);  
                
}

export testfunction SBR1RowCNTRLWarning_Not_Active37()
{
  testModuleTitle("SBR1RowCNTRLWarning_Not_Active37");
  //write("SBR1RowCNTRLWarning_Not_Active37");
  
                sysSetVariableInt(sysvar::RoadMap::SBR1RowCentralSeatConfigSts,0);
                sysSetVariableInt(sysvar::RoadMap::SBR1RowCentralSeatSts,7);
                sysSetVariableInt(sysvar::RoadMap::SBR1RowCentralSeatPPDFailSts,3);
                sysSetVariableInt(sysvar::RoadMap::SBR1RowCentralSeatBuckleFailSts,3);  
                
}

export testfunction SBR1RowCNTRLWarning_Not_Active38()
{
  testModuleTitle("SBR1RowCNTRLWarning_Not_Active38");
  //write("SBR1RowCNTRLWarning_Not_Active38");
  
                sysSetVariableInt(sysvar::RoadMap::SBR1RowCentralSeatConfigSts,0);
                sysSetVariableInt(sysvar::RoadMap::SBR1RowCentralSeatSts,0);
                sysSetVariableInt(sysvar::RoadMap::SBR1RowCentralSeatPPDFailSts,0);
                sysSetVariableInt(sysvar::RoadMap::SBR1RowCentralSeatBuckleFailSts,3);  
                
}

export testfunction SBR1RowCNTRLWarning_Not_Active39()
{
  testModuleTitle("SBR1RowCNTRLWarning_Not_Active39");
  //write("SBR1RowCNTRLWarning_Not_Active39");
  
                sysSetVariableInt(sysvar::RoadMap::SBR1RowCentralSeatConfigSts,0);
                sysSetVariableInt(sysvar::RoadMap::SBR1RowCentralSeatSts,1);
                sysSetVariableInt(sysvar::RoadMap::SBR1RowCentralSeatPPDFailSts,0);
                sysSetVariableInt(sysvar::RoadMap::SBR1RowCentralSeatBuckleFailSts,3);  
                
}

export testfunction SBR1RowCNTRLWarning_Not_Active40()
{
  testModuleTitle("SBR1RowCNTRLWarning_Not_Active40");
  //write("SBR1RowCNTRLWarning_Not_Active40");
  
                sysSetVariableInt(sysvar::RoadMap::SBR1RowCentralSeatConfigSts,0);
                sysSetVariableInt(sysvar::RoadMap::SBR1RowCentralSeatSts,2);
                sysSetVariableInt(sysvar::RoadMap::SBR1RowCentralSeatPPDFailSts,0);
                sysSetVariableInt(sysvar::RoadMap::SBR1RowCentralSeatBuckleFailSts,3);  
                
}

export testfunction SBR1RowCNTRLWarning_Not_Active41()
{
  testModuleTitle("SBR1RowCNTRLWarning_Not_Active41");
  //write("SBR1RowCNTRLWarning_Not_Active41");
  
                sysSetVariableInt(sysvar::RoadMap::SBR1RowCentralSeatConfigSts,0);
                sysSetVariableInt(sysvar::RoadMap::SBR1RowCentralSeatSts,3);
                sysSetVariableInt(sysvar::RoadMap::SBR1RowCentralSeatPPDFailSts,0);
                sysSetVariableInt(sysvar::RoadMap::SBR1RowCentralSeatBuckleFailSts,3);  
                
}

export testfunction SBR1RowCNTRLWarning_Not_Active42()
{
  testModuleTitle("SBR1RowCNTRLWarning_Not_Active42");
  //write("SBR1RowCNTRLWarning_Not_Active42");
  
                sysSetVariableInt(sysvar::RoadMap::SBR1RowCentralSeatConfigSts,0);
                sysSetVariableInt(sysvar::RoadMap::SBR1RowCentralSeatSts,7);
                sysSetVariableInt(sysvar::RoadMap::SBR1RowCentralSeatPPDFailSts,0);
                sysSetVariableInt(sysvar::RoadMap::SBR1RowCentralSeatBuckleFailSts,3);  
                
}

export testfunction SBR1RowCNTRLWarning_Not_Active43()
{
  testModuleTitle("SBR1RowCNTRLWarning_Not_Active43");
  //write("SBR1RowCNTRLWarning_Not_Active43");
  
                sysSetVariableInt(sysvar::RoadMap::SBR1RowCentralSeatConfigSts,0);
                sysSetVariableInt(sysvar::RoadMap::SBR1RowCentralSeatSts,0);
                sysSetVariableInt(sysvar::RoadMap::SBR1RowCentralSeatPPDFailSts,1);
                sysSetVariableInt(sysvar::RoadMap::SBR1RowCentralSeatBuckleFailSts,3);  
                
}

export testfunction SBR1RowCNTRLWarning_Not_Active44()
{
  testModuleTitle("SBR1RowCNTRLWarning_Not_Active44");
  //write("SBR1RowCNTRLWarning_Not_Active44");
  
                sysSetVariableInt(sysvar::RoadMap::SBR1RowCentralSeatConfigSts,0);
                sysSetVariableInt(sysvar::RoadMap::SBR1RowCentralSeatSts,1);
                sysSetVariableInt(sysvar::RoadMap::SBR1RowCentralSeatPPDFailSts,1);
                sysSetVariableInt(sysvar::RoadMap::SBR1RowCentralSeatBuckleFailSts,3);  
                
}

export testfunction SBR1RowCNTRLWarning_Not_Active45()
{
  testModuleTitle("SBR1RowCNTRLWarning_Not_Active45");
  //write("SBR1RowCNTRLWarning_Not_Active45");
  
                sysSetVariableInt(sysvar::RoadMap::SBR1RowCentralSeatConfigSts,0);
                sysSetVariableInt(sysvar::RoadMap::SBR1RowCentralSeatSts,2);
                sysSetVariableInt(sysvar::RoadMap::SBR1RowCentralSeatPPDFailSts,1);
                sysSetVariableInt(sysvar::RoadMap::SBR1RowCentralSeatBuckleFailSts,3);  
                
}

export testfunction SBR1RowCNTRLWarning_Not_Active46()
{
  testModuleTitle("SBR1RowCNTRLWarning_Not_Active46");
  //write("SBR1RowCNTRLWarning_Not_Active46");
  
                sysSetVariableInt(sysvar::RoadMap::SBR1RowCentralSeatConfigSts,0);
                sysSetVariableInt(sysvar::RoadMap::SBR1RowCentralSeatSts,3);
                sysSetVariableInt(sysvar::RoadMap::SBR1RowCentralSeatPPDFailSts,1);
                sysSetVariableInt(sysvar::RoadMap::SBR1RowCentralSeatBuckleFailSts,3);  
                
}

export testfunction SBR1RowCNTRLWarning_Not_Active47()
{
  testModuleTitle("SBR1RowCNTRLWarning_Not_Active47");
  //write("SBR1RowCNTRLWarning_Not_Active47");
  
                sysSetVariableInt(sysvar::RoadMap::SBR1RowCentralSeatConfigSts,0);
                sysSetVariableInt(sysvar::RoadMap::SBR1RowCentralSeatSts,7);
                sysSetVariableInt(sysvar::RoadMap::SBR1RowCentralSeatPPDFailSts,1);
                sysSetVariableInt(sysvar::RoadMap::SBR1RowCentralSeatBuckleFailSts,3);  
                
}

export testfunction SBR1RowCNTRLWarning_Not_Active48()
{
  testModuleTitle("SBR1RowCNTRLWarning_Not_Active48");
  //write("SBR1RowCNTRLWarning_Not_Active48");
  
                sysSetVariableInt(sysvar::RoadMap::SBR1RowCentralSeatConfigSts,0);
                sysSetVariableInt(sysvar::RoadMap::SBR1RowCentralSeatSts,0);
                sysSetVariableInt(sysvar::RoadMap::SBR1RowCentralSeatPPDFailSts,3);
                sysSetVariableInt(sysvar::RoadMap::SBR1RowCentralSeatBuckleFailSts,0);  
                
}

export testfunction SBR1RowCNTRLWarning_Not_Active49()
{
  testModuleTitle("SBR1RowCNTRLWarning_Not_Active49");
  //write("SBR1RowCNTRLWarning_Not_Active49");
  
                sysSetVariableInt(sysvar::RoadMap::SBR1RowCentralSeatConfigSts,0);
                sysSetVariableInt(sysvar::RoadMap::SBR1RowCentralSeatSts,1);
                sysSetVariableInt(sysvar::RoadMap::SBR1RowCentralSeatPPDFailSts,3);
                sysSetVariableInt(sysvar::RoadMap::SBR1RowCentralSeatBuckleFailSts,0);  
                
}

export testfunction SBR1RowCNTRLWarning_Not_Active50()
{
  testModuleTitle("SBR1RowCNTRLWarning_Not_Active50");
  //write("SBR1RowCNTRLWarning_Not_Active50");
  
                sysSetVariableInt(sysvar::RoadMap::SBR1RowCentralSeatConfigSts,0);
                sysSetVariableInt(sysvar::RoadMap::SBR1RowCentralSeatSts,2);
                sysSetVariableInt(sysvar::RoadMap::SBR1RowCentralSeatPPDFailSts,3);
                sysSetVariableInt(sysvar::RoadMap::SBR1RowCentralSeatBuckleFailSts,0);  
                
}

export testfunction SBR1RowCNTRLWarning_Not_Active51()
{
  testModuleTitle("SBR1RowCNTRLWarning_Not_Active51");
  //write("SBR1RowCNTRLWarning_Not_Active51");
  
                sysSetVariableInt(sysvar::RoadMap::SBR1RowCentralSeatConfigSts,0);
                sysSetVariableInt(sysvar::RoadMap::SBR1RowCentralSeatSts,3);
                sysSetVariableInt(sysvar::RoadMap::SBR1RowCentralSeatPPDFailSts,3);
                sysSetVariableInt(sysvar::RoadMap::SBR1RowCentralSeatBuckleFailSts,0);  
                
}

export testfunction SBR1RowCNTRLWarning_Not_Active52()
{
  testModuleTitle("SBR1RowCNTRLWarning_Not_Active52");
  //write("SBR1RowCNTRLWarning_Not_Active52");
  
                sysSetVariableInt(sysvar::RoadMap::SBR1RowCentralSeatConfigSts,0);
                sysSetVariableInt(sysvar::RoadMap::SBR1RowCentralSeatSts,7);
                sysSetVariableInt(sysvar::RoadMap::SBR1RowCentralSeatPPDFailSts,3);
                sysSetVariableInt(sysvar::RoadMap::SBR1RowCentralSeatBuckleFailSts,0);  
                
}

export testfunction SBR1RowCNTRLWarning_Not_Active53()
{
  testModuleTitle("SBR1RowCNTRLWarning_Not_Active53");
  //write("SBR1RowCNTRLWarning_Not_Active53");
  
                sysSetVariableInt(sysvar::RoadMap::SBR1RowCentralSeatConfigSts,0);
                sysSetVariableInt(sysvar::RoadMap::SBR1RowCentralSeatSts,0);
                sysSetVariableInt(sysvar::RoadMap::SBR1RowCentralSeatPPDFailSts,3);
                sysSetVariableInt(sysvar::RoadMap::SBR1RowCentralSeatBuckleFailSts,1);  
                
}

export testfunction SBR1RowCNTRLWarning_Not_Active54()
{
  testModuleTitle("SBR1RowCNTRLWarning_Not_Active54");
  //write("SBR1RowCNTRLWarning_Not_Active54");
  
                sysSetVariableInt(sysvar::RoadMap::SBR1RowCentralSeatConfigSts,0);
                sysSetVariableInt(sysvar::RoadMap::SBR1RowCentralSeatSts,1);
                sysSetVariableInt(sysvar::RoadMap::SBR1RowCentralSeatPPDFailSts,3);
                sysSetVariableInt(sysvar::RoadMap::SBR1RowCentralSeatBuckleFailSts,1);  
                
}

export testfunction SBR1RowCNTRLWarning_Not_Active55()
{
  testModuleTitle("SBR1RowCNTRLWarning_Not_Active55");
  //write("SBR1RowCNTRLWarning_Not_Active55");
  
                sysSetVariableInt(sysvar::RoadMap::SBR1RowCentralSeatConfigSts,0);
                sysSetVariableInt(sysvar::RoadMap::SBR1RowCentralSeatSts,2);
                sysSetVariableInt(sysvar::RoadMap::SBR1RowCentralSeatPPDFailSts,3);
                sysSetVariableInt(sysvar::RoadMap::SBR1RowCentralSeatBuckleFailSts,1);  
                
}

export testfunction SBR1RowCNTRLWarning_Not_Active56()
{
  testModuleTitle("SBR1RowCNTRLWarning_Not_Active56");
  //write("SBR1RowCNTRLWarning_Not_Active56");
  
                sysSetVariableInt(sysvar::RoadMap::SBR1RowCentralSeatConfigSts,0);
                sysSetVariableInt(sysvar::RoadMap::SBR1RowCentralSeatSts,3);
                sysSetVariableInt(sysvar::RoadMap::SBR1RowCentralSeatPPDFailSts,3);
                sysSetVariableInt(sysvar::RoadMap::SBR1RowCentralSeatBuckleFailSts,1);  
                
}

export testfunction SBR1RowCNTRLWarning_Not_Active57()
{
  testModuleTitle("SBR1RowCNTRLWarning_Not_Active57");
  //write("SBR1RowCNTRLWarning_Not_Active57");
  
                sysSetVariableInt(sysvar::RoadMap::SBR1RowCentralSeatConfigSts,0);
                sysSetVariableInt(sysvar::RoadMap::SBR1RowCentralSeatSts,7);
                sysSetVariableInt(sysvar::RoadMap::SBR1RowCentralSeatPPDFailSts,3);
                sysSetVariableInt(sysvar::RoadMap::SBR1RowCentralSeatBuckleFailSts,1);  
                
}

export testfunction SBR1RowCNTRLWarning_Not_Active58()
{
  testModuleTitle("SBR1RowCNTRLWarning_Not_Active58");
  //write("SBR1RowCNTRLWarning_Not_Active58");
  
                sysSetVariableInt(sysvar::RoadMap::SBR1RowCentralSeatConfigSts,1);
                sysSetVariableInt(sysvar::RoadMap::SBR1RowCentralSeatSts,0);
                sysSetVariableInt(sysvar::RoadMap::SBR1RowCentralSeatPPDFailSts,1);
                sysSetVariableInt(sysvar::RoadMap::SBR1RowCentralSeatBuckleFailSts,0);  
                
}

export testfunction SBR1RowCNTRLWarning_Not_Active59()
{
  testModuleTitle("SBR1RowCNTRLWarning_Not_Active59");
  //write("SBR1RowCNTRLWarning_Not_Active59");
  
                sysSetVariableInt(sysvar::RoadMap::SBR1RowCentralSeatConfigSts,1);
                sysSetVariableInt(sysvar::RoadMap::SBR1RowCentralSeatSts,1);
                sysSetVariableInt(sysvar::RoadMap::SBR1RowCentralSeatPPDFailSts,1);
                sysSetVariableInt(sysvar::RoadMap::SBR1RowCentralSeatBuckleFailSts,0);  
                
}

export testfunction SBR1RowCNTRLWarning_Not_Active60()
{
  testModuleTitle("SBR1RowCNTRLWarning_Not_Active60");
  //write("SBR1RowCNTRLWarning_Not_Active60");
  
                sysSetVariableInt(sysvar::RoadMap::SBR1RowCentralSeatConfigSts,1);
                sysSetVariableInt(sysvar::RoadMap::SBR1RowCentralSeatSts,2);
                sysSetVariableInt(sysvar::RoadMap::SBR1RowCentralSeatPPDFailSts,1);
                sysSetVariableInt(sysvar::RoadMap::SBR1RowCentralSeatBuckleFailSts,0);  
                
}

export testfunction SBR1RowCNTRLWarning_Not_Active61()
{
  testModuleTitle("SBR1RowCNTRLWarning_Not_Active61");
  //write("SBR1RowCNTRLWarning_Not_Active61");
  
                sysSetVariableInt(sysvar::RoadMap::SBR1RowCentralSeatConfigSts,1);
                sysSetVariableInt(sysvar::RoadMap::SBR1RowCentralSeatSts,3);
                sysSetVariableInt(sysvar::RoadMap::SBR1RowCentralSeatPPDFailSts,1);
                sysSetVariableInt(sysvar::RoadMap::SBR1RowCentralSeatBuckleFailSts,0);  
                
}

export testfunction SBR1RowCNTRLWarning_Not_Active62()
{
  testModuleTitle("SBR1RowCNTRLWarning_Not_Active62");
  //write("SBR1RowCNTRLWarning_Not_Active62");
  
                sysSetVariableInt(sysvar::RoadMap::SBR1RowCentralSeatConfigSts,1);
                sysSetVariableInt(sysvar::RoadMap::SBR1RowCentralSeatSts,7);
                sysSetVariableInt(sysvar::RoadMap::SBR1RowCentralSeatPPDFailSts,1);
                sysSetVariableInt(sysvar::RoadMap::SBR1RowCentralSeatBuckleFailSts,0);  
                
}

export testfunction SBR1RowCNTRLWarning_Not_Active63()
{
  testModuleTitle("SBR1RowCNTRLWarning_Not_Active63");
  //write("SBR1RowCNTRLWarning_Not_Active63");
  
                sysSetVariableInt(sysvar::RoadMap::SBR1RowCentralSeatConfigSts,1);
                sysSetVariableInt(sysvar::RoadMap::SBR1RowCentralSeatSts,0);
                sysSetVariableInt(sysvar::RoadMap::SBR1RowCentralSeatPPDFailSts,1);
                sysSetVariableInt(sysvar::RoadMap::SBR1RowCentralSeatBuckleFailSts,1);  
                
}

export testfunction SBR1RowCNTRLWarning_Not_Active64()
{
  testModuleTitle("SBR1RowCNTRLWarning_Not_Active64");
  //write("SBR1RowCNTRLWarning_Not_Active64");
  
                sysSetVariableInt(sysvar::RoadMap::SBR1RowCentralSeatConfigSts,1);
                sysSetVariableInt(sysvar::RoadMap::SBR1RowCentralSeatSts,1);
                sysSetVariableInt(sysvar::RoadMap::SBR1RowCentralSeatPPDFailSts,1);
                sysSetVariableInt(sysvar::RoadMap::SBR1RowCentralSeatBuckleFailSts,1);  
                
}

export testfunction SBR1RowCNTRLWarning_Not_Active65()
{
  testModuleTitle("SBR1RowCNTRLWarning_Not_Active65");
  //write("SBR1RowCNTRLWarning_Not_Active65");
  
                sysSetVariableInt(sysvar::RoadMap::SBR1RowCentralSeatConfigSts,1);
                sysSetVariableInt(sysvar::RoadMap::SBR1RowCentralSeatSts,2);
                sysSetVariableInt(sysvar::RoadMap::SBR1RowCentralSeatPPDFailSts,1);
                sysSetVariableInt(sysvar::RoadMap::SBR1RowCentralSeatBuckleFailSts,1);  
                
}

export testfunction SBR1RowCNTRLWarning_Not_Active66()
{
  testModuleTitle("SBR1RowCNTRLWarning_Not_Active66");
  //write("SBR1RowCNTRLWarning_Not_Active66");
  
                sysSetVariableInt(sysvar::RoadMap::SBR1RowCentralSeatConfigSts,1);
                sysSetVariableInt(sysvar::RoadMap::SBR1RowCentralSeatSts,3);
                sysSetVariableInt(sysvar::RoadMap::SBR1RowCentralSeatPPDFailSts,1);
                sysSetVariableInt(sysvar::RoadMap::SBR1RowCentralSeatBuckleFailSts,1);  
                
}

export testfunction SBR1RowCNTRLWarning_Not_Active67()
{
  testModuleTitle("SBR1RowCNTRLWarning_Not_Active67");
  //write("SBR1RowCNTRLWarning_Not_Active67");
  
                sysSetVariableInt(sysvar::RoadMap::SBR1RowCentralSeatConfigSts,1);
                sysSetVariableInt(sysvar::RoadMap::SBR1RowCentralSeatSts,7);
                sysSetVariableInt(sysvar::RoadMap::SBR1RowCentralSeatPPDFailSts,1);
                sysSetVariableInt(sysvar::RoadMap::SBR1RowCentralSeatBuckleFailSts,1);  
                
}

export testfunction SBR1RowCNTRLWarning_Not_Active68()
{
  testModuleTitle("SBR1RowCNTRLWarning_Not_Active68");
  //write("SBR1RowCNTRLWarning_Not_Active68");
  
                sysSetVariableInt(sysvar::RoadMap::SBR1RowCentralSeatConfigSts,1);
                sysSetVariableInt(sysvar::RoadMap::SBR1RowCentralSeatSts,0);
                sysSetVariableInt(sysvar::RoadMap::SBR1RowCentralSeatPPDFailSts,1);
                sysSetVariableInt(sysvar::RoadMap::SBR1RowCentralSeatBuckleFailSts,3);  
                
}

export testfunction SBR1RowCNTRLWarning_Not_Active69()
{
  testModuleTitle("SBR1RowCNTRLWarning_Not_Active69");
  //write("SBR1RowCNTRLWarning_Not_Active69");
  
                sysSetVariableInt(sysvar::RoadMap::SBR1RowCentralSeatConfigSts,1);
                sysSetVariableInt(sysvar::RoadMap::SBR1RowCentralSeatSts,1);
                sysSetVariableInt(sysvar::RoadMap::SBR1RowCentralSeatPPDFailSts,1);
                sysSetVariableInt(sysvar::RoadMap::SBR1RowCentralSeatBuckleFailSts,3);  
                
}

export testfunction SBR1RowCNTRLWarning_Not_Active70()
{
  testModuleTitle("SBR1RowCNTRLWarning_Not_Active70");
  //write("SBR1RowCNTRLWarning_Not_Active70");
  
                sysSetVariableInt(sysvar::RoadMap::SBR1RowCentralSeatConfigSts,1);
                sysSetVariableInt(sysvar::RoadMap::SBR1RowCentralSeatSts,2);
                sysSetVariableInt(sysvar::RoadMap::SBR1RowCentralSeatPPDFailSts,1);
                sysSetVariableInt(sysvar::RoadMap::SBR1RowCentralSeatBuckleFailSts,3);  
                
}

export testfunction SBR1RowCNTRLWarning_Not_Active71()
{
  testModuleTitle("SBR1RowCNTRLWarning_Not_Active71");
  //write("SBR1RowCNTRLWarning_Not_Active71");
  
                sysSetVariableInt(sysvar::RoadMap::SBR1RowCentralSeatConfigSts,1);
                sysSetVariableInt(sysvar::RoadMap::SBR1RowCentralSeatSts,3);
                sysSetVariableInt(sysvar::RoadMap::SBR1RowCentralSeatPPDFailSts,1);
                sysSetVariableInt(sysvar::RoadMap::SBR1RowCentralSeatBuckleFailSts,3);  
                
}

export testfunction SBR1RowCNTRLWarning_Not_Active72()
{
  testModuleTitle("SBR1RowCNTRLWarning_Not_Active72");
  //write("SBR1RowCNTRLWarning_Not_Active72");
  
                sysSetVariableInt(sysvar::RoadMap::SBR1RowCentralSeatConfigSts,1);
                sysSetVariableInt(sysvar::RoadMap::SBR1RowCentralSeatSts,7);
                sysSetVariableInt(sysvar::RoadMap::SBR1RowCentralSeatPPDFailSts,1);
                sysSetVariableInt(sysvar::RoadMap::SBR1RowCentralSeatBuckleFailSts,3);  
                
}

export testfunction SBR2RowLeftWarning_Active()
{
  testModuleTitle("SBR2RowLeftWarning_Active");
  //write("SBR2RowLeftWarning_Active");
  
                sysSetVariableInt(sysvar::RoadMap::SBR2RowLeftSeatConfigSts,1);
                sysSetVariableInt(sysvar::RoadMap::SBR2RowLeftSeatSts,1);  
                
}

export testfunction SBR2RowLeftWarning_Not_Active()
{
  testModuleTitle("SBR2RowLeftWarning_Not_Active");
  //write("SBR2RowLeftWarning_Not_Active");
  
                sysSetVariableInt(sysvar::RoadMap::SBR2RowLeftSeatConfigSts,1);
                sysSetVariableInt(sysvar::RoadMap::SBR2RowLeftSeatSts,0);  
                
}

export testfunction SBR2RowLeftWarning_SNA_1()
{
  testModuleTitle("SBR2RowLeftWarning_SNA_1");
  //write("SBR2RowLeftWarning_SNA_1");
  
                sysSetVariableInt(sysvar::RoadMap::SBR2RowLeftSeatConfigSts,1);
                sysSetVariableInt(sysvar::RoadMap::SBR2RowLeftSeatSts,3);  
                
}

export testfunction SBR2RowLeftWarning_SNA_2()
{
  testModuleTitle("SBR2RowLeftWarning_SNA_2");
  //write("SBR2RowLeftWarning_SNA_2");
  
                sysSetVariableInt(sysvar::RoadMap::SBR2RowLeftSeatConfigSts,0);
                sysSetVariableInt(sysvar::RoadMap::SBR2RowLeftSeatSts,0);  
                
}

export testfunction SBR2RowLeftWarning_SNA_3()
{
  testModuleTitle("SBR2RowLeftWarning_SNA_3");
  //write("SBR2RowLeftWarning_SNA_3");
  
                sysSetVariableInt(sysvar::RoadMap::SBR2RowLeftSeatConfigSts,0);
                sysSetVariableInt(sysvar::RoadMap::SBR2RowLeftSeatSts,1);  
                
}

export testfunction SBR2RowLeftWarning_SNA_4()
{
  testModuleTitle("SBR2RowLeftWarning_SNA_4");
  //write("SBR2RowLeftWarning_SNA_4");
  
                sysSetVariableInt(sysvar::RoadMap::SBR2RowLeftSeatConfigSts,0);
                sysSetVariableInt(sysvar::RoadMap::SBR2RowLeftSeatSts,3);  
                
}

export testfunction SBR2RowRightWarning_Active()
{
  testModuleTitle("SBR2RowRightWarning_Active");
  //write("SBR2RowRightWarning_Active");
  
                sysSetVariableInt(sysvar::RoadMap::SBR2RowRightSeatConfigSts,1);
                sysSetVariableInt(sysvar::RoadMap::SBR2RowRightSeatSts,1);  
                
}

export testfunction SBR2RowRightWarning_Not_Active()
{
  testModuleTitle("SBR2RowRightWarning_Not_Active");
  //write("SBR2RowRightWarning_Not_Active");
  
                sysSetVariableInt(sysvar::RoadMap::SBR2RowRightSeatConfigSts,1);
                sysSetVariableInt(sysvar::RoadMap::SBR2RowRightSeatSts,0);  
                
}

export testfunction SBR2RowRightWarning_SNA_1()
{
  testModuleTitle("SBR2RowRightWarning_SNA_1");
  //write("SBR2RowRightWarning_SNA_1");
  
                sysSetVariableInt(sysvar::RoadMap::SBR2RowRightSeatConfigSts,1);
                sysSetVariableInt(sysvar::RoadMap::SBR2RowRightSeatSts,3);  
                
}

export testfunction SBR2RowRightWarning_SNA_2()
{
  testModuleTitle("SBR2RowRightWarning_SNA_2");
  //write("SBR2RowRightWarning_SNA_2");
  
                sysSetVariableInt(sysvar::RoadMap::SBR2RowRightSeatConfigSts,0);
                sysSetVariableInt(sysvar::RoadMap::SBR2RowRightSeatSts,0);  
                
}

export testfunction SBR2RowRightWarning_SNA_3()
{
  testModuleTitle("SBR2RowRightWarning_SNA_3");
  //write("SBR2RowRightWarning_SNA_3");
  
                sysSetVariableInt(sysvar::RoadMap::SBR2RowRightSeatConfigSts,0);
                sysSetVariableInt(sysvar::RoadMap::SBR2RowRightSeatSts,1);  
                
}

export testfunction SBR2RowRightWarning_SNA_4()
{
  testModuleTitle("SBR2RowRightWarning_SNA_4");
  //write("SBR2RowRightWarning_SNA_4");
  
                sysSetVariableInt(sysvar::RoadMap::SBR2RowRightSeatConfigSts,0);
                sysSetVariableInt(sysvar::RoadMap::SBR2RowRightSeatSts,3);  
                
}

export testfunction SBR2RowCentralWarning_Active()
{
  testModuleTitle("SBR2RowCentralWarning_Active");
  //write("SBR2RowCentralWarning_Active");
  
                sysSetVariableInt(sysvar::RoadMap::SBR2RowCentralSeatConfigSts,1);
                sysSetVariableInt(sysvar::RoadMap::SBR2RowCentralSeatSts,1);  
                
}

export testfunction SBR2RowCentralWarning_Not_Active()
{
  testModuleTitle("SBR2RowCentralWarning_Not_Active");
  //write("SBR2RowCentralWarning_Not_Active");
  
                sysSetVariableInt(sysvar::RoadMap::SBR2RowCentralSeatConfigSts,1);
                sysSetVariableInt(sysvar::RoadMap::SBR2RowCentralSeatSts,0);  
                
}

export testfunction SBR2RowCentralWarning_SNA_1()
{
  testModuleTitle("SBR2RowCentralWarning_SNA_1");
  //write("SBR2RowCentralWarning_SNA_1");
  
                sysSetVariableInt(sysvar::RoadMap::SBR2RowCentralSeatConfigSts,1);
                sysSetVariableInt(sysvar::RoadMap::SBR2RowCentralSeatSts,3);  
                
}

export testfunction SBR2RowCentralWarning_SNA_2()
{
  testModuleTitle("SBR2RowCentralWarning_SNA_2");
  //write("SBR2RowCentralWarning_SNA_2");
  
                sysSetVariableInt(sysvar::RoadMap::SBR2RowCentralSeatConfigSts,0);
                sysSetVariableInt(sysvar::RoadMap::SBR2RowCentralSeatSts,0);  
                
}

export testfunction SBR2RowCentralWarning_SNA_3()
{
  testModuleTitle("SBR2RowCentralWarning_SNA_3");
  //write("SBR2RowCentralWarning_SNA_3");
  
                sysSetVariableInt(sysvar::RoadMap::SBR2RowCentralSeatConfigSts,0);
                sysSetVariableInt(sysvar::RoadMap::SBR2RowCentralSeatSts,1);  
                
}

export testfunction SBR2RowCentralWarning_SNA_4()
{
  testModuleTitle("SBR2RowCentralWarning_SNA_4");
  //write("SBR2RowCentralWarning_SNA_4");
  
                sysSetVariableInt(sysvar::RoadMap::SBR2RowCentralSeatConfigSts,0);
                sysSetVariableInt(sysvar::RoadMap::SBR2RowCentralSeatSts,3);  
                
}

export testfunction SBR2RowLeftWarning_UNSAFE()
{


  testModuleTitle("SBR2RowLeftWarning_UNSAFE");
  //write("SBR2RowLeftWarning_UNSAFE");
                sysSetVariableInt(sysvar::RoadMap::SBR2RowLeftSeatConfigSts,1);//Seat checked
                sysSetVariableInt(sysvar::RoadMap::SBR2RowLeftSeatSts,1); //Seat Belt Not Fasten
                
}


export testfunction SBR2RowLeftWarning_SAFE()
{

  testModuleTitle("SBR2RowLeftWarning_SAFE");
  //write("SBR2RowLeftWarning_SAFE");
                sysSetVariableInt(sysvar::RoadMap::SBR2RowLeftSeatConfigSts,1);//Seat checked
                sysSetVariableInt(sysvar::RoadMap::SBR2RowLeftSeatSts,0); //Seat Belt Fasten
}




export testfunction SBR2RowLeftWarning_NOT_CONFIGURED()
{

  testModuleTitle("SBR2RowLeftWarning_NOT_CONFIGURED");
  //write("SBR2RowLeftWarning_NOT_CONFIGURED");
  
                sysSetVariableInt(sysvar::RoadMap::SBR2RowLeftSeatConfigSts,0);//Seat Not Checked
                sysSetVariableInt(sysvar::RoadMap::SBR2RowLeftSeatSts,0); //Seat Belt Fasten
                

}

export testfunction SBR2RowLeftWarning_NOT_CONFIGURED1()
{



  testModuleTitle("SBR2RowLeftWarning_NOT_CONFIGURED1");
  //write("SBR2RowLeftWarning_NOT_CONFIGURED1");
  
                sysSetVariableInt(sysvar::RoadMap::SBR2RowLeftSeatConfigSts,0);//Seat Not Checked
                sysSetVariableInt(sysvar::RoadMap::SBR2RowLeftSeatSts,1); //Seat Belt Fasten
                
}

export testfunction SBR2RowLeftWarning_NOT_CONFIGURED2()
{
  testModuleTitle("SBR2RowLeftWarning_NOT_CONFIGURED2");
  //write("SBR2RowLeftWarning_NOT_CONFIGURED2");
  
                sysSetVariableInt(sysvar::RoadMap::SBR2RowLeftSeatConfigSts,0);//Seat Not Checked
                sysSetVariableInt(sysvar::RoadMap::SBR2RowLeftSeatSts,3); //SNA
                
}


export testfunction SBR2RowLeftWarning_NOT_CONFIGURED3()
{
  testModuleTitle("SBR2RowLeftWarning_NOT_CONFIGURED3");
  //write("SBR2RowLeftWarning_NOT_CONFIGURED1");
  
                sysSetVariableInt(sysvar::RoadMap::SBR2RowLeftSeatConfigSts,1);//Seat Checked
                sysSetVariableInt(sysvar::RoadMap::SBR2RowLeftSeatSts,3); //SNA
                

}

export testfunction SBR2RowRightWarning_UNSAFE()
{



  testModuleTitle("SBR2RowRightWarning_UNSAFE");
  //write("SBR2RowRightWarning_UNSAFE");
  
                sysSetVariableInt(sysvar::RoadMap::SBR2RowRightSeatConfigSts,1);//Seat checked
                sysSetVariableInt(sysvar::RoadMap::SBR2RowRightSeatSts,1); //Seat Belt Not Fasten
                
}

export testfunction SBR2RowRightWarning_SAFE()
{
  testModuleTitle("SBR2RowRightWarning_SAFE");
  //write("SBR2RowRightWarning_SAFE");
  
                sysSetVariableInt(sysvar::RoadMap::SBR2RowRightSeatConfigSts,1);//Seat checked
                sysSetVariableInt(sysvar::RoadMap::SBR2RowRightSeatSts,0); //Seat Belt Fasten
                
}

export testfunction SBR2RowRightWarning_NOT_CONFIGURED()
{
  testModuleTitle("SBR2RowRightWarning_NOT_CONFIGURED");
  //write("SBR2RowRightWarning_NOT_CONFIGURED");
  
                sysSetVariableInt(sysvar::RoadMap::SBR2RowRightSeatConfigSts,0);//Seat Not Checked
                sysSetVariableInt(sysvar::RoadMap::SBR2RowRightSeatSts,0); //Seat Belt Fasten
                

}

export testfunction SBR2RowRightWarning_NOT_CONFIGURED1()
{



  testModuleTitle("SBR2RowRightWarning_NOT_CONFIGURED1");
  //write("SBR2RowRightWarning_NOT_CONFIGURED1");
  
                sysSetVariableInt(sysvar::RoadMap::SBR2RowRightSeatConfigSts,0);//Seat Not Checked
                sysSetVariableInt(sysvar::RoadMap::SBR2RowRightSeatSts,1); //Seat Belt Fasten
                
}

export testfunction SBR2RowRightWarning_NOT_CONFIGURED2()
{
  testModuleTitle("SBR2RowRightWarning_NOT_CONFIGURED2");
  //write("SBR2RowRightWarning_NOT_CONFIGURED2");
  
                sysSetVariableInt(sysvar::RoadMap::SBR2RowRightSeatConfigSts,0);//Seat Not Checked
                sysSetVariableInt(sysvar::RoadMap::SBR2RowRightSeatSts,3); //SNA
                
}


export testfunction SBR2RowRightWarning_NOT_CONFIGURED3()
{

  testModuleTitle("SBR2RowRightWarning_NOT_CONFIGURED3");
  //write("SBR2RowRightWarning_NOT_CONFIGURED1");
  
                sysSetVariableInt(sysvar::RoadMap::SBR2RowRightSeatConfigSts,1);//Seat Checked
                sysSetVariableInt(sysvar::RoadMap::SBR2RowRightSeatSts,3); //SNA
                

}

export testfunction SBR2RowCentralWarning_UNSAFE()
{



  testModuleTitle("SBR2RowCentralWarning_UNSAFE");
  //write("SBR2RowCentralWarning_UNSAFE");
  
                sysSetVariableInt(sysvar::RoadMap::SBR2RowCentralSeatConfigSts,1);//Seat checked
                sysSetVariableInt(sysvar::RoadMap::SBR2RowCentralSeatSts,1); //Seat Belt Not Fasten
                
}

export testfunction SBR2RowCentralWarning_SAFE()
{
  testModuleTitle("SBR2RowCentralWarning_SAFE");
  //write("SBR2RowCentralWarning_SAFE");
  
                sysSetVariableInt(sysvar::RoadMap::SBR2RowCentralSeatConfigSts,1);//Seat checked
                sysSetVariableInt(sysvar::RoadMap::SBR2RowCentralSeatSts,0); //Seat Belt Fasten
                
}

export testfunction SBR2RowCentralWarning_NOT_CONFIGURED()
{
  testModuleTitle("SBR2RowCentralWarning_NOT_CONFIGURED");
  //write("SBR2RowCentralWarning_NOT_CONFIGURED");
  

                sysSetVariableInt(sysvar::RoadMap::SBR2RowCentralSeatConfigSts,0);//Seat Not Checked
                sysSetVariableInt(sysvar::RoadMap::SBR2RowCentralSeatSts,0); //Seat Belt Fasten
                
}

export testfunction SBR2RowCentralWarning_NOT_CONFIGURED1()
{

  testModuleTitle("SBR2RowCentralWarning_NOT_CONFIGURED1");
  //write("SBR2RowCentralWarning_NOT_CONFIGURED1");
  
                sysSetVariableInt(sysvar::RoadMap::SBR2RowCentralSeatConfigSts,0);//Seat Not Checked
                sysSetVariableInt(sysvar::RoadMap::SBR2RowCentralSeatSts,1); //Seat Belt Fasten
                

}

export testfunction SBR2RowCentralWarning_NOT_CONFIGURED2()
{



  testModuleTitle("SBR2RowCentralWarning_NOT_CONFIGURED2");
  //write("SBR2RowCentralWarning_NOT_CONFIGURED2");
  
                sysSetVariableInt(sysvar::RoadMap::SBR2RowCentralSeatConfigSts,0);//Seat Not Checked
                sysSetVariableInt(sysvar::RoadMap::SBR2RowCentralSeatSts,3); //SNA
                
}

export testfunction SBR2RowCentralWarning_NOT_CONFIGURED3()
{
  testModuleTitle("SBR2RowCentralWarning_NOT_CONFIGURED3");
  //write("SBR2RowCentralWarning_NOT_CONFIGURED1");
  
                sysSetVariableInt(sysvar::RoadMap::SBR2RowCentralSeatConfigSts,1);//Seat Checked
                sysSetVariableInt(sysvar::RoadMap::SBR2RowCentralSeatSts,3); //SNA
                
}

export testfunction Send_Km_AND_Day_Not_active()
{
  testModuleTitle("Send_Km_AND_Day");
  write("Send_Km_AND_Day");
             
                sysSetVariableInt(sysvar::RoadMap::EnableTravelDistance,0);
                sysSetVariableFloat(sysvar::RoadMap::VehicleSpeedVSOSig,0);
                sysSetVariableInt(sysvar::RoadMap::EngineSpeed,0);
                sysSetVariableFloat(sysvar::RoadMap::FuelLevel,50);
                sysSetVariableFloat(sysvar::RoadMap::FuelConsumption_GAG,12);
                testWaitForTimeout (1000); 
}


export testfunction Increase_CC_SetSpdDspl_KPH_0_30 ()
{
  testModuleTitle("Increase_CC_SetSpdDspl_KPH_0_30");
  
              
              for (i=0; i<=30; i++)
              {
                write("VehicleSpeed:%VehicleSpeedVSOSig");
                sysSetVariableFloat(sysvar::RoadMap::CC_SetSpdDspl_KPH,i);
                testWaitForTimeout (300);
              }  
}


export testfunction Increase_CC_SetSpdDspl_KPH_130_511 ()
{
  testModuleTitle("Increase_CC_SetSpdDspl_KPH_130_511");
  
              
              for (i=130; i<=511; i++)
              {
                write("VehicleSpeed:%VehicleSpeedVSOSig");
                sysSetVariableFloat(sysvar::RoadMap::CC_SetSpdDspl_KPH,i);
                testWaitForTimeout (300);
              }  
}

export testfunction Increase_CC_SetSpdDspl_KPH_30_130 ()
{
  testModuleTitle("Increase_CC_SetSpdDspl_KPH_30_130");
  
              
              for (i=30; i<=130; i++)
              {
                write("VehicleSpeed:%VehicleSpeedVSOSig");
                sysSetVariableFloat(sysvar::RoadMap::CC_SetSpdDspl_KPH,i);
                testWaitForTimeout (300);
              }  
}

export testfunction Increase_CC_SetSpdDspl_KPH_0_510 ()
{
  testModuleTitle("Increase_CC_SetSpdDspl_KPH_0_510");
  
              
              for (i=0; i<=510; i++)
              {
                write("VehicleSpeed:%VehicleSpeedVSOSig");
                sysSetVariableFloat(sysvar::RoadMap::CC_SetSpdDspl_KPH,i);
                testWaitForTimeout (300);
              }  
}

export testfunction Increase_CC_SetSpdDspl_MPH_0_20 ()
{
  testModuleTitle("Increase_CC_SetSpdDspl_MPH_0_20");
  
              
              for (i=0; i<=30; i++)
              {
                write("VehicleSpeed:%VehicleSpeedVSOSig");
                sysSetVariableint(sysvar::RoadMap::CC_SetSpdDspl_MPH,i);
                testWaitForTimeout (300);
              }  
}


export testfunction Increase_CC_SetSpdDspl_MPH_80_511 ()
{
  testModuleTitle("Increase_CC_SetSpdDspl_MPH_80_511");
  
              
              for (i=130; i<=511; i++)
              {
                write("VehicleSpeed:%VehicleSpeedVSOSig");
                sysSetVariableint(sysvar::RoadMap::CC_SetSpdDspl_MPH,i);
                testWaitForTimeout (300);
              }  
}

export testfunction Increase_CC_SetSpdDspl_MPH_20_80 ()
{
  testModuleTitle("Increase_CC_SetSpdDspl_MPH_20_80");
  
              
              for (i=30; i<=130; i++)
              {
                write("VehicleSpeed:%VehicleSpeedVSOSig");
                sysSetVariableint(sysvar::RoadMap::CC_SetSpdDspl_MPH,i);
                testWaitForTimeout (300);
              }  
}

export testfunction Increase_CC_SetSpdDspl_MPH_0_510 ()
{
  testModuleTitle("Increase_CC_SetSpdDspl_MPH_0_510");
  
              
              for (i=0; i<=510; i++)
              {
                write("VehicleSpeed:%VehicleSpeedVSOSig");
                sysSetVariableint(sysvar::RoadMap::CC_SetSpdDspl_MPH,i);
                testWaitForTimeout (300);
              }  
}


export testfunction Increase_Speed_0_9 ()
{
  testModuleTitle("Increase_Speed_0_9");
  
              
              for (i=0; i<=9; i++)
              {
                write("VehicleSpeed:%VehicleSpeedVSOSig");
                sysSetVariableFloat(sysvar::RoadMap::VehicleSpeedVSOSig,i);
                testWaitForTimeout (500);
              }  
}

export testfunction Increase_Speed_10_19 ()
{
  testModuleTitle("Increase_Speed_10_19");
  
              
              for (i=10; i<=19; i++)
              {
                write("VehicleSpeed:%VehicleSpeedVSOSig");
                sysSetVariableFloat(sysvar::RoadMap::VehicleSpeedVSOSig,i);
                testWaitForTimeout (500);
              }  
}

export testfunction Increase_Speed_20_200 ()
{
  testModuleTitle("Increase_Speed_20_200");
  
              
              for (i=20; i<=200; i++)
              {
                write("VehicleSpeed:%VehicleSpeedVSOSig");
                sysSetVariableFloat(sysvar::RoadMap::VehicleSpeedVSOSig,i);
                testWaitForTimeout (100);
              }  
}

export testfunction Increase_Speed_0_200 ()
{
  testModuleTitle("Increase_Speed_0_200");
  
              
              for (i=0; i<=200; i++)
              {
                write("VehicleSpeed:%VehicleSpeedVSOSig");
                sysSetVariableFloat(sysvar::RoadMap::VehicleSpeedVSOSig,i);
                testWaitForTimeout (100);
              }  
}

export testfunction Increase_PressureValue_LHF_RHF_LHR_RHR_Tyre_0_6__9 ()
{
  testModuleTitle("Increase_PressureValue_LHF_RHF_LHR_RHR_Tyre_0_6__9");
  
              
              for (i=0; i<=6.9; i++)
              {
                write("VehicleSpeed:%VehicleSpeedVSOSig");
                sysSetVariableint(sysvar::RoadMap::InflationState_LHF_Tyre,i);
				sysSetVariableint(sysvar::RoadMap::InflationState_RHF_Tyre,i);
				sysSetVariableint(sysvar::RoadMap::InflationState_LHR_Tyre,i);
				sysSetVariableint(sysvar::RoadMap::InflationState_RHR_Tyre,i);
                testWaitForTimeout (300);
              }  
}


//***********Increase Km**************************
export testfunction Increase_1km ()
{
  testModuleTitle("Increase_1km");
  write("Increase_1km");
  
                sysSetVariableInt(sysvar::RoadMap::EnableTravelDistance,1);
                sysSetVariableInt(sysvar::RoadMap::WC_Ignition_On_EngOn_AUTO,1);
                sysSetVariableFloat(sysvar::RoadMap::VehicleSpeedVSOSig,100);
                sysSetVariableInt(sysvar::RoadMap::EngineSpeed,3000);
                sysSetVariableFloat(sysvar::RoadMap::FuelLevel,50);
                sysSetVariableFloat(sysvar::RoadMap::FuelConsumption_GAG,12);
                testWaitForTimeout (Increase_1km);
                sysSetVariableInt(sysvar::RoadMap::EnableTravelDistance,0);
                sysSetVariableInt(sysvar::RoadMap::WC_Ignition_On_EngOn_AUTO,0);
                sysSetVariableFloat(sysvar::RoadMap::VehicleSpeedVSOSig,0);
                sysSetVariableInt(sysvar::RoadMap::EngineSpeed,0);
                sysSetVariableFloat(sysvar::RoadMap::FuelLevel,0);
                sysSetVariableFloat(sysvar::RoadMap::FuelConsumption_GAG,0);
        
}

export testfunction Increase_2km ()
{
  testModuleTitle("Increase_2km");
  write("Increase_2km");
  
                sysSetVariableInt(sysvar::RoadMap::EnableTravelDistance,1);
                sysSetVariableInt(sysvar::RoadMap::WC_Ignition_On_EngOn_AUTO,1);
                sysSetVariableFloat(sysvar::RoadMap::VehicleSpeedVSOSig,100);
                sysSetVariableInt(sysvar::RoadMap::EngineSpeed,3000);
                sysSetVariableFloat(sysvar::RoadMap::FuelLevel,50);
                sysSetVariableFloat(sysvar::RoadMap::FuelConsumption_GAG,12);
                testWaitForTimeout (Increase_2km);
                sysSetVariableInt(sysvar::RoadMap::EnableTravelDistance,0);
                sysSetVariableInt(sysvar::RoadMap::WC_Ignition_On_EngOn_AUTO,0);
                sysSetVariableFloat(sysvar::RoadMap::VehicleSpeedVSOSig,0);
                sysSetVariableInt(sysvar::RoadMap::EngineSpeed,0);
                sysSetVariableFloat(sysvar::RoadMap::FuelLevel,0);
                sysSetVariableFloat(sysvar::RoadMap::FuelConsumption_GAG,0);
        
}

export testfunction Increase_3km ()
{
  testModuleTitle("Increase_3km");
  write("Increase_3km");
  
                sysSetVariableInt(sysvar::RoadMap::EnableTravelDistance,1);
                sysSetVariableInt(sysvar::RoadMap::WC_Ignition_On_EngOn_AUTO,1);
                sysSetVariableFloat(sysvar::RoadMap::VehicleSpeedVSOSig,100);
                sysSetVariableInt(sysvar::RoadMap::EngineSpeed,3000);
                sysSetVariableFloat(sysvar::RoadMap::FuelLevel,50);
                sysSetVariableFloat(sysvar::RoadMap::FuelConsumption_GAG,12);
                testWaitForTimeout (Increase_3km);
                sysSetVariableInt(sysvar::RoadMap::EnableTravelDistance,0);
                sysSetVariableInt(sysvar::RoadMap::WC_Ignition_On_EngOn_AUTO,0);
                sysSetVariableFloat(sysvar::RoadMap::VehicleSpeedVSOSig,0);
                sysSetVariableInt(sysvar::RoadMap::EngineSpeed,0);
                sysSetVariableFloat(sysvar::RoadMap::FuelLevel,0);
                sysSetVariableFloat(sysvar::RoadMap::FuelConsumption_GAG,0);
        
}

export testfunction Increase_4km ()
{
  testModuleTitle("Increase_4km");
  write("Increase_4km");
  
                sysSetVariableInt(sysvar::RoadMap::EnableTravelDistance,1);
                sysSetVariableInt(sysvar::RoadMap::WC_Ignition_On_EngOn_AUTO,1);
                sysSetVariableFloat(sysvar::RoadMap::VehicleSpeedVSOSig,100);
                sysSetVariableInt(sysvar::RoadMap::EngineSpeed,3000);
                sysSetVariableFloat(sysvar::RoadMap::FuelLevel,50);
                sysSetVariableFloat(sysvar::RoadMap::FuelConsumption_GAG,12);
                testWaitForTimeout (Increase_4km);
                sysSetVariableInt(sysvar::RoadMap::EnableTravelDistance,0);
                sysSetVariableInt(sysvar::RoadMap::WC_Ignition_On_EngOn_AUTO,0);
                sysSetVariableFloat(sysvar::RoadMap::VehicleSpeedVSOSig,0);
                sysSetVariableInt(sysvar::RoadMap::EngineSpeed,0);
                sysSetVariableFloat(sysvar::RoadMap::FuelLevel,0);
                sysSetVariableFloat(sysvar::RoadMap::FuelConsumption_GAG,0);
        
}

export testfunction Increase_5km ()
{
  testModuleTitle("Increase_5km");
  write("Increase_5km");
  
                sysSetVariableInt(sysvar::RoadMap::EnableTravelDistance,1);
                sysSetVariableInt(sysvar::RoadMap::WC_Ignition_On_EngOn_AUTO,1);
                sysSetVariableFloat(sysvar::RoadMap::VehicleSpeedVSOSig,100);
                sysSetVariableInt(sysvar::RoadMap::EngineSpeed,3000);
                sysSetVariableFloat(sysvar::RoadMap::FuelLevel,50);
                sysSetVariableFloat(sysvar::RoadMap::FuelConsumption_GAG,12);
                testWaitForTimeout (Increase_5km);
                sysSetVariableInt(sysvar::RoadMap::EnableTravelDistance,0);
                sysSetVariableInt(sysvar::RoadMap::WC_Ignition_On_EngOn_AUTO,0);
                sysSetVariableFloat(sysvar::RoadMap::VehicleSpeedVSOSig,0);
                sysSetVariableInt(sysvar::RoadMap::EngineSpeed,0);
                sysSetVariableFloat(sysvar::RoadMap::FuelLevel,0);
                sysSetVariableFloat(sysvar::RoadMap::FuelConsumption_GAG,0);
        
}

export testfunction Increase_10km ()
{
  testModuleTitle("Increase_10km");
  write("Increase_10km");
                
  
                sysSetVariableInt(sysvar::RoadMap::OperationalModeSts,8);
                testWaitForTimeout (5000);
                sysSetVariableInt(sysvar::RoadMap::EnableTravelDistance,1);
                //sysSetVariableInt(sysvar::RoadMap::TravelDistance,1);
                sysSetVariableFloat(sysvar::RoadMap::VehicleSpeedVSOSig,200);
                sysSetVariableInt(sysvar::RoadMap::EngineSpeed,3000);
                sysSetVariableFloat(sysvar::RoadMap::FuelLevel,50);
                sysSetVariableFloat(sysvar::RoadMap::FuelConsumption_GAG,12);
                testWaitForTimeout (Increase_10km);
                sysSetVariableInt(sysvar::RoadMap::EnableTravelDistance,0);
                sysSetVariableInt(sysvar::RoadMap::OperationalModeSts,4);
                sysSetVariableFloat(sysvar::RoadMap::VehicleSpeedVSOSig,0);
                sysSetVariableInt(sysvar::RoadMap::EngineSpeed,0);
                sysSetVariableFloat(sysvar::RoadMap::FuelLevel,0);
                sysSetVariableFloat(sysvar::RoadMap::FuelConsumption_GAG,0);
        
}

export testfunction Increase_200km ()
{
  testModuleTitle("Increase_200km ");
  write("Increase_200km ");
  
                sysSetVariableInt(sysvar::RoadMap::OperationalModeSts,8);
                testWaitForTimeout (5000);
                sysSetVariableInt(sysvar::RoadMap::EnableTravelDistance,1);
                sysSetVariableInt(sysvar::RoadMap::TravelDistance,1);
                sysSetVariableFloat(sysvar::RoadMap::VehicleSpeedVSOSig,100);
                sysSetVariableInt(sysvar::RoadMap::EngineSpeed,3000);
                sysSetVariableFloat(sysvar::RoadMap::FuelLevel,50);
                sysSetVariableFloat(sysvar::RoadMap::FuelConsumption_GAG,12);
                testWaitForTimeout (Increase_200km);
                sysSetVariableInt(sysvar::RoadMap::EnableTravelDistance,0);
                sysSetVariableInt(sysvar::RoadMap::WC_Ignition_On_EngOn_AUTO,0);
                sysSetVariableFloat(sysvar::RoadMap::VehicleSpeedVSOSig,0);
                sysSetVariableInt(sysvar::RoadMap::EngineSpeed,0);
                sysSetVariableFloat(sysvar::RoadMap::FuelLevel,0);
                sysSetVariableFloat(sysvar::RoadMap::FuelConsumption_GAG,0);
        
}

export testfunction Increase_201km ()
{
  testModuleTitle("Increase_201km ");
  write("Increase_201km ");
  
                sysSetVariableInt(sysvar::RoadMap::OperationalModeSts,8);
                testWaitForTimeout (5000);
                sysSetVariableInt(sysvar::RoadMap::EnableTravelDistance,1);
                sysSetVariableInt(sysvar::RoadMap::TravelDistance,1);
                sysSetVariableFloat(sysvar::RoadMap::VehicleSpeedVSOSig,100);
                sysSetVariableInt(sysvar::RoadMap::EngineSpeed,3000);
                sysSetVariableFloat(sysvar::RoadMap::FuelLevel,50);
                sysSetVariableFloat(sysvar::RoadMap::FuelConsumption_GAG,12);
                testWaitForTimeout (Increase_201km);
                sysSetVariableInt(sysvar::RoadMap::EnableTravelDistance,0);
                sysSetVariableInt(sysvar::RoadMap::WC_Ignition_On_EngOn_AUTO,0);
                sysSetVariableFloat(sysvar::RoadMap::VehicleSpeedVSOSig,0);
                sysSetVariableInt(sysvar::RoadMap::EngineSpeed,0);
                sysSetVariableFloat(sysvar::RoadMap::FuelLevel,0);
                sysSetVariableFloat(sysvar::RoadMap::FuelConsumption_GAG,0);
        
}

export testfunction Increase_499km ()
{
  testModuleTitle("Increase_499km ");
  write("Increase_499km ");
  
                sysSetVariableInt(sysvar::RoadMap::OperationalModeSts,8);
                testWaitForTimeout (5000);
                sysSetVariableInt(sysvar::RoadMap::EnableTravelDistance,1);
                sysSetVariableInt(sysvar::RoadMap::TravelDistance,1);
                sysSetVariableFloat(sysvar::RoadMap::VehicleSpeedVSOSig,100);
                sysSetVariableInt(sysvar::RoadMap::EngineSpeed,3000);
                sysSetVariableFloat(sysvar::RoadMap::FuelLevel,50);
                sysSetVariableFloat(sysvar::RoadMap::FuelConsumption_GAG,12);
                testWaitForTimeout (Increase_499km);
                sysSetVariableInt(sysvar::RoadMap::EnableTravelDistance,0);
                sysSetVariableInt(sysvar::RoadMap::WC_Ignition_On_EngOn_AUTO,0);
                sysSetVariableFloat(sysvar::RoadMap::VehicleSpeedVSOSig,0);
                sysSetVariableInt(sysvar::RoadMap::EngineSpeed,0);
                sysSetVariableFloat(sysvar::RoadMap::FuelLevel,0);
                sysSetVariableFloat(sysvar::RoadMap::FuelConsumption_GAG,0);
        
}

export testfunction Increase_1500km ()
{
  testModuleTitle("Increase_499km ");
  write("Increase_499km ");
  
                sysSetVariableInt(sysvar::RoadMap::OperationalModeSts,8);
                testWaitForTimeout (5000);
                sysSetVariableInt(sysvar::RoadMap::EnableTravelDistance,1);
                sysSetVariableInt(sysvar::RoadMap::TravelDistance,1);
                sysSetVariableFloat(sysvar::RoadMap::VehicleSpeedVSOSig,100);
                sysSetVariableInt(sysvar::RoadMap::EngineSpeed,3000);
                sysSetVariableFloat(sysvar::RoadMap::FuelLevel,50);
                sysSetVariableFloat(sysvar::RoadMap::FuelConsumption_GAG,12);
                testWaitForTimeout (Increase_1500km);
                sysSetVariableInt(sysvar::RoadMap::EnableTravelDistance,0);
                sysSetVariableInt(sysvar::RoadMap::WC_Ignition_On_EngOn_AUTO,0);
                sysSetVariableFloat(sysvar::RoadMap::VehicleSpeedVSOSig,0);
                sysSetVariableInt(sysvar::RoadMap::EngineSpeed,0);
                sysSetVariableFloat(sysvar::RoadMap::FuelLevel,0);
                sysSetVariableFloat(sysvar::RoadMap::FuelConsumption_GAG,0);
        
}


//**********Decrease DaysToService **************
//**********Decrease DaysToService **************
export testfunction Decrease_1_day()
{
  testModuleTitle("DECREASE_DAYS");
  write("DECREASE_DAYS");
             
              for (i=1; i<=decrease_1_day; i++)
              {
                sysSetVariableInt(sysvar::RoadMap::Hour1_TLM_Master,0);
                sysSetVariableInt(sysvar::RoadMap::Hour2_TLM_Master,1);
                sysSetVariableInt(sysvar::RoadMap::Minute1_TLM_Master,0);
                sysSetVariableInt(sysvar::RoadMap::Minute2_TLM_Master,1);
                sysSetVariableInt(sysvar::RoadMap::Day1_TLM_Master,0);
                sysSetVariableInt(sysvar::RoadMap::Day2_TLM_Master,Day);
                sysSetVariableInt(sysvar::RoadMap::Month1_TLM_Master,0);
                sysSetVariableInt(sysvar::RoadMap::Month2_TLM_Master,0);
                sysSetVariableInt(sysvar::RoadMap::Year1_TLM_Master,2);
                sysSetVariableInt(sysvar::RoadMap::Year2_TLM_Master,0);
                sysSetVariableInt(sysvar::RoadMap::Year3_TLM_Master,0);
                sysSetVariableInt(sysvar::RoadMap::Year4_TLM_Master,0);
                testWaitForTimeout (500);
                sysSetVariableInt(sysvar::RoadMap::SEND_TIMEDATE_AUTO_MASTER,1);
                testWaitForTimeout (500);
                sysSetVariableInt(sysvar::RoadMap::SEND_TIMEDATE_AUTO_MASTER,0);
                testWaitForTimeout (60000);
              }  
}

export testfunction Decrease_2_days()
{
  testModuleTitle("DECREASE_DAYS");
  write("DECREASE_DAYS");
             
              for (i=1; i<=decrease_2_days; i++)
              {
                sysSetVariableInt(sysvar::RoadMap::Hour1_TLM,2);
                sysSetVariableInt(sysvar::RoadMap::Hour2_TLM,3);
                sysSetVariableInt(sysvar::RoadMap::Minute1_TLM,5);
                sysSetVariableInt(sysvar::RoadMap::Minute2_TLM,9);
                testWaitForTimeout (500);
                sysSetVariableInt(sysvar::RoadMap::SendTimeDate1,1);
                testWaitForTimeout (500);
                sysSetVariableInt(sysvar::RoadMap::SendTimeDate1,0);
                testWaitForTimeout (62000);
              }  
}

export testfunction Decrease_3_days()
{
  testModuleTitle("DECREASE_DAYS");
  write("DECREASE_DAYS");
             
              for (i=1; i<=decrease_3_days; i++)
              {
                sysSetVariableInt(sysvar::RoadMap::Hour1_TLM,2);
                sysSetVariableInt(sysvar::RoadMap::Hour2_TLM,3);
                sysSetVariableInt(sysvar::RoadMap::Minute1_TLM,5);
                sysSetVariableInt(sysvar::RoadMap::Minute2_TLM,9);
                testWaitForTimeout (500);
                sysSetVariableInt(sysvar::RoadMap::SendTimeDate1,1);
                testWaitForTimeout (500);
                sysSetVariableInt(sysvar::RoadMap::SendTimeDate1,0);
                testWaitForTimeout (62000);
              }  
}

export testfunction Decrease_5_days()
{
  testModuleTitle("DECREASE_DAYS");
  write("DECREASE_DAYS");
             
              for (i=1; i<=decrease_5_days; i++)
              {
                sysSetVariableInt(sysvar::RoadMap::Hour1_TLM,2);
                sysSetVariableInt(sysvar::RoadMap::Hour2_TLM,3);
                sysSetVariableInt(sysvar::RoadMap::Minute1_TLM,5);
                sysSetVariableInt(sysvar::RoadMap::Minute2_TLM,9);
                testWaitForTimeout (200);
                sysSetVariableInt(sysvar::RoadMap::SendTimeDate1,1);
                testWaitForTimeout (200);
                sysSetVariableInt(sysvar::RoadMap::SendTimeDate1,0);
                testWaitForTimeout (62000);
              }  
}

export testfunction Decrease_4_days()
{
  testModuleTitle("DECREASE_DAYS");
  write("DECREASE_DAYS");
             
              for (i=1; i<=decrease_4_days; i++)
              {
                sysSetVariableInt(sysvar::RoadMap::Hour1_TLM,2);
                sysSetVariableInt(sysvar::RoadMap::Hour2_TLM,3);
                sysSetVariableInt(sysvar::RoadMap::Minute1_TLM,5);
                sysSetVariableInt(sysvar::RoadMap::Minute2_TLM,9);
                testWaitForTimeout (500);
                sysSetVariableInt(sysvar::RoadMap::SendTimeDate1,1);
                testWaitForTimeout (500);
                sysSetVariableInt(sysvar::RoadMap::SendTimeDate1,0);
                testWaitForTimeout (62000);
              }  
}

export testfunction Decrease_10_days()
{
  testModuleTitle("DECREASE_DAYS");
  write("DECREASE_DAYS");
             
              for (i=1; i<=decrease_10_days; i++)
              {
                sysSetVariableInt(sysvar::RoadMap::Hour1_TLM,2);
                sysSetVariableInt(sysvar::RoadMap::Hour2_TLM,3);
                sysSetVariableInt(sysvar::RoadMap::Minute1_TLM,5);
                sysSetVariableInt(sysvar::RoadMap::Minute2_TLM,9);
                testWaitForTimeout (500);
                sysSetVariableInt(sysvar::RoadMap::SendTimeDate1,1);
                testWaitForTimeout (500);
                sysSetVariableInt(sysvar::RoadMap::SendTimeDate1,0);
                testWaitForTimeout (62000);
              }  
}

export testfunction Decrease_15_days()
{
  testModuleTitle("DECREASE_DAYS");
  write("DECREASE_DAYS");
             
              for (i=1; i<=decrease_15_days; i++)
              {
                sysSetVariableInt(sysvar::RoadMap::Hour1_TLM,2);
                sysSetVariableInt(sysvar::RoadMap::Hour2_TLM,3);
                sysSetVariableInt(sysvar::RoadMap::Minute1_TLM,5);
                sysSetVariableInt(sysvar::RoadMap::Minute2_TLM,9);
                testWaitForTimeout (500);
                sysSetVariableInt(sysvar::RoadMap::SendTimeDate1,1);
                testWaitForTimeout (500);
                sysSetVariableInt(sysvar::RoadMap::SendTimeDate1,0);
                testWaitForTimeout (62000);
              }  
}

export testfunction Decrease_20_days()
{
  testModuleTitle("DECREASE_DAYS");
  write("DECREASE_DAYS");
             
              for (i=1; i<=decrease_20_days; i++)
              {
                sysSetVariableInt(sysvar::RoadMap::Hour1_TLM,2);
                sysSetVariableInt(sysvar::RoadMap::Hour2_TLM,3);
                sysSetVariableInt(sysvar::RoadMap::Minute1_TLM,5);
                sysSetVariableInt(sysvar::RoadMap::Minute2_TLM,9);
                testWaitForTimeout (500);
                sysSetVariableInt(sysvar::RoadMap::SendTimeDate1,1);
                testWaitForTimeout (500);
                sysSetVariableInt(sysvar::RoadMap::SendTimeDate1,0);
                testWaitForTimeout (62000);
              }  
}

export testfunction Decrease_25_days()
{
  testModuleTitle("DECREASE_DAYS");
  write("DECREASE_DAYS");
             
              for (i=1; i<=decrease_25_days; i++)
              {
                sysSetVariableInt(sysvar::RoadMap::Hour1_TLM,2);
                sysSetVariableInt(sysvar::RoadMap::Hour2_TLM,3);
                sysSetVariableInt(sysvar::RoadMap::Minute1_TLM,5);
                sysSetVariableInt(sysvar::RoadMap::Minute2_TLM,9);
                testWaitForTimeout (500);
                sysSetVariableInt(sysvar::RoadMap::SendTimeDate1,1);
                testWaitForTimeout (500);
                sysSetVariableInt(sysvar::RoadMap::SendTimeDate1,0);
                testWaitForTimeout (62000);
              }  
}

export testfunction Decrease_30_days()
{
  testModuleTitle("DECREASE_DAYS");
  write("DECREASE_DAYS");
             
              for (i=1; i<=decrease_30_days; i++)
              {
                sysSetVariableInt(sysvar::RoadMap::Hour1_TLM,2);
                sysSetVariableInt(sysvar::RoadMap::Hour2_TLM,3);
                sysSetVariableInt(sysvar::RoadMap::Minute1_TLM,5);
                sysSetVariableInt(sysvar::RoadMap::Minute2_TLM,9);
                testWaitForTimeout (500);
                sysSetVariableInt(sysvar::RoadMap::SendTimeDate1,1);
                testWaitForTimeout (500);
                sysSetVariableInt(sysvar::RoadMap::SendTimeDate1,0);
                testWaitForTimeout (62000);
              }  
}

export testfunction Decrease_34_days()
{
  testModuleTitle("DECREASE_DAYS");
  write("DECREASE_DAYS");
             
              for (i=1; i<=decrease_34_days; i++)
              {
                sysSetVariableInt(sysvar::RoadMap::Hour1_TLM,2);
                sysSetVariableInt(sysvar::RoadMap::Hour2_TLM,3);
                sysSetVariableInt(sysvar::RoadMap::Minute1_TLM,5);
                sysSetVariableInt(sysvar::RoadMap::Minute2_TLM,9);
                testWaitForTimeout (500);
                sysSetVariableInt(sysvar::RoadMap::SendTimeDate1,1);
                testWaitForTimeout (500);
                sysSetVariableInt(sysvar::RoadMap::SendTimeDate1,0);
                testWaitForTimeout (62000);
              }  
}

export testfunction Decrease_35_days()
{
  testModuleTitle("DECREASE_DAYS");
  write("DECREASE_DAYS");
             
              for (i=1; i<=decrease_35_days; i++)
              {
                sysSetVariableInt(sysvar::RoadMap::Hour1_TLM,2);
                sysSetVariableInt(sysvar::RoadMap::Hour2_TLM,3);
                sysSetVariableInt(sysvar::RoadMap::Minute1_TLM,5);
                sysSetVariableInt(sysvar::RoadMap::Minute2_TLM,9);
                testWaitForTimeout (500);
                sysSetVariableInt(sysvar::RoadMap::SendTimeDate1,1);
                testWaitForTimeout (500);
                sysSetVariableInt(sysvar::RoadMap::SendTimeDate1,0);
                testWaitForTimeout (62000);
              }  
}

export testfunction Decrease_40_days()
{
  testModuleTitle("DECREASE_DAYS");
  write("DECREASE_DAYS");
             
              for (i=1; i<=decrease_40_days; i++)
              {
                sysSetVariableInt(sysvar::RoadMap::Hour1_TLM,2);
                sysSetVariableInt(sysvar::RoadMap::Hour2_TLM,3);
                sysSetVariableInt(sysvar::RoadMap::Minute1_TLM,5);
                sysSetVariableInt(sysvar::RoadMap::Minute2_TLM,9);
                testWaitForTimeout (500);
                sysSetVariableInt(sysvar::RoadMap::SendTimeDate1,1);
                testWaitForTimeout (500);
                sysSetVariableInt(sysvar::RoadMap::SendTimeDate1,0);
                testWaitForTimeout (62000);
              }  
}

export testfunction Decrease_45_days()
{
  testModuleTitle("DECREASE_DAYS");
  write("DECREASE_DAYS");
             
              for (i=1; i<=decrease_45_days; i++)
              {
                sysSetVariableInt(sysvar::RoadMap::Hour1_TLM,2);
                sysSetVariableInt(sysvar::RoadMap::Hour2_TLM,3);
                sysSetVariableInt(sysvar::RoadMap::Minute1_TLM,5);
                sysSetVariableInt(sysvar::RoadMap::Minute2_TLM,9);
                testWaitForTimeout (500);
                sysSetVariableInt(sysvar::RoadMap::SendTimeDate1,1);
                testWaitForTimeout (500);
                sysSetVariableInt(sysvar::RoadMap::SendTimeDate1,0);
                testWaitForTimeout (62000);
              }  
}

export testfunction Decrease_50_days()
{
  testModuleTitle("DECREASE_DAYS");
  write("DECREASE_DAYS");
             
              for (i=1; i<=decrease_50_days; i++)
              {
                sysSetVariableInt(sysvar::RoadMap::Hour1_TLM,2);
                sysSetVariableInt(sysvar::RoadMap::Hour2_TLM,3);
                sysSetVariableInt(sysvar::RoadMap::Minute1_TLM,5);
                sysSetVariableInt(sysvar::RoadMap::Minute2_TLM,9);
                testWaitForTimeout (500);
                sysSetVariableInt(sysvar::RoadMap::SendTimeDate1,1);
                testWaitForTimeout (500);
                sysSetVariableInt(sysvar::RoadMap::SendTimeDate1,0);
                testWaitForTimeout (62000);
              }  
}

export testfunction Decrease_53_days()
{
  testModuleTitle("DECREASE_DAYS");
  write("DECREASE_DAYS");
             
              for (i=1; i<=decrease_53_days; i++)
              {
                sysSetVariableInt(sysvar::RoadMap::Hour1_TLM,2);
                sysSetVariableInt(sysvar::RoadMap::Hour2_TLM,3);
                sysSetVariableInt(sysvar::RoadMap::Minute1_TLM,5);
                sysSetVariableInt(sysvar::RoadMap::Minute2_TLM,9);
                testWaitForTimeout (500);
                sysSetVariableInt(sysvar::RoadMap::SendTimeDate1,1);
                testWaitForTimeout (500);
                sysSetVariableInt(sysvar::RoadMap::SendTimeDate1,0);
                testWaitForTimeout (62000);
              }  
}

export testfunction Decrease_55_days()
{
  testModuleTitle("DECREASE_DAYS");
  write("DECREASE_DAYS");
             
              for (i=1; i<=decrease_55_days; i++)
              {
                sysSetVariableInt(sysvar::RoadMap::Hour1_TLM,2);
                sysSetVariableInt(sysvar::RoadMap::Hour2_TLM,3);
                sysSetVariableInt(sysvar::RoadMap::Minute1_TLM,5);
                sysSetVariableInt(sysvar::RoadMap::Minute2_TLM,9);
                testWaitForTimeout (500);
                sysSetVariableInt(sysvar::RoadMap::SendTimeDate1,1);
                testWaitForTimeout (500);
                sysSetVariableInt(sysvar::RoadMap::SendTimeDate1,0);
                testWaitForTimeout (62000);
              }  
}

export testfunction Decrease_60_days()
{
  testModuleTitle("DECREASE_DAYS");
  write("DECREASE_DAYS");
             
              for (i=1; i<=decrease_60_days; i++)
              {
                sysSetVariableInt(sysvar::RoadMap::Hour1_TLM,2);
                sysSetVariableInt(sysvar::RoadMap::Hour2_TLM,3);
                sysSetVariableInt(sysvar::RoadMap::Minute1_TLM,5);
                sysSetVariableInt(sysvar::RoadMap::Minute2_TLM,9);
                testWaitForTimeout (500);
                sysSetVariableInt(sysvar::RoadMap::SendTimeDate1,1);
                testWaitForTimeout (500);
                sysSetVariableInt(sysvar::RoadMap::SendTimeDate1,0);
                testWaitForTimeout (62000);
              }  
}

export testfunction Decrease_65_days()
{
  testModuleTitle("DECREASE_DAYS");
  write("DECREASE_DAYS");
             
              for (i=1; i<=decrease_65_days; i++)
              {
                sysSetVariableInt(sysvar::RoadMap::Hour1_TLM,2);
                sysSetVariableInt(sysvar::RoadMap::Hour2_TLM,3);
                sysSetVariableInt(sysvar::RoadMap::Minute1_TLM,5);
                sysSetVariableInt(sysvar::RoadMap::Minute2_TLM,9);
                testWaitForTimeout (500);
                sysSetVariableInt(sysvar::RoadMap::SendTimeDate1,1);
                testWaitForTimeout (500);
                sysSetVariableInt(sysvar::RoadMap::SendTimeDate1,0);
                testWaitForTimeout (62000);
              }  
}

export testfunction Decrease_66_days()
{
  testModuleTitle("DECREASE_DAYS");
  write("DECREASE_DAYS");
             
              for (i=1; i<=decrease_66_days; i++)
              {
                sysSetVariableInt(sysvar::RoadMap::Hour1_TLM,2);
                sysSetVariableInt(sysvar::RoadMap::Hour2_TLM,3);
                sysSetVariableInt(sysvar::RoadMap::Minute1_TLM,5);
                sysSetVariableInt(sysvar::RoadMap::Minute2_TLM,9);
                testWaitForTimeout (500);
                sysSetVariableInt(sysvar::RoadMap::SendTimeDate1,1);
                testWaitForTimeout (500);
                sysSetVariableInt(sysvar::RoadMap::SendTimeDate1,0);
                testWaitForTimeout (62000);
              }  
}

export testfunction Decrease_70_days()
{
  testModuleTitle("DECREASE_DAYS");
  write("DECREASE_DAYS");
             
              for (i=1; i<=decrease_70_days; i++)
              {
                sysSetVariableInt(sysvar::RoadMap::Hour1_TLM,2);
                sysSetVariableInt(sysvar::RoadMap::Hour2_TLM,3);
                sysSetVariableInt(sysvar::RoadMap::Minute1_TLM,5);
                sysSetVariableInt(sysvar::RoadMap::Minute2_TLM,9);
                testWaitForTimeout (500);
                sysSetVariableInt(sysvar::RoadMap::SendTimeDate1,1);
                testWaitForTimeout (500);
                sysSetVariableInt(sysvar::RoadMap::SendTimeDate1,0);
                testWaitForTimeout (62000);
              }  
}

export testfunction Decrease_71_days()
{
  testModuleTitle("DECREASE_DAYS");
  write("DECREASE_DAYS");
             
              for (i=1; i<=decrease_71_days; i++)
              {
                sysSetVariableInt(sysvar::RoadMap::Hour1_TLM,2);
                sysSetVariableInt(sysvar::RoadMap::Hour2_TLM,3);
                sysSetVariableInt(sysvar::RoadMap::Minute1_TLM,5);
                sysSetVariableInt(sysvar::RoadMap::Minute2_TLM,9);
                testWaitForTimeout (500);
                sysSetVariableInt(sysvar::RoadMap::SendTimeDate1,1);
                testWaitForTimeout (500);
                sysSetVariableInt(sysvar::RoadMap::SendTimeDate1,0);
                testWaitForTimeout (62000);
              }  
}

export testfunction Decrease_75_days()
{
  testModuleTitle("DECREASE_DAYS");
  write("DECREASE_DAYS");
             
              for (i=1; i<=decrease_75_days; i++)
              {
                sysSetVariableInt(sysvar::RoadMap::Hour1_TLM,2);
                sysSetVariableInt(sysvar::RoadMap::Hour2_TLM,3);
                sysSetVariableInt(sysvar::RoadMap::Minute1_TLM,5);
                sysSetVariableInt(sysvar::RoadMap::Minute2_TLM,9);
                testWaitForTimeout (500);
                sysSetVariableInt(sysvar::RoadMap::SendTimeDate1,1);
                testWaitForTimeout (500);
                sysSetVariableInt(sysvar::RoadMap::SendTimeDate1,0);
                testWaitForTimeout (62000);
              }  
}

export testfunction Decrease_80_days()
{
  testModuleTitle("DECREASE_DAYS");
  write("DECREASE_DAYS");
             
              for (i=1; i<=decrease_80_days; i++)
              {
                sysSetVariableInt(sysvar::RoadMap::Hour1_TLM,2);
                sysSetVariableInt(sysvar::RoadMap::Hour2_TLM,3);
                sysSetVariableInt(sysvar::RoadMap::Minute1_TLM,5);
                sysSetVariableInt(sysvar::RoadMap::Minute2_TLM,9);
                testWaitForTimeout (500);
                sysSetVariableInt(sysvar::RoadMap::SendTimeDate1,1);
                testWaitForTimeout (500);
                sysSetVariableInt(sysvar::RoadMap::SendTimeDate1,0);
                testWaitForTimeout (62000);
              }  
}

export testfunction Decrease_85_days()
{
  testModuleTitle("DECREASE_DAYS");
  write("DECREASE_DAYS");
             
              for (i=1; i<=decrease_85_days; i++)
              {
                sysSetVariableInt(sysvar::RoadMap::Hour1_TLM,2);
                sysSetVariableInt(sysvar::RoadMap::Hour2_TLM,3);
                sysSetVariableInt(sysvar::RoadMap::Minute1_TLM,5);
                sysSetVariableInt(sysvar::RoadMap::Minute2_TLM,9);
                testWaitForTimeout (500);
                sysSetVariableInt(sysvar::RoadMap::SendTimeDate1,1);
                testWaitForTimeout (500);
                sysSetVariableInt(sysvar::RoadMap::SendTimeDate1,0);
                testWaitForTimeout (62000);
              }  
}

export testfunction Decrease_90_days()
{
  testModuleTitle("DECREASE_DAYS");
  write("DECREASE_DAYS");
             
              for (i=1; i<=decrease_90_days; i++)
              {
                sysSetVariableInt(sysvar::RoadMap::Hour1_TLM,2);
                sysSetVariableInt(sysvar::RoadMap::Hour2_TLM,3);
                sysSetVariableInt(sysvar::RoadMap::Minute1_TLM,5);
                sysSetVariableInt(sysvar::RoadMap::Minute2_TLM,9);
                testWaitForTimeout (500);
                sysSetVariableInt(sysvar::RoadMap::SendTimeDate1,1);
                testWaitForTimeout (500);
                sysSetVariableInt(sysvar::RoadMap::SendTimeDate1,0);
                testWaitForTimeout (62000);
              }  
}

export testfunction Decrease_95_days()
{
  testModuleTitle("DECREASE_DAYS");
  write("DECREASE_DAYS");
             
              for (i=1; i<=decrease_95_days; i++)
              {
                sysSetVariableInt(sysvar::RoadMap::Hour1_TLM,2);
                sysSetVariableInt(sysvar::RoadMap::Hour2_TLM,3);
                sysSetVariableInt(sysvar::RoadMap::Minute1_TLM,5);
                sysSetVariableInt(sysvar::RoadMap::Minute2_TLM,9);
                testWaitForTimeout (500);
                sysSetVariableInt(sysvar::RoadMap::SendTimeDate1,1);
                testWaitForTimeout (500);
                sysSetVariableInt(sysvar::RoadMap::SendTimeDate1,0);
                testWaitForTimeout (62000);
              }  
}

export testfunction Decrease_100_days()
{
  testModuleTitle("DECREASE_DAYS");
  write("DECREASE_DAYS");
             
              for (i=1; i<=decrease_100_days; i++)
              {
                sysSetVariableInt(sysvar::RoadMap::Hour1_TLM,2);
                sysSetVariableInt(sysvar::RoadMap::Hour2_TLM,3);
                sysSetVariableInt(sysvar::RoadMap::Minute1_TLM,5);
                sysSetVariableInt(sysvar::RoadMap::Minute2_TLM,9);
                testWaitForTimeout (500);
                sysSetVariableInt(sysvar::RoadMap::SendTimeDate1,1);
                testWaitForTimeout (500);
                sysSetVariableInt(sysvar::RoadMap::SendTimeDate1,0);
                testWaitForTimeout (62000);
              }  
}

export testfunction Decrease_335_days()
{
  testModuleTitle("DECREASE_DAYS");
  write("DECREASE_DAYS");
             
              for (i=1; i<=decrease_335_days; i++)
              {
                sysSetVariableInt(sysvar::RoadMap::Hour1_TLM,2);
                sysSetVariableInt(sysvar::RoadMap::Hour2_TLM,3);
                sysSetVariableInt(sysvar::RoadMap::Minute1_TLM,5);
                sysSetVariableInt(sysvar::RoadMap::Minute2_TLM,9);
                testWaitForTimeout (500);
                sysSetVariableInt(sysvar::RoadMap::SendTimeDate1,1);
                testWaitForTimeout (500);
                sysSetVariableInt(sysvar::RoadMap::SendTimeDate1,0);
                testWaitForTimeout (62000);
              }  
}

export testfunction Decrease_365_days()
{
  testModuleTitle("DECREASE_DAYS");
  write("DECREASE_DAYS");
             
              for (i=1; i<=decrease_365_days; i++)
              {
                sysSetVariableInt(sysvar::RoadMap::Hour1_TLM,2);
                sysSetVariableInt(sysvar::RoadMap::Hour2_TLM,3);
                sysSetVariableInt(sysvar::RoadMap::Minute1_TLM,5);
                sysSetVariableInt(sysvar::RoadMap::Minute2_TLM,9);
                testWaitForTimeout (500);
                sysSetVariableInt(sysvar::RoadMap::SendTimeDate1,1);
                testWaitForTimeout (500);
                sysSetVariableInt(sysvar::RoadMap::SendTimeDate1,0);
                testWaitForTimeout (62000);
              }  
}

/*PROXI*/

export testfunction PROXI_Km_To_Service_2500km()
{
  testModuleTitle("PROXI_Km_To_Service_2500km");
  //write("PROXI_Km_To_Service_2500km");
  
    sysSetVariableInt(sysvar::SysVar_PROXI::DIAG_ProxiLesen,1);
    testWaitForTimeout (200);
    sysSetVariableInt(sysvar::SysVar_PROXI::DIAG_ProxiLesen,0);
    testWaitForTimeout (200);
	  sysSetVariableInt(sysvar::SysVar_PROXI::pByte75,2500);		
	  sysSetVariableInt(sysvar::SysVar_PROXI::DIAG_eLoadAll,1);
    testWaitForTimeout (200);
    sysSetVariableInt(sysvar::SysVar_PROXI::DIAG_eLoadAll,0);
    testWaitForTimeout (1000);
	  sysSetVariableInt(sysvar::SysVar_PROXI::DIAG_eSendProxi,1);
    testWaitForTimeout (200);
    sysSetVariableInt(sysvar::SysVar_PROXI::DIAG_eSendProxi,0);
    testWaitForTimeout (200);
				
}

export testfunction PROXI_Km_To_Service_127500km()
{
  testModuleTitle("PROXI_Km_To_Service_127500km");
  //write("PROXI_Km_To_Service_127500km");
  
    sysSetVariableInt(sysvar::SysVar_PROXI::DIAG_ProxiLesen,1);
    testWaitForTimeout (200);
    sysSetVariableInt(sysvar::SysVar_PROXI::DIAG_ProxiLesen,0);
    testWaitForTimeout (200);
	  sysSetVariableInt(sysvar::SysVar_PROXI::pByte75,255);		
	  sysSetVariableInt(sysvar::SysVar_PROXI::DIAG_eLoadAll,1);
    testWaitForTimeout (200);
    sysSetVariableInt(sysvar::SysVar_PROXI::DIAG_eLoadAll,0);
    testWaitForTimeout (1000);
	  sysSetVariableInt(sysvar::SysVar_PROXI::DIAG_eSendProxi,1);
    testWaitForTimeout (200);
    sysSetVariableInt(sysvar::SysVar_PROXI::DIAG_eSendProxi,0);
    testWaitForTimeout (200);
				
}

export testfunction PROXI_Km_To_Service_0km()
{
  testModuleTitle("PROXI_Km_To_Service_0km");
  //write("PROXI_Km_To_Service_0km");
  
    sysSetVariableInt(sysvar::SysVar_PROXI::DIAG_ProxiLesen,1);
    testWaitForTimeout (200);
    sysSetVariableInt(sysvar::SysVar_PROXI::DIAG_ProxiLesen,0);
    testWaitForTimeout (200);
	  sysSetVariableInt(sysvar::SysVar_PROXI::pByte75,0);		
	  sysSetVariableInt(sysvar::SysVar_PROXI::DIAG_eLoadAll,1);
    testWaitForTimeout (200);
    sysSetVariableInt(sysvar::SysVar_PROXI::DIAG_eLoadAll,0);
    testWaitForTimeout (1000);
	  sysSetVariableInt(sysvar::SysVar_PROXI::DIAG_eSendProxi,1);
    testWaitForTimeout (200);
    sysSetVariableInt(sysvar::SysVar_PROXI::DIAG_eSendProxi,0);
    testWaitForTimeout (200);
				
}

export testfunction PROXI_Km_To_Service_2000km()
{
  testModuleTitle("PROXI_Km_To_Service_2000km");
  //write("PROXI_Km_To_Service_2000km");
  
    sysSetVariableInt(sysvar::SysVar_PROXI::DIAG_ProxiLesen,1);
    testWaitForTimeout (200);
    sysSetVariableInt(sysvar::SysVar_PROXI::DIAG_ProxiLesen,0);
    testWaitForTimeout (200);
	  sysSetVariableInt(sysvar::SysVar_PROXI::pByte75,4);		
	  sysSetVariableInt(sysvar::SysVar_PROXI::DIAG_eLoadAll,1);
    testWaitForTimeout (200);
    sysSetVariableInt(sysvar::SysVar_PROXI::DIAG_eLoadAll,0);
    testWaitForTimeout (200);
	  sysSetVariableInt(sysvar::SysVar_PROXI::DIAG_eSendProxi,1);
    testWaitForTimeout (200);
    sysSetVariableInt(sysvar::SysVar_PROXI::DIAG_eSendProxi,0);
    testWaitForTimeout (200);
				
}

export testfunction PROXI_Km_To_Service_500km()
{
  testModuleTitle("PROXI_Km_To_Service_500km");
  //write("PROXI_Km_To_Service_500km");
  
    sysSetVariableInt(sysvar::SysVar_PROXI::DIAG_ProxiLesen,1);
    testWaitForTimeout (200);
    sysSetVariableInt(sysvar::SysVar_PROXI::DIAG_ProxiLesen,0);
    testWaitForTimeout (200);
	  sysSetVariableInt(sysvar::SysVar_PROXI::pByte75,1);		
	  sysSetVariableInt(sysvar::SysVar_PROXI::DIAG_eLoadAll,1);
    testWaitForTimeout (200);
    sysSetVariableInt(sysvar::SysVar_PROXI::DIAG_eLoadAll,0);
    testWaitForTimeout (1000);
	  sysSetVariableInt(sysvar::SysVar_PROXI::DIAG_eSendProxi,1);
    testWaitForTimeout (200);
    sysSetVariableInt(sysvar::SysVar_PROXI::DIAG_eSendProxi,0);
    testWaitForTimeout (200);
				
}

export testfunction PROXI_Days_To_Service_1275days()
{
  testModuleTitle("PROXI_Days_To_Service_1275days");
  //write("PROXI_Days_To_Service_1275days");
  
    sysSetVariableInt(sysvar::SysVar_PROXI::DIAG_ProxiLesen,1);
    testWaitForTimeout (200);
    sysSetVariableInt(sysvar::SysVar_PROXI::DIAG_ProxiLesen,0);
    testWaitForTimeout (200);
	  sysSetVariableInt(sysvar::SysVar_PROXI::pByte128,255);		
	  sysSetVariableInt(sysvar::SysVar_PROXI::DIAG_eLoadAll,1);
    testWaitForTimeout (200);
    sysSetVariableInt(sysvar::SysVar_PROXI::DIAG_eLoadAll,0);
    testWaitForTimeout (200);
	  sysSetVariableInt(sysvar::SysVar_PROXI::DIAG_eSendProxi,1);
    testWaitForTimeout (200);
    sysSetVariableInt(sysvar::SysVar_PROXI::DIAG_eSendProxi,0);
    testWaitForTimeout (200);
				
}

export testfunction PROXI_Days_To_Service_35days()
{
  testModuleTitle("PROXI_Days_To_Service_35days");
  //write("PROXI_Days_To_Service_35days");
  
    sysSetVariableInt(sysvar::SysVar_PROXI::DIAG_ProxiLesen,1);
    testWaitForTimeout (200);
    sysSetVariableInt(sysvar::SysVar_PROXI::DIAG_ProxiLesen,0);
    testWaitForTimeout (200);
	  sysSetVariableInt(sysvar::SysVar_PROXI::pByte128,7);		
	  sysSetVariableInt(sysvar::SysVar_PROXI::DIAG_eLoadAll,1);
    testWaitForTimeout (200);
    sysSetVariableInt(sysvar::SysVar_PROXI::DIAG_eLoadAll,0);
    testWaitForTimeout (1000);
	  sysSetVariableInt(sysvar::SysVar_PROXI::DIAG_eSendProxi,1);
    testWaitForTimeout (200);
    sysSetVariableInt(sysvar::SysVar_PROXI::DIAG_eSendProxi,0);
    testWaitForTimeout (200);
				
}

export testfunction PROXI_Days_To_Service_5days()
{
  testModuleTitle("PROXI_Days_To_Service_5days");
  //write("PROXI_Days_To_Service_5days");
  
    sysSetVariableInt(sysvar::SysVar_PROXI::DIAG_ProxiLesen,1);
    testWaitForTimeout (200);
    sysSetVariableInt(sysvar::SysVar_PROXI::DIAG_ProxiLesen,0);
    testWaitForTimeout (200);
	  sysSetVariableInt(sysvar::SysVar_PROXI::pByte128,1);		
	  sysSetVariableInt(sysvar::SysVar_PROXI::DIAG_eLoadAll,1);
    testWaitForTimeout (200);
    sysSetVariableInt(sysvar::SysVar_PROXI::DIAG_eLoadAll,0);
    testWaitForTimeout (200);
	  sysSetVariableInt(sysvar::SysVar_PROXI::DIAG_eSendProxi,1);
    testWaitForTimeout (200);
    sysSetVariableInt(sysvar::SysVar_PROXI::DIAG_eSendProxi,0);
    testWaitForTimeout (200);
				
}

export testfunction PROXI_Days_To_Service_30days()
{
  testModuleTitle("PROXI_Days_To_Service_30days");
  //write("PROXI_Days_To_Service_30days");
  
    sysSetVariableInt(sysvar::SysVar_PROXI::DIAG_ProxiLesen,1);
    testWaitForTimeout (200);
    sysSetVariableInt(sysvar::SysVar_PROXI::DIAG_ProxiLesen,0);
    testWaitForTimeout (200);
	  sysSetVariableInt(sysvar::SysVar_PROXI::pByte128,6);		
	  sysSetVariableInt(sysvar::SysVar_PROXI::DIAG_eLoadAll,1);
    testWaitForTimeout (200);
    sysSetVariableInt(sysvar::SysVar_PROXI::DIAG_eLoadAll,0);
    testWaitForTimeout (1000);
	  sysSetVariableInt(sysvar::SysVar_PROXI::DIAG_eSendProxi,1);
    testWaitForTimeout (200);
    sysSetVariableInt(sysvar::SysVar_PROXI::DIAG_eSendProxi,0);
    testWaitForTimeout (200);
				
}

export testfunction PROXI_Days_To_Service_10days()
{
  testModuleTitle("PROXI_Days_To_Service_10days");
  //write("PROXI_Days_To_Service_10days");
  
    sysSetVariableInt(sysvar::SysVar_PROXI::DIAG_ProxiLesen,1);
    testWaitForTimeout (200);
    sysSetVariableInt(sysvar::SysVar_PROXI::DIAG_ProxiLesen,0);
    testWaitForTimeout (200);
	  sysSetVariableInt(sysvar::SysVar_PROXI::pByte128,10);		
	  sysSetVariableInt(sysvar::SysVar_PROXI::DIAG_eLoadAll,1);
    testWaitForTimeout (200);
    sysSetVariableInt(sysvar::SysVar_PROXI::DIAG_eLoadAll,0);
    testWaitForTimeout (200);
	  sysSetVariableInt(sysvar::SysVar_PROXI::DIAG_eSendProxi,1);
    testWaitForTimeout (200);
    sysSetVariableInt(sysvar::SysVar_PROXI::DIAG_eSendProxi,0);
    testWaitForTimeout (200);
				
}

export testfunction PROXI_Days_To_Service_0days()
{
  testModuleTitle("PROXI_Days_To_Service_0days");
  //write("PROXI_Days_To_Service_0days");
  
    sysSetVariableInt(sysvar::SysVar_PROXI::DIAG_ProxiLesen,1);
    testWaitForTimeout (200);
    sysSetVariableInt(sysvar::SysVar_PROXI::DIAG_ProxiLesen,0);
    testWaitForTimeout (200);
	  sysSetVariableInt(sysvar::SysVar_PROXI::pByte128,0);		
	  sysSetVariableInt(sysvar::SysVar_PROXI::DIAG_eLoadAll,1);
    testWaitForTimeout (200);
    sysSetVariableInt(sysvar::SysVar_PROXI::DIAG_eLoadAll,0);
    testWaitForTimeout (1000);
	  sysSetVariableInt(sysvar::SysVar_PROXI::DIAG_eSendProxi,1);
    testWaitForTimeout (200);
    sysSetVariableInt(sysvar::SysVar_PROXI::DIAG_eSendProxi,0);
    testWaitForTimeout (200);
				
}

export testfunction PROXI_2500km_35days()
{
  testModuleTitle("PROXI_2500km_35_days");
  //write("PROXI_2500km_35_days");
  
    sysSetVariableInt(sysvar::SysVar_PROXI::DIAG_ProxiLesen,1);
    testWaitForTimeout (200);
    sysSetVariableInt(sysvar::SysVar_PROXI::DIAG_ProxiLesen,0);
    testWaitForTimeout (200);
	  sysSetVariableInt(sysvar::SysVar_PROXI::pByte75,5);
    sysSetVariableInt(sysvar::SysVar_PROXI::pByte128,7);
	  sysSetVariableInt(sysvar::SysVar_PROXI::DIAG_eLoadAll,1);
    testWaitForTimeout (200);
    sysSetVariableInt(sysvar::SysVar_PROXI::DIAG_eLoadAll,0);
    testWaitForTimeout (200);
	  sysSetVariableInt(sysvar::SysVar_PROXI::DIAG_eSendProxi,1);
    testWaitForTimeout (200);
    sysSetVariableInt(sysvar::SysVar_PROXI::DIAG_eSendProxi,0);
    testWaitForTimeout (200);
				
}

export testfunction PROXI_1500km_35days()
{
  testModuleTitle("PROXI_1500km_35_days");
  //write("PROXI_1500km_35_days");
  
    sysSetVariableInt(sysvar::SysVar_PROXI::DIAG_ProxiLesen,1);
    testWaitForTimeout (200);
    sysSetVariableInt(sysvar::SysVar_PROXI::DIAG_ProxiLesen,0);
    testWaitForTimeout (200);
	  sysSetVariableInt(sysvar::SysVar_PROXI::pByte75,3);
    sysSetVariableInt(sysvar::SysVar_PROXI::pByte128,7);
	  sysSetVariableInt(sysvar::SysVar_PROXI::DIAG_eLoadAll,1);
    testWaitForTimeout (200);
    sysSetVariableInt(sysvar::SysVar_PROXI::DIAG_eLoadAll,0);
    testWaitForTimeout (1000);
	  sysSetVariableInt(sysvar::SysVar_PROXI::DIAG_eSendProxi,1);
    testWaitForTimeout (200);
    sysSetVariableInt(sysvar::SysVar_PROXI::DIAG_eSendProxi,0);
    testWaitForTimeout (200);
				
}

export testfunction PROXI_1000km_30days()
{
  testModuleTitle("PROXI_1000km_30_days");
  //write("PROXI_1000km_30_days");
  
    sysSetVariableInt(sysvar::SysVar_PROXI::DIAG_ProxiLesen,1);
    testWaitForTimeout (200);
    sysSetVariableInt(sysvar::SysVar_PROXI::DIAG_ProxiLesen,0);
    testWaitForTimeout (200);
	  sysSetVariableInt(sysvar::SysVar_PROXI::pByte75,2);
    sysSetVariableInt(sysvar::SysVar_PROXI::pByte128,6);
	  sysSetVariableInt(sysvar::SysVar_PROXI::DIAG_eLoadAll,1);
    testWaitForTimeout (200);
    sysSetVariableInt(sysvar::SysVar_PROXI::DIAG_eLoadAll,0);
    testWaitForTimeout (1000);
	  sysSetVariableInt(sysvar::SysVar_PROXI::DIAG_eSendProxi,1);
    testWaitForTimeout (200);
    sysSetVariableInt(sysvar::SysVar_PROXI::DIAG_eSendProxi,0);
    testWaitForTimeout (200);
				
}

export testfunction PROXI_1500km_0days()
{
  testModuleTitle("PROXI_1500km_0days");
  //write("PROXI_1500km_0days");
  
    sysSetVariableInt(sysvar::SysVar_PROXI::DIAG_ProxiLesen,1);
    testWaitForTimeout (200);
    sysSetVariableInt(sysvar::SysVar_PROXI::DIAG_ProxiLesen,0);
    testWaitForTimeout (200);
	  sysSetVariableInt(sysvar::SysVar_PROXI::pByte75,3);
    sysSetVariableInt(sysvar::SysVar_PROXI::pByte128,0);
	  sysSetVariableInt(sysvar::SysVar_PROXI::DIAG_eLoadAll,1);
    testWaitForTimeout (200);
    sysSetVariableInt(sysvar::SysVar_PROXI::DIAG_eLoadAll,0);
    testWaitForTimeout (1000);
	  sysSetVariableInt(sysvar::SysVar_PROXI::DIAG_eSendProxi,1);
    testWaitForTimeout (200);
    sysSetVariableInt(sysvar::SysVar_PROXI::DIAG_eSendProxi,0);
    testWaitForTimeout (200);
				
}

export testfunction PROXI_0km_35days()
{
  testModuleTitle("PROXI_0km_35days");
  //write("PROXI_0km_35days");
  
    sysSetVariableInt(sysvar::SysVar_PROXI::DIAG_ProxiLesen,1);
    testWaitForTimeout (200);
    sysSetVariableInt(sysvar::SysVar_PROXI::DIAG_ProxiLesen,0);
    testWaitForTimeout (200);
	  sysSetVariableInt(sysvar::SysVar_PROXI::pByte75,0);
    sysSetVariableInt(sysvar::SysVar_PROXI::pByte128,7);
	  sysSetVariableInt(sysvar::SysVar_PROXI::DIAG_eLoadAll,1);
    testWaitForTimeout (200);
    sysSetVariableInt(sysvar::SysVar_PROXI::DIAG_eLoadAll,0);
    testWaitForTimeout (1000);
	  sysSetVariableInt(sysvar::SysVar_PROXI::DIAG_eSendProxi,1);
    testWaitForTimeout (200);
    sysSetVariableInt(sysvar::SysVar_PROXI::DIAG_eSendProxi,0);
    testWaitForTimeout (200);
				
}

export testfunction PROXI_10000km_365days()
{
  testModuleTitle("PROXI_10000km_365days");
  //write("PROXI_10000km_365days");
  
    sysSetVariableInt(sysvar::SysVar_PROXI::DIAG_ProxiLesen,1);
    testWaitForTimeout (200);
    sysSetVariableInt(sysvar::SysVar_PROXI::DIAG_ProxiLesen,0);
    testWaitForTimeout (200);
	  sysSetVariableInt(sysvar::SysVar_PROXI::pByte75,20);
    sysSetVariableInt(sysvar::SysVar_PROXI::pByte128,73);
	  sysSetVariableInt(sysvar::SysVar_PROXI::DIAG_eLoadAll,1);
    testWaitForTimeout (200);
    sysSetVariableInt(sysvar::SysVar_PROXI::DIAG_eLoadAll,0);
    testWaitForTimeout (1000);
	  sysSetVariableInt(sysvar::SysVar_PROXI::DIAG_eSendProxi,1);
    testWaitForTimeout (200);
    sysSetVariableInt(sysvar::SysVar_PROXI::DIAG_eSendProxi,0);
    testWaitForTimeout (200);
				
}

export testfunction PROXI_10000km_0days()
{
  testModuleTitle("PROXI_10000km_0days");
  //write("PROXI_10000km_0days");
  
    sysSetVariableInt(sysvar::SysVar_PROXI::DIAG_ProxiLesen,1);
    testWaitForTimeout (200);
    sysSetVariableInt(sysvar::SysVar_PROXI::DIAG_ProxiLesen,0);
    testWaitForTimeout (200);
	  sysSetVariableInt(sysvar::SysVar_PROXI::pByte75,20);
    sysSetVariableInt(sysvar::SysVar_PROXI::pByte128,0);
	  sysSetVariableInt(sysvar::SysVar_PROXI::DIAG_eLoadAll,1);
    testWaitForTimeout (200);
    sysSetVariableInt(sysvar::SysVar_PROXI::DIAG_eLoadAll,0);
    testWaitForTimeout (1000);
	  sysSetVariableInt(sysvar::SysVar_PROXI::DIAG_eSendProxi,1);
    testWaitForTimeout (200);
    sysSetVariableInt(sysvar::SysVar_PROXI::DIAG_eSendProxi,0);
    testWaitForTimeout (200);
				
}

export testfunction PROXI_20000km_365days()
{
  testModuleTitle("PROXI_20000km_365days");
  //write("PROXI_20000km_365days");
  
    sysSetVariableInt(sysvar::SysVar_PROXI::DIAG_ProxiLesen,1);
    testWaitForTimeout (200);
    sysSetVariableInt(sysvar::SysVar_PROXI::DIAG_ProxiLesen,0);
    testWaitForTimeout (200);
	  sysSetVariableInt(sysvar::SysVar_PROXI::pByte75,40);
    sysSetVariableInt(sysvar::SysVar_PROXI::pByte128,73);
	  sysSetVariableInt(sysvar::SysVar_PROXI::DIAG_eLoadAll,1);
    testWaitForTimeout (1000);
    sysSetVariableInt(sysvar::SysVar_PROXI::DIAG_eLoadAll,0);
    testWaitForTimeout (2000);
	  sysSetVariableInt(sysvar::SysVar_PROXI::DIAG_eSendProxi,1);
    testWaitForTimeout (1000);
    sysSetVariableInt(sysvar::SysVar_PROXI::DIAG_eSendProxi,0);
    testWaitForTimeout (1000);
				
}

export testfunction PROXI_20000km_0days()
{
  testModuleTitle("PROXI_20000km_0days");
  //write("PROXI_20000km_0days");
  
    sysSetVariableInt(sysvar::SysVar_PROXI::DIAG_ProxiLesen,1);
    testWaitForTimeout (200);
    sysSetVariableInt(sysvar::SysVar_PROXI::DIAG_ProxiLesen,0);
    testWaitForTimeout (200);
	  sysSetVariableInt(sysvar::SysVar_PROXI::pByte75,40);
    sysSetVariableInt(sysvar::SysVar_PROXI::pByte128,0);
	  sysSetVariableInt(sysvar::SysVar_PROXI::DIAG_eLoadAll,1);
    testWaitForTimeout (200);
    sysSetVariableInt(sysvar::SysVar_PROXI::DIAG_eLoadAll,0);
    testWaitForTimeout (1000);
	  sysSetVariableInt(sysvar::SysVar_PROXI::DIAG_eSendProxi,1);
    testWaitForTimeout (200);
    sysSetVariableInt(sysvar::SysVar_PROXI::DIAG_eSendProxi,0);
    testWaitForTimeout (200);
				
}

export testfunction PROXI_0km_365days()
{
  testModuleTitle("PROXI_0km_365days");
  //write("PROXI_20000km_365days");
  
    sysSetVariableInt(sysvar::SysVar_PROXI::DIAG_ProxiLesen,1);
    testWaitForTimeout (200);
    sysSetVariableInt(sysvar::SysVar_PROXI::DIAG_ProxiLesen,0);
    testWaitForTimeout (200);
	  sysSetVariableInt(sysvar::SysVar_PROXI::pByte75,0);
    sysSetVariableInt(sysvar::SysVar_PROXI::pByte128,73);
	  sysSetVariableInt(sysvar::SysVar_PROXI::DIAG_eLoadAll,1);
    testWaitForTimeout (200);
    sysSetVariableInt(sysvar::SysVar_PROXI::DIAG_eLoadAll,0);
    testWaitForTimeout (1000);
	  sysSetVariableInt(sysvar::SysVar_PROXI::DIAG_eSendProxi,1);
    testWaitForTimeout (200);
    sysSetVariableInt(sysvar::SysVar_PROXI::DIAG_eSendProxi,0);
    testWaitForTimeout (200);
				
}

export testfunction PROXI_127500km_1275days()
{
  testModuleTitle("PROXI_127500km_1275days");
  //write("PROXI_127500km_1275days");
  
    sysSetVariableInt(sysvar::SysVar_PROXI::DIAG_ProxiLesen,1);
    testWaitForTimeout (200);
    sysSetVariableInt(sysvar::SysVar_PROXI::DIAG_ProxiLesen,0);
    testWaitForTimeout (200);
	  sysSetVariableInt(sysvar::SysVar_PROXI::pByte75,255);
    sysSetVariableInt(sysvar::SysVar_PROXI::pByte128,255);
	  sysSetVariableInt(sysvar::SysVar_PROXI::DIAG_eLoadAll,1);
    testWaitForTimeout (200);
    sysSetVariableInt(sysvar::SysVar_PROXI::DIAG_eLoadAll,0);
    testWaitForTimeout (200);
	  sysSetVariableInt(sysvar::SysVar_PROXI::DIAG_eSendProxi,1);
    testWaitForTimeout (200);
    sysSetVariableInt(sysvar::SysVar_PROXI::DIAG_eSendProxi,0);
    testWaitForTimeout (200);
				
}

export testfunction PROXI_127500km_0days()
{
  testModuleTitle("PROXI_127500km_1275days");
  //write("PROXI_127500km_1275days");
  
    sysSetVariableInt(sysvar::SysVar_PROXI::DIAG_ProxiLesen,1);
    testWaitForTimeout (200);
    sysSetVariableInt(sysvar::SysVar_PROXI::DIAG_ProxiLesen,0);
    testWaitForTimeout (200);
	  sysSetVariableInt(sysvar::SysVar_PROXI::pByte75,255);
    sysSetVariableInt(sysvar::SysVar_PROXI::pByte128,0);
	  sysSetVariableInt(sysvar::SysVar_PROXI::DIAG_eLoadAll,1);
    testWaitForTimeout (200);
    sysSetVariableInt(sysvar::SysVar_PROXI::DIAG_eLoadAll,0);
    testWaitForTimeout (1000);
	  sysSetVariableInt(sysvar::SysVar_PROXI::DIAG_eSendProxi,1);
    testWaitForTimeout (200);
    sysSetVariableInt(sysvar::SysVar_PROXI::DIAG_eSendProxi,0);
    testWaitForTimeout (200);
				
}

export testfunction PROXI_0km_1275days()
{
  testModuleTitle("PROXI_127500km_1275days");
  //write("PROXI_127500km_1275days");
  
    sysSetVariableInt(sysvar::SysVar_PROXI::DIAG_ProxiLesen,1);
    testWaitForTimeout (200);
    sysSetVariableInt(sysvar::SysVar_PROXI::DIAG_ProxiLesen,0);
    testWaitForTimeout (200);
	  sysSetVariableInt(sysvar::SysVar_PROXI::pByte75,0);
    sysSetVariableInt(sysvar::SysVar_PROXI::pByte128,255);
	  sysSetVariableInt(sysvar::SysVar_PROXI::DIAG_eLoadAll,1);
    testWaitForTimeout (200);
    sysSetVariableInt(sysvar::SysVar_PROXI::DIAG_eLoadAll,0);
    testWaitForTimeout (1000);
	  sysSetVariableInt(sysvar::SysVar_PROXI::DIAG_eSendProxi,1);
    testWaitForTimeout (200);
    sysSetVariableInt(sysvar::SysVar_PROXI::DIAG_eSendProxi,0);
    testWaitForTimeout (200);
				
}



export testfunction PROXI_0km_0days()
{
  testModuleTitle("PROXI_127500km_1275days");
  //write("PROXI_127500km_1275days");
  
    sysSetVariableInt(sysvar::SysVar_PROXI::DIAG_ProxiLesen,1);
    testWaitForTimeout (200);
    sysSetVariableInt(sysvar::SysVar_PROXI::DIAG_ProxiLesen,0);
    testWaitForTimeout (200);
	  sysSetVariableInt(sysvar::SysVar_PROXI::pByte75,0);
    sysSetVariableInt(sysvar::SysVar_PROXI::pByte128,0);
	  sysSetVariableInt(sysvar::SysVar_PROXI::DIAG_eLoadAll,1);
    testWaitForTimeout (200);
    sysSetVariableInt(sysvar::SysVar_PROXI::DIAG_eLoadAll,0);
    testWaitForTimeout (1000);
	  sysSetVariableInt(sysvar::SysVar_PROXI::DIAG_eSendProxi,1);
    testWaitForTimeout (200);
    sysSetVariableInt(sysvar::SysVar_PROXI::DIAG_eSendProxi,0);
    testWaitForTimeout (200);
				
}

export testfunction PROXI_2000km_30days()
{
  testModuleTitle("PROXI_2500km_35_days");
  //write("PROXI_2500km_35_days");
  
    sysSetVariableInt(sysvar::SysVar_PROXI::DIAG_ProxiLesen,1);
    testWaitForTimeout (200);
    sysSetVariableInt(sysvar::SysVar_PROXI::DIAG_ProxiLesen,0);
    testWaitForTimeout (200);
	  sysSetVariableInt(sysvar::SysVar_PROXI::pByte75,254);
    sysSetVariableInt(sysvar::SysVar_PROXI::pByte128,254);
	  sysSetVariableInt(sysvar::SysVar_PROXI::DIAG_eLoadAll,1);
    testWaitForTimeout (200);
    sysSetVariableInt(sysvar::SysVar_PROXI::DIAG_eLoadAll,0);
    testWaitForTimeout (1000);
	  sysSetVariableInt(sysvar::SysVar_PROXI::DIAG_eSendProxi,1);
    testWaitForTimeout (200);
    sysSetVariableInt(sysvar::SysVar_PROXI::DIAG_eSendProxi,0);
    testWaitForTimeout (200);
				
}

export testfunction LanguageSelection_Italian()
{
  testModuleTitle("LanguageSelection_Italian");
  write("LanguageSelection_Italian");
  
                sysSetVariableInt(sysvar::RoadMap::LanguageSelection_Req,0);
                testWaitForTimeout (500);
                sysSetVariableInt(sysvar::RoadMap::SendVehicleSetup,1);
                testWaitForTimeout (500);
                sysSetVariableInt(sysvar::RoadMap::SendVehicleSetup,0);
                testWaitForTimeout (500);
}

export testfunction LanguageSelection_Deutsch()
{
  testModuleTitle("LanguageSelection_Deutsch");
  write("LanguageSelection_Deutsch");
  
                sysSetVariableInt(sysvar::RoadMap::LanguageSelection_Req,1);
                testWaitForTimeout (500);
                sysSetVariableInt(sysvar::RoadMap::SendVehicleSetup,1);
                testWaitForTimeout (500);
                sysSetVariableInt(sysvar::RoadMap::SendVehicleSetup,0);
                testWaitForTimeout (500);
}

export testfunction LanguageSelection_English_UK()
{
  testModuleTitle("LanguageSelection_English_UK");
  write("LanguageSelection_English_UK");
  
                sysSetVariableInt(sysvar::RoadMap::LanguageSelection_Req,2);
                testWaitForTimeout (500);
                sysSetVariableInt(sysvar::RoadMap::SendVehicleSetup,1);
                testWaitForTimeout (500);
                sysSetVariableInt(sysvar::RoadMap::SendVehicleSetup,0);
                testWaitForTimeout (500);
}

export testfunction LanguageSelection_Espanol()
{
  testModuleTitle("LanguageSelection_Espanol");
  write("LanguageSelection_Espanol");
  
                sysSetVariableInt(sysvar::RoadMap::LanguageSelection_Req,3);
                testWaitForTimeout (500);
                sysSetVariableInt(sysvar::RoadMap::SendVehicleSetup,1);
                testWaitForTimeout (500);
                sysSetVariableInt(sysvar::RoadMap::SendVehicleSetup,0);
                testWaitForTimeout (500);
}

export testfunction LanguageSelection_Francais()
{
  testModuleTitle("LanguageSelection_Francais");
  write("LanguageSelection_Francais");
  
                sysSetVariableInt(sysvar::RoadMap::LanguageSelection_Req,4);
                testWaitForTimeout (500);
                sysSetVariableInt(sysvar::RoadMap::SendVehicleSetup,1);
                testWaitForTimeout (500);
                sysSetVariableInt(sysvar::RoadMap::SendVehicleSetup,0);
                testWaitForTimeout (500);
}

export testfunction LanguageSelection_Portugues()
{
  testModuleTitle("LanguageSelection_Portugues");
  write("LanguageSelection_Portugues");
  
                sysSetVariableInt(sysvar::RoadMap::LanguageSelection_Req,5);
                testWaitForTimeout (500);
                sysSetVariableInt(sysvar::RoadMap::SendVehicleSetup,1);
                testWaitForTimeout (500);
                sysSetVariableInt(sysvar::RoadMap::SendVehicleSetup,0);
                testWaitForTimeout (500);
}

export testfunction LanguageSelection_Polish()
{
  testModuleTitle("LanguageSelection_Polish");
  write("LanguageSelection_Polish");
  
                sysSetVariableInt(sysvar::RoadMap::LanguageSelection_Req,6);
                testWaitForTimeout (500);
                sysSetVariableInt(sysvar::RoadMap::SendVehicleSetup,1);
                testWaitForTimeout (500);
                sysSetVariableInt(sysvar::RoadMap::SendVehicleSetup,0);
                testWaitForTimeout (500);
}

export testfunction LanguageSelection_Dutch()
{
  testModuleTitle("LanguageSelection_Dutch");
  write("LanguageSelection_Dutch");
  
                sysSetVariableInt(sysvar::RoadMap::LanguageSelection_Req,7);
                testWaitForTimeout (500);
                sysSetVariableInt(sysvar::RoadMap::SendVehicleSetup,1);
                testWaitForTimeout (500);
                sysSetVariableInt(sysvar::RoadMap::SendVehicleSetup,0);
                testWaitForTimeout (500);
}

export testfunction LanguageSelection_Brazilian()
{
  testModuleTitle("LanguageSelection_Brazilian");
  write("LanguageSelection_Brazilian");
  
                sysSetVariableInt(sysvar::RoadMap::LanguageSelection_Req,8);
                testWaitForTimeout (500);
                sysSetVariableInt(sysvar::RoadMap::SendVehicleSetup,1);
                testWaitForTimeout (500);
                sysSetVariableInt(sysvar::RoadMap::SendVehicleSetup,0);
                testWaitForTimeout (500);
}

export testfunction LanguageSelection_Turkish()
{
  testModuleTitle("LanguageSelection_Turkish");
  write("LanguageSelection_Turkish");
  
                sysSetVariableInt(sysvar::RoadMap::LanguageSelection_Req,9);
                testWaitForTimeout (500);
                sysSetVariableInt(sysvar::RoadMap::SendVehicleSetup,1);
                testWaitForTimeout (500);
                sysSetVariableInt(sysvar::RoadMap::SendVehicleSetup,0);
                testWaitForTimeout (500);
}

export testfunction LanguageSelection_Mexican()
{
  testModuleTitle("LanguageSelection_Mexican");
  write("LanguageSelection_Mexican");
  
                sysSetVariableInt(sysvar::RoadMap::LanguageSelection_Req,10);
                testWaitForTimeout (500);
                sysSetVariableInt(sysvar::RoadMap::SendVehicleSetup,1);
                testWaitForTimeout (500);
                sysSetVariableInt(sysvar::RoadMap::SendVehicleSetup,0);
                testWaitForTimeout (500);
}

export testfunction LanguageSelection_English_US()
{
  testModuleTitle("LanguageSelection_English_US");
  write("LanguageSelection_English_US");
  
                sysSetVariableInt(sysvar::RoadMap::LanguageSelection_Req,11);
                testWaitForTimeout (500);
                sysSetVariableInt(sysvar::RoadMap::SendVehicleSetup,1);
                testWaitForTimeout (500);
                sysSetVariableInt(sysvar::RoadMap::SendVehicleSetup,0);
                testWaitForTimeout (500);
}

export testfunction LanguageSelection_Canadian()
{
  testModuleTitle("LanguageSelection_Canadian");
  write("LanguageSelection_Canadian");
  
                sysSetVariableInt(sysvar::RoadMap::LanguageSelection_Req,12);
                testWaitForTimeout (500);
                sysSetVariableInt(sysvar::RoadMap::SendVehicleSetup,1);
                testWaitForTimeout (500);
                sysSetVariableInt(sysvar::RoadMap::SendVehicleSetup,0);
                testWaitForTimeout (500);
}

export testfunction LanguageSelection_Russian()
{
  testModuleTitle("LanguageSelection_Russian");
  write("LanguageSelection_Russian");
  
                sysSetVariableInt(sysvar::RoadMap::LanguageSelection_Req,13);
                testWaitForTimeout (500);
                sysSetVariableInt(sysvar::RoadMap::SendVehicleSetup,1);
                testWaitForTimeout (500);
                sysSetVariableInt(sysvar::RoadMap::SendVehicleSetup,0);
                testWaitForTimeout (500);
}

export testfunction LanguageSelection_Chinese()
{
  testModuleTitle("LanguageSelection_Chinese");
  write("LanguageSelection_Chinese");
  
                sysSetVariableInt(sysvar::RoadMap::LanguageSelection_Req,14);
                testWaitForTimeout (500);
                sysSetVariableInt(sysvar::RoadMap::SendVehicleSetup,1);
                testWaitForTimeout (500);
                sysSetVariableInt(sysvar::RoadMap::SendVehicleSetup,0);
                testWaitForTimeout (500);
}

export testfunction LanguageSelection_Japanese()
{
  testModuleTitle("LanguageSelection_Japanese");
  write("LanguageSelection_Japanese");
  
                sysSetVariableInt(sysvar::RoadMap::LanguageSelection_Req,15);
                testWaitForTimeout (500);
                sysSetVariableInt(sysvar::RoadMap::SendVehicleSetup,1);
                testWaitForTimeout (500);
                sysSetVariableInt(sysvar::RoadMap::SendVehicleSetup,0);
                testWaitForTimeout (500);
}

export testfunction LanguageSelection_Korean()
{
  testModuleTitle("LanguageSelection_Korean");
  write("LanguageSelection_Korean");
  
                sysSetVariableInt(sysvar::RoadMap::LanguageSelection_Req,16);
                testWaitForTimeout (500);
                sysSetVariableInt(sysvar::RoadMap::SendVehicleSetup,1);
                testWaitForTimeout (500);
                sysSetVariableInt(sysvar::RoadMap::SendVehicleSetup,0);
                testWaitForTimeout (500);
}

export testfunction LanguageSelection_Arabic()
{
  testModuleTitle("LanguageSelection_Arabic");
  write("LanguageSelection_Arabic");
  
                sysSetVariableInt(sysvar::RoadMap::LanguageSelection_Req,17);
                testWaitForTimeout (500);
                sysSetVariableInt(sysvar::RoadMap::SendVehicleSetup,1);
                testWaitForTimeout (500);
                sysSetVariableInt(sysvar::RoadMap::SendVehicleSetup,0);
                testWaitForTimeout (500);
}

export testfunction Send_TimeDate_AND_Day()
{
  testModuleTitle("Send_TimeDate_AND_Day");
  write("Send_TimeDate_AND_Day");
             
                sysSetVariableInt(sysvar::RoadMap::Hour_panel,2);
                sysSetVariableInt(sysvar::RoadMap::Hour_panel,3);
                sysSetVariableInt(sysvar::RoadMap::Minute_Panel,5);
                sysSetVariableInt(sysvar::RoadMap::Minute_Panel,9);
                testWaitForTimeout (500);
                sysSetVariableInt(sysvar::RoadMap::SendTimeDate1,1);
                testWaitForTimeout (500);
                sysSetVariableInt(sysvar::RoadMap::SendTimeDate1,0);
                testWaitForTimeout (24000);                
                sysSetVariableInt(sysvar::RoadMap::EnableTravelDistance,1);
                sysSetVariableInt(sysvar::RoadMap::WC_Ignition_On_EngOn_AUTO,1);
                sysSetVariableFloat(sysvar::RoadMap::VehicleSpeedVSOSig,100);
                sysSetVariableInt(sysvar::RoadMap::EngineSpeed,3000);
                sysSetVariableFloat(sysvar::RoadMap::FuelLevel,50);
                sysSetVariableFloat(sysvar::RoadMap::FuelConsumption_GAG,12);
                testWaitForTimeout (36000); 
}

export testfunction ReleaseBrakePedalFlag_Not_Active_HIGH() //Set Strategy Gear to "RELEASE_BRAKE_PEDAL_FLAG" (exclusive for VF200)
  
  //It’s necessary to check the Memory ID for STRATEGY_GEAR in “EOL_CONFIGURATION_IPC_226_HIGH” document
{
	DIAGNOSTIC_REQUEST_IPC_msg.id=0x18DA60F1x;
	DIAGNOSTIC_REQUEST_IPC_msg.dlc = 8;
	DIAGNOSTIC_REQUEST_IPC_msg.byte(0) = 0x10;
	DIAGNOSTIC_REQUEST_IPC_msg.byte(1) = 0x08;
	DIAGNOSTIC_REQUEST_IPC_msg.byte(2) = 0x31;
	DIAGNOSTIC_REQUEST_IPC_msg.byte(3) = 0x01;
	DIAGNOSTIC_REQUEST_IPC_msg.byte(4) = 0x00;
	DIAGNOSTIC_REQUEST_IPC_msg.byte(5) = 0x61;
	DIAGNOSTIC_REQUEST_IPC_msg.byte(6) = 0x81;
	DIAGNOSTIC_REQUEST_IPC_msg.byte(7) = 0x01; //RELEASE_BRAKE_PEDAL_FLAG Memory ID
	output( DIAGNOSTIC_REQUEST_IPC_msg );
	testWaitForTimeout(200);
 	DIAGNOSTIC_REQUEST_IPC_msg.id=0x18DA60F1x;
	DIAGNOSTIC_REQUEST_IPC_msg.dlc = 3;
	DIAGNOSTIC_REQUEST_IPC_msg.byte(0) = 0x21;
	DIAGNOSTIC_REQUEST_IPC_msg.byte(1) = 0x2F; //RELEASE_BRAKE_PEDAL_FLAG Memory ID
	DIAGNOSTIC_REQUEST_IPC_msg.byte(2) = 0x00;
	output( DIAGNOSTIC_REQUEST_IPC_msg ); 
  testWaitForTimeout(200);
  
  DIAGNOSTIC_REQUEST_IPC_msg.id=0x18DA60F1x;
	DIAGNOSTIC_REQUEST_IPC_msg.dlc = 5;
	DIAGNOSTIC_REQUEST_IPC_msg.byte(0) = 0x04; 
	DIAGNOSTIC_REQUEST_IPC_msg.byte(1) = 0x31;
	DIAGNOSTIC_REQUEST_IPC_msg.byte(2) = 0x03;
  DIAGNOSTIC_REQUEST_IPC_msg.byte(3) = 0x00;
  DIAGNOSTIC_REQUEST_IPC_msg.byte(4) = 0x61;
	output(DIAGNOSTIC_REQUEST_IPC_msg);
	testWaitForTimeout(200);
}

export testfunction ReleaseBrakePedalFlag_Active_HIGH() //Set Strategy Gear to "RELEASE_BRAKE_PEDAL_FLAG" (exclusive for VF200)
  
  //It’s necessary to check the Memory ID for STRATEGY_GEAR in “EOL_CONFIGURATION_IPC_226_HIGH” document
{
	DIAGNOSTIC_REQUEST_IPC_msg.id=0x18DA60F1x;
	DIAGNOSTIC_REQUEST_IPC_msg.dlc = 8;
	DIAGNOSTIC_REQUEST_IPC_msg.byte(0) = 0x10;
	DIAGNOSTIC_REQUEST_IPC_msg.byte(1) = 0x08;
	DIAGNOSTIC_REQUEST_IPC_msg.byte(2) = 0x31;
	DIAGNOSTIC_REQUEST_IPC_msg.byte(3) = 0x01;
	DIAGNOSTIC_REQUEST_IPC_msg.byte(4) = 0x00;
	DIAGNOSTIC_REQUEST_IPC_msg.byte(5) = 0x61;
	DIAGNOSTIC_REQUEST_IPC_msg.byte(6) = 0x81;
	DIAGNOSTIC_REQUEST_IPC_msg.byte(7) = 0x01; //RELEASE_BRAKE_PEDAL_FLAG Memory ID
	output( DIAGNOSTIC_REQUEST_IPC_msg );
	testWaitForTimeout(200);
 	DIAGNOSTIC_REQUEST_IPC_msg.id=0x18DA60F1x;
	DIAGNOSTIC_REQUEST_IPC_msg.dlc = 3;
	DIAGNOSTIC_REQUEST_IPC_msg.byte(0) = 0x21;
	DIAGNOSTIC_REQUEST_IPC_msg.byte(1) = 0x2F; //RELEASE_BRAKE_PEDAL_FLAG Memory ID
	DIAGNOSTIC_REQUEST_IPC_msg.byte(2) = 0x01;
	output( DIAGNOSTIC_REQUEST_IPC_msg ); 
  testWaitForTimeout(200);
  
  DIAGNOSTIC_REQUEST_IPC_msg.id=0x18DA60F1x;
	DIAGNOSTIC_REQUEST_IPC_msg.dlc = 5;
	DIAGNOSTIC_REQUEST_IPC_msg.byte(0) = 0x04; 
	DIAGNOSTIC_REQUEST_IPC_msg.byte(1) = 0x31;
	DIAGNOSTIC_REQUEST_IPC_msg.byte(2) = 0x03;
  DIAGNOSTIC_REQUEST_IPC_msg.byte(3) = 0x00;
  DIAGNOSTIC_REQUEST_IPC_msg.byte(4) = 0x61;
	output(DIAGNOSTIC_REQUEST_IPC_msg);
	testWaitForTimeout(200);
}

export testfunction ReleaseBrakePedalFlag_Not_Active_BASE() //Set Strategy Gear to "RELEASE_BRAKE_PEDAL_FLAG" (exclusive for VF200)
  
  //It’s necessary to check the Memory ID for STRATEGY_GEAR in “EOL_CONFIGURATION_IPC_226_BASE” document
{
	DIAGNOSTIC_REQUEST_IPC_msg.id=0x18DA60F1x;
	DIAGNOSTIC_REQUEST_IPC_msg.dlc = 8;
	DIAGNOSTIC_REQUEST_IPC_msg.byte(0) = 0x10;
	DIAGNOSTIC_REQUEST_IPC_msg.byte(1) = 0x08;
	DIAGNOSTIC_REQUEST_IPC_msg.byte(2) = 0x31;
	DIAGNOSTIC_REQUEST_IPC_msg.byte(3) = 0x01;
	DIAGNOSTIC_REQUEST_IPC_msg.byte(4) = 0x00;
	DIAGNOSTIC_REQUEST_IPC_msg.byte(5) = 0x61;
	DIAGNOSTIC_REQUEST_IPC_msg.byte(6) = 0x81;
	DIAGNOSTIC_REQUEST_IPC_msg.byte(7) = 0x01; //RELEASE_BRAKE_PEDAL_FLAG Memory ID
	output( DIAGNOSTIC_REQUEST_IPC_msg );
	testWaitForTimeout(200);
 	DIAGNOSTIC_REQUEST_IPC_msg.id=0x18DA60F1x;
	DIAGNOSTIC_REQUEST_IPC_msg.dlc = 3;
	DIAGNOSTIC_REQUEST_IPC_msg.byte(0) = 0x21;
	DIAGNOSTIC_REQUEST_IPC_msg.byte(1) = 0x91; //RELEASE_BRAKE_PEDAL_FLAG Memory ID
	DIAGNOSTIC_REQUEST_IPC_msg.byte(2) = 0x00;
	output( DIAGNOSTIC_REQUEST_IPC_msg ); 
  testWaitForTimeout(200);
  
  DIAGNOSTIC_REQUEST_IPC_msg.id=0x18DA60F1x;
	DIAGNOSTIC_REQUEST_IPC_msg.dlc = 5;
	DIAGNOSTIC_REQUEST_IPC_msg.byte(0) = 0x04; 
	DIAGNOSTIC_REQUEST_IPC_msg.byte(1) = 0x31;
	DIAGNOSTIC_REQUEST_IPC_msg.byte(2) = 0x03;
  DIAGNOSTIC_REQUEST_IPC_msg.byte(3) = 0x00;
  DIAGNOSTIC_REQUEST_IPC_msg.byte(4) = 0x61;
	output(DIAGNOSTIC_REQUEST_IPC_msg);
	testWaitForTimeout(200);
}

export testfunction ReleaseBrakePedalFlag_Active_BASE() //Set Strategy Gear to "RELEASE_BRAKE_PEDAL_FLAG" (exclusive for VF200)
  
  //It’s necessary to check the Memory ID for STRATEGY_GEAR in “EOL_CONFIGURATION_IPC_226_BASE” document
{
	DIAGNOSTIC_REQUEST_IPC_msg.id=0x18DA60F1x;
	DIAGNOSTIC_REQUEST_IPC_msg.dlc = 8;
	DIAGNOSTIC_REQUEST_IPC_msg.byte(0) = 0x10;
	DIAGNOSTIC_REQUEST_IPC_msg.byte(1) = 0x08;
	DIAGNOSTIC_REQUEST_IPC_msg.byte(2) = 0x31;
	DIAGNOSTIC_REQUEST_IPC_msg.byte(3) = 0x01;
	DIAGNOSTIC_REQUEST_IPC_msg.byte(4) = 0x00;
	DIAGNOSTIC_REQUEST_IPC_msg.byte(5) = 0x61;
	DIAGNOSTIC_REQUEST_IPC_msg.byte(6) = 0x81;
	DIAGNOSTIC_REQUEST_IPC_msg.byte(7) = 0x01; //RELEASE_BRAKE_PEDAL_FLAG Memory ID
	output( DIAGNOSTIC_REQUEST_IPC_msg );
	testWaitForTimeout(200);
 	DIAGNOSTIC_REQUEST_IPC_msg.id=0x18DA60F1x;
	DIAGNOSTIC_REQUEST_IPC_msg.dlc = 3;
	DIAGNOSTIC_REQUEST_IPC_msg.byte(0) = 0x21;
	DIAGNOSTIC_REQUEST_IPC_msg.byte(1) = 0x91; //RELEASE_BRAKE_PEDAL_FLAG Memory ID
	DIAGNOSTIC_REQUEST_IPC_msg.byte(2) = 0x01;
	output( DIAGNOSTIC_REQUEST_IPC_msg ); 
  testWaitForTimeout(200);
  
  DIAGNOSTIC_REQUEST_IPC_msg.id=0x18DA60F1x;
	DIAGNOSTIC_REQUEST_IPC_msg.dlc = 5;
	DIAGNOSTIC_REQUEST_IPC_msg.byte(0) = 0x04; 
	DIAGNOSTIC_REQUEST_IPC_msg.byte(1) = 0x31;
	DIAGNOSTIC_REQUEST_IPC_msg.byte(2) = 0x03;
  DIAGNOSTIC_REQUEST_IPC_msg.byte(3) = 0x00;
  DIAGNOSTIC_REQUEST_IPC_msg.byte(4) = 0x61;
	output(DIAGNOSTIC_REQUEST_IPC_msg);
	testWaitForTimeout(200);
}

export testfunction CheckLeverPositionFlag_Not_Active_HIGH() //Set Strategy Gear to "CHECK_LEVER_POSITION_FLAG" (exclusive for VF200)
  
  //It’s necessary to check the Memory ID for STRATEGY_GEAR in “EOL_CONFIGURATION_IPC_226_HIGH” document
{
	DIAGNOSTIC_REQUEST_IPC_msg.id=0x18DA60F1x;
	DIAGNOSTIC_REQUEST_IPC_msg.dlc = 8;
	DIAGNOSTIC_REQUEST_IPC_msg.byte(0) = 0x10;
	DIAGNOSTIC_REQUEST_IPC_msg.byte(1) = 0x08;
	DIAGNOSTIC_REQUEST_IPC_msg.byte(2) = 0x31;
	DIAGNOSTIC_REQUEST_IPC_msg.byte(3) = 0x01;
	DIAGNOSTIC_REQUEST_IPC_msg.byte(4) = 0x00;
	DIAGNOSTIC_REQUEST_IPC_msg.byte(5) = 0x61;
	DIAGNOSTIC_REQUEST_IPC_msg.byte(6) = 0x81;
	DIAGNOSTIC_REQUEST_IPC_msg.byte(7) = 0x00; //CHECK_LEVER_POSITION_FLAG Memory ID
	output( DIAGNOSTIC_REQUEST_IPC_msg );
	testWaitForTimeout(200);
 	DIAGNOSTIC_REQUEST_IPC_msg.id=0x18DA60F1x;
	DIAGNOSTIC_REQUEST_IPC_msg.dlc = 3;
	DIAGNOSTIC_REQUEST_IPC_msg.byte(0) = 0x21;
	DIAGNOSTIC_REQUEST_IPC_msg.byte(1) = 0xC3; //CHECK_LEVER_POSITION_FLAG Memory ID
	DIAGNOSTIC_REQUEST_IPC_msg.byte(2) = 0x00;
	output( DIAGNOSTIC_REQUEST_IPC_msg ); 
  testWaitForTimeout(200);
  
  DIAGNOSTIC_REQUEST_IPC_msg.id=0x18DA60F1x;
	DIAGNOSTIC_REQUEST_IPC_msg.dlc = 5;
	DIAGNOSTIC_REQUEST_IPC_msg.byte(0) = 0x04; 
	DIAGNOSTIC_REQUEST_IPC_msg.byte(1) = 0x31;
	DIAGNOSTIC_REQUEST_IPC_msg.byte(2) = 0x03;
  DIAGNOSTIC_REQUEST_IPC_msg.byte(3) = 0x00;
  DIAGNOSTIC_REQUEST_IPC_msg.byte(4) = 0x61;
	output(DIAGNOSTIC_REQUEST_IPC_msg);
	testWaitForTimeout(200);
}

export testfunction CheckLeverPositionFlag_Active_HIGH() //Set Strategy Gear to "CHECK_LEVER_POSITION_FLAG" (exclusive for VF200)
  
  //It’s necessary to check the Memory ID for STRATEGY_GEAR in “EOL_CONFIGURATION_IPC_226_HIGH” document
{
	DIAGNOSTIC_REQUEST_IPC_msg.id=0x18DA60F1x;
	DIAGNOSTIC_REQUEST_IPC_msg.dlc = 8;
	DIAGNOSTIC_REQUEST_IPC_msg.byte(0) = 0x10;
	DIAGNOSTIC_REQUEST_IPC_msg.byte(1) = 0x08;
	DIAGNOSTIC_REQUEST_IPC_msg.byte(2) = 0x31;
	DIAGNOSTIC_REQUEST_IPC_msg.byte(3) = 0x01;
	DIAGNOSTIC_REQUEST_IPC_msg.byte(4) = 0x00;
	DIAGNOSTIC_REQUEST_IPC_msg.byte(5) = 0x61;
	DIAGNOSTIC_REQUEST_IPC_msg.byte(6) = 0x81;
	DIAGNOSTIC_REQUEST_IPC_msg.byte(7) = 0x00; //CHECK_LEVER_POSITION_FLAG Memory ID
	output( DIAGNOSTIC_REQUEST_IPC_msg );
	testWaitForTimeout(200);
 	DIAGNOSTIC_REQUEST_IPC_msg.id=0x18DA60F1x;
	DIAGNOSTIC_REQUEST_IPC_msg.dlc = 3;
	DIAGNOSTIC_REQUEST_IPC_msg.byte(0) = 0x21;
	DIAGNOSTIC_REQUEST_IPC_msg.byte(1) = 0xC3; //CHECK_LEVER_POSITION_FLAG Memory ID
	DIAGNOSTIC_REQUEST_IPC_msg.byte(2) = 0x01;
	output( DIAGNOSTIC_REQUEST_IPC_msg ); 
  testWaitForTimeout(200);
  
  DIAGNOSTIC_REQUEST_IPC_msg.id=0x18DA60F1x;
	DIAGNOSTIC_REQUEST_IPC_msg.dlc = 5;
	DIAGNOSTIC_REQUEST_IPC_msg.byte(0) = 0x04; 
	DIAGNOSTIC_REQUEST_IPC_msg.byte(1) = 0x31;
	DIAGNOSTIC_REQUEST_IPC_msg.byte(2) = 0x03;
  DIAGNOSTIC_REQUEST_IPC_msg.byte(3) = 0x00;
  DIAGNOSTIC_REQUEST_IPC_msg.byte(4) = 0x61;
	output(DIAGNOSTIC_REQUEST_IPC_msg);
	testWaitForTimeout(200);
}

export testfunction CheckLeverPositionFlag_Not_Active_BASE() //Set Strategy Gear to "CHECK_LEVER_POSITION_FLAG" (exclusive for VF200)
  
  //It’s necessary to check the Memory ID for STRATEGY_GEAR in “EOL_CONFIGURATION_IPC_226_BASE” document
{
	DIAGNOSTIC_REQUEST_IPC_msg.id=0x18DA60F1x;
	DIAGNOSTIC_REQUEST_IPC_msg.dlc = 8;
	DIAGNOSTIC_REQUEST_IPC_msg.byte(0) = 0x10;
	DIAGNOSTIC_REQUEST_IPC_msg.byte(1) = 0x08;
	DIAGNOSTIC_REQUEST_IPC_msg.byte(2) = 0x31;
	DIAGNOSTIC_REQUEST_IPC_msg.byte(3) = 0x01;
	DIAGNOSTIC_REQUEST_IPC_msg.byte(4) = 0x00;
	DIAGNOSTIC_REQUEST_IPC_msg.byte(5) = 0x61;
	DIAGNOSTIC_REQUEST_IPC_msg.byte(6) = 0x81;
	DIAGNOSTIC_REQUEST_IPC_msg.byte(7) = 0x01; //CHECK_LEVER_POSITION_FLAG Memory ID
	output( DIAGNOSTIC_REQUEST_IPC_msg );
	testWaitForTimeout(200);
 	DIAGNOSTIC_REQUEST_IPC_msg.id=0x18DA60F1x;
	DIAGNOSTIC_REQUEST_IPC_msg.dlc = 3;
	DIAGNOSTIC_REQUEST_IPC_msg.byte(0) = 0x21;
	DIAGNOSTIC_REQUEST_IPC_msg.byte(1) = 0x92; //CHECK_LEVER_POSITION_FLAG Memory ID
	DIAGNOSTIC_REQUEST_IPC_msg.byte(2) = 0x00;
	output( DIAGNOSTIC_REQUEST_IPC_msg ); 
  testWaitForTimeout(200);
  
  DIAGNOSTIC_REQUEST_IPC_msg.id=0x18DA60F1x;
	DIAGNOSTIC_REQUEST_IPC_msg.dlc = 5;
	DIAGNOSTIC_REQUEST_IPC_msg.byte(0) = 0x04; 
	DIAGNOSTIC_REQUEST_IPC_msg.byte(1) = 0x31;
	DIAGNOSTIC_REQUEST_IPC_msg.byte(2) = 0x03;
  DIAGNOSTIC_REQUEST_IPC_msg.byte(3) = 0x00;
  DIAGNOSTIC_REQUEST_IPC_msg.byte(4) = 0x61;
	output(DIAGNOSTIC_REQUEST_IPC_msg);
	testWaitForTimeout(200);
}

export testfunction CheckLeverPositionFlag_Active_BASE() //Set Strategy Gear to "CHECK_LEVER_POSITION_FLAG" (exclusive for VF200)
  
  //It’s necessary to check the Memory ID for STRATEGY_GEAR in “EOL_CONFIGURATION_IPC_226_BASE” document
{
	DIAGNOSTIC_REQUEST_IPC_msg.id=0x18DA60F1x;
	DIAGNOSTIC_REQUEST_IPC_msg.dlc = 8;
	DIAGNOSTIC_REQUEST_IPC_msg.byte(0) = 0x10;
	DIAGNOSTIC_REQUEST_IPC_msg.byte(1) = 0x08;
	DIAGNOSTIC_REQUEST_IPC_msg.byte(2) = 0x31;
	DIAGNOSTIC_REQUEST_IPC_msg.byte(3) = 0x01;
	DIAGNOSTIC_REQUEST_IPC_msg.byte(4) = 0x00;
	DIAGNOSTIC_REQUEST_IPC_msg.byte(5) = 0x61;
	DIAGNOSTIC_REQUEST_IPC_msg.byte(6) = 0x81;
	DIAGNOSTIC_REQUEST_IPC_msg.byte(7) = 0x01; //CHECK_LEVER_POSITION_FLAG Memory ID
	output( DIAGNOSTIC_REQUEST_IPC_msg );
	testWaitForTimeout(200);
 	DIAGNOSTIC_REQUEST_IPC_msg.id=0x18DA60F1x;
	DIAGNOSTIC_REQUEST_IPC_msg.dlc = 3;
	DIAGNOSTIC_REQUEST_IPC_msg.byte(0) = 0x21;
	DIAGNOSTIC_REQUEST_IPC_msg.byte(1) = 0x92; //CHECK_LEVER_POSITION_FLAG Memory ID
	DIAGNOSTIC_REQUEST_IPC_msg.byte(2) = 0x01;
	output( DIAGNOSTIC_REQUEST_IPC_msg ); 
  testWaitForTimeout(200);
  
  DIAGNOSTIC_REQUEST_IPC_msg.id=0x18DA60F1x;
	DIAGNOSTIC_REQUEST_IPC_msg.dlc = 5;
	DIAGNOSTIC_REQUEST_IPC_msg.byte(0) = 0x04; 
	DIAGNOSTIC_REQUEST_IPC_msg.byte(1) = 0x31;
	DIAGNOSTIC_REQUEST_IPC_msg.byte(2) = 0x03;
  DIAGNOSTIC_REQUEST_IPC_msg.byte(3) = 0x00;
  DIAGNOSTIC_REQUEST_IPC_msg.byte(4) = 0x61;
	output(DIAGNOSTIC_REQUEST_IPC_msg);
	testWaitForTimeout(200);
}

export testfunction PULLOUT_Absent() //Set Strategy Gear to "PULLOUT" (exclusive for VF505)
  
  //It’s necessary to check the Memory ID for STRATEGY_GEAR in “EOL_CONFIGURATION_IPC_226MCA” document
{
	DIAGNOSTIC_REQUEST_IPC_msg.id=0x18DA60F1x;
	DIAGNOSTIC_REQUEST_IPC_msg.dlc = 8;
	DIAGNOSTIC_REQUEST_IPC_msg.byte(0) = 0x10;
	DIAGNOSTIC_REQUEST_IPC_msg.byte(1) = 0x08;
	DIAGNOSTIC_REQUEST_IPC_msg.byte(2) = 0x31;
	DIAGNOSTIC_REQUEST_IPC_msg.byte(3) = 0x01;
	DIAGNOSTIC_REQUEST_IPC_msg.byte(4) = 0x00;
	DIAGNOSTIC_REQUEST_IPC_msg.byte(5) = 0x61;
	DIAGNOSTIC_REQUEST_IPC_msg.byte(6) = 0x81;
	DIAGNOSTIC_REQUEST_IPC_msg.byte(7) = 0x01; //PULLOUT Memory ID
	output( DIAGNOSTIC_REQUEST_IPC_msg );
	testWaitForTimeout(200);
 	DIAGNOSTIC_REQUEST_IPC_msg.id=0x18DA60F1x;
	DIAGNOSTIC_REQUEST_IPC_msg.dlc = 3;
	DIAGNOSTIC_REQUEST_IPC_msg.byte(0) = 0x21;
	DIAGNOSTIC_REQUEST_IPC_msg.byte(1) = 0x2C; //PULLOUT Memory ID
	DIAGNOSTIC_REQUEST_IPC_msg.byte(2) = 0x00;
	output( DIAGNOSTIC_REQUEST_IPC_msg ); 
  testWaitForTimeout(200);
  
  DIAGNOSTIC_REQUEST_IPC_msg.id=0x18DA60F1x;
	DIAGNOSTIC_REQUEST_IPC_msg.dlc = 5;
	DIAGNOSTIC_REQUEST_IPC_msg.byte(0) = 0x04; 
	DIAGNOSTIC_REQUEST_IPC_msg.byte(1) = 0x31;
	DIAGNOSTIC_REQUEST_IPC_msg.byte(2) = 0x03;
  DIAGNOSTIC_REQUEST_IPC_msg.byte(3) = 0x00;
  DIAGNOSTIC_REQUEST_IPC_msg.byte(4) = 0x61;
	output(DIAGNOSTIC_REQUEST_IPC_msg);
	testWaitForTimeout(200);
}

export testfunction PULLOUT_Present() //Set Strategy Gear to "PULLOUT" (exclusive for VF505)
  
  //It’s necessary to check the Memory ID for STRATEGY_GEAR in “EOL_CONFIGURATION_IPC_226MCA” document
{
	DIAGNOSTIC_REQUEST_IPC_msg.id=0x18DA60F1x;
	DIAGNOSTIC_REQUEST_IPC_msg.dlc = 8;
	DIAGNOSTIC_REQUEST_IPC_msg.byte(0) = 0x10;
	DIAGNOSTIC_REQUEST_IPC_msg.byte(1) = 0x08;
	DIAGNOSTIC_REQUEST_IPC_msg.byte(2) = 0x31;
	DIAGNOSTIC_REQUEST_IPC_msg.byte(3) = 0x01;
	DIAGNOSTIC_REQUEST_IPC_msg.byte(4) = 0x00;
	DIAGNOSTIC_REQUEST_IPC_msg.byte(5) = 0x61;
	DIAGNOSTIC_REQUEST_IPC_msg.byte(6) = 0x81;
	DIAGNOSTIC_REQUEST_IPC_msg.byte(7) = 0x01; //PULLOUT Memory ID
	output( DIAGNOSTIC_REQUEST_IPC_msg );
	testWaitForTimeout(200);
 	DIAGNOSTIC_REQUEST_IPC_msg.id=0x18DA60F1x;
	DIAGNOSTIC_REQUEST_IPC_msg.dlc = 3;
	DIAGNOSTIC_REQUEST_IPC_msg.byte(0) = 0x21;
	DIAGNOSTIC_REQUEST_IPC_msg.byte(1) = 0x2C; //PULLOUT Memory ID
	DIAGNOSTIC_REQUEST_IPC_msg.byte(2) = 0x01;
	output( DIAGNOSTIC_REQUEST_IPC_msg ); 
  testWaitForTimeout(200);
  
  DIAGNOSTIC_REQUEST_IPC_msg.id=0x18DA60F1x;
	DIAGNOSTIC_REQUEST_IPC_msg.dlc = 5;
	DIAGNOSTIC_REQUEST_IPC_msg.byte(0) = 0x04; 
	DIAGNOSTIC_REQUEST_IPC_msg.byte(1) = 0x31;
	DIAGNOSTIC_REQUEST_IPC_msg.byte(2) = 0x03;
  DIAGNOSTIC_REQUEST_IPC_msg.byte(3) = 0x00;
  DIAGNOSTIC_REQUEST_IPC_msg.byte(4) = 0x61;
	output(DIAGNOSTIC_REQUEST_IPC_msg);
	testWaitForTimeout(200);
}

export testfunction Increase_CC_SetSpdDspl_KPH_0_240 ()
{
  testModuleTitle("Increase_CC_SetSpdDspl_KPH_0_240");
  
              
              for (i=0; i<=225; i++)
              {
                write("VehicleSpeed:%VehicleSpeedVSOSig");
                sysSetVariableFloat(sysvar::RoadMap::CC_SetSpdDspl_KPH,i);
                testWaitForTimeout (500);
              }  
}

export testfunction Increase_CC_SetSpdDspl_KPH_0_511 ()
{
  testModuleTitle("Increase_CC_SetSpdDspl_KPH_0_511");
  
              
              for (i=0; i<=511; i++)
              {
                write("VehicleSpeed:%VehicleSpeedVSOSig");
                sysSetVariableFloat(sysvar::RoadMap::CC_SetSpdDspl_KPH,i);
                testWaitForTimeout (500);
              }  
}

//#####################  TEST AUTOMATION CAPL FUNCTIONS ################################


//StepName - name of Inspection step 
//ExpVal - expected value of measurement of Inspection step 
//ToleranceUnits - tolerance in units, e.g 100 by RPM meeans +-100RPM 
//TolerancePercent in %; e.g 15 means 15%
//when ToleranceUnits=TolerancePercent=0 then  Result must be same as ExpVal
export testfunction CheckStepResultCamera ( char StepName[], double ExpVal, double ToleranceUnits, double TolerancePercent )
{
  double Result;
  double Tolerance;
  Result = GetStepResult(StepName);
  if ( Result == 9e+99 )
  {
     TestStep( StepName, "Wrong StepName - '%s' not found !", StepName); 
     testStepFail();  
     return;
  }
  
  //tolerance in units
  if (ToleranceUnits > 0)
  {
     TestStep( StepName, "Result: %.2f Expected: %.2f, Tolerance interval %.2f-%.2f", Result, ExpVal, ExpVal-ToleranceUnits, ExpVal+ToleranceUnits);
     if ( abs(Result-ExpVal) <= ToleranceUnits )
       testStepPass();
     else
       testStepFail();  
  }
  
  //tolerance in %
  else if (TolerancePercent > 0)
  {
    Tolerance = TolerancePercent * 0.01;    
    TestStep( StepName, "Result: %.2f Expected: %.2f, Tolerance interval %.2f-%.2f", Result, ExpVal, ExpVal-Tolerance*ExpVal, ExpVal+Tolerance*ExpVal);   
  if ( abs(Result-ExpVal) <=  Tolerance*ExpVal)    
    testStepPass();
  else
    testStepFail();
  }  
  
  //no tolerance
  else  
  {
    TestStep( StepName, "Result: %f Expected: %f", Result, ExpVal );
    if ( Result == ExpVal)
      testStepPass();
    else
      testStepFail();   
  }
}
int CompareStringsWithTolerance(char Result[], char ExpVal[])
//compares 2 strings
//ExpVal can be substring from Result as only characters to strlen(ExpVal) are checked
//if the only difference are LowerCase, Uppercase or characters difficult to recognise like 'l', '0' etc, returns 1
//if there are other differences as well, returns 0 

{
     int i; 
     for (i=0; i< strlen(ExpVal); i++)    
     {
        str_replace(ExpVal," ",""); //spaces are removed from "ExpVal"
        str_replace(Result," ",""); //spaces are removed from "Result"     
        if ( Result[i] != ExpVal[i] )
        {
          
           if (toLower(Result[i]) ==  toLower(ExpVal[i]))
            
             continue; 
           else if (( Result[i] == 'i' ||  Result[i]== 'l' ||  Result[i]== 'I' ||  Result[i]== '\'' || Result[i]== '0' ||  Result[i]== 'o' ||  Result[i]== 'O' || Result[i]== '.' || Result[i]== '-'|| Result[i]== '_')
            && ( ExpVal[i] =='i'  ||  ExpVal[i]== 'l' ||  ExpVal[i]== 'I' ||  ExpVal[i]== '\'' || ExpVal[i]== '0' ||  ExpVal[i]== 'o' ||  ExpVal[i]== 'O' || ExpVal[i]== '.' || ExpVal[i]== '-' || ExpVal[i]== '_' )) 
             continue;
           else
           {
              return 0;
           }          
        }        
     }
     return 1;
}

export testfunction PutTextReport(char StepName[])
{
  vPutTextReport( StepName);
}

void vPutTextReport (char StepName[])
{   
  char Result[10000];
  
  //str_replace(ExpVal," ",""); //spaces are removed from "ExpVal"
  GetOCRStepResult(StepName, Result);
  str_replace(Result," ",""); //spaces are removed from "Result"
  TestStep(StepName,"ReadText=%s.", Result );
  testStepPass();
  return;     
}
//Anderson

//checks ExpVal with ResultText returned by StepName; if ExpVal=% -> any nonempty text is OK
//spaces in ExpVal are removed as OCR returns text without spaces
//if ContainsExpVal=1, passes if ResultText contains ExpVal
//if TolerateSimilarChars =1, ignores LowerCase, Uppercase; checks 1.. strlen(ExpVal) characters, passes when ExpVal differs from ResultText only in charecters difficult to recognize like 'i', 'l', 'I' ...
//in other cases strings must be the same to pass
export testfunction CheckStepResultCameraText(char StepName[],char ExpVal[], int ContainsExpVal, int TolerateSimilarChars)

{
  vCheckStepResultCameraText( StepName, ExpVal, ContainsExpVal, TolerateSimilarChars);
}

void vCheckStepResultCameraText (char StepName[], char ExpVal[], int ContainsExpVal, int TolerateSimilarChars)
{   
  char Result[10000];
  
  str_replace(ExpVal," ",""); //spaces are removed from "ExpVal"
  GetOCRStepResult(StepName, Result);
  str_replace(Result," ",""); //spaces are removed from "Result"
  if ( strncmp(Result, "Wrong StepName", 100) == 0)
  {
     TestStep( StepName, "Wrong StepName - '%s' not found !", StepName); 
     testStepFail();  
     return;     
  }

  if ( strncmp(ExpVal, "%", 1000) == 0 )
  {
    TestStep(StepName,"ReadText=%s , ExpectedText=any nonempty text", Result );
    if (strlen(Result) >0 )
      testStepPass();
    else
      testStepFail();     
  }
  
  else if (ContainsExpVal == 1)
  {
     if (strstr(Result, ExpVal) > -1)
     {    
       TestStep(StepName,"ReadText=%s contains ExpectedText=%s", Result, ExpVal); 
       testStepPass();
     }
     else
     {
       TestStep(StepName,"ReadText=%s doesn't contain ExpectedText=%s", Result, ExpVal); 
       testStepFail();  
     }
  }
  else if (TolerateSimilarChars == 1 )
  {
     TestStep(StepName,"ReadText=%s , ExpectedText=%s", Result, ExpVal); 
     if (CompareStringsWithTolerance(Result, ExpVal) == 1)
       testStepPass();  
     else
       testStepFail();          
  }
  else
  {
    TestStep(StepName,"ReadText=%s , ExpectedText=%s", Result, ExpVal);
    if (strncmp(ExpVal,Result,10000) == 0 )
      testStepPass();
    else
      testStepFail();     
  }
  strncpy(Resultchar,Result,200);
  
}

//same as prev export testfunction, two additional params can be used for Tolerance when ExpVal is number  
//ToleranceUnits - tolerance in units, e.g 100 by RPM meeans +-100RPM 
//TolerancePercent in %; e.g 15 means 15%
export testfunction CheckStepResultCameraText(char StepName[],char ExpVal[], int ContainsExpVal, int TolerateSimilarChars, float ToleranceUnits, float TolerancePercent)
{   
  char Result[10000];
  float fResult, fExpVal, Tolerance;
  
  GetOCRStepResult(StepName, Result);  
  str_replace(ExpVal," ",""); //spaces are removed from "ExpVal"
  str_replace(Result," ",""); //spaces are removed from "Result"
  if ( strncmp(Result, "Wrong StepName", 100) == 0)
  {
     TestStep( StepName, "Wrong StepName - '%s' not found !", StepName); 
     testStepFail();  
     return;     
  }  
  
  if (ToleranceUnits > 0)
  {
    //delete all characters except numbers and then convert string to number
    str_replace(ExpVal," ",""); //spaces are removed from "ExpVal"
    str_replace(Result," ",""); //spaces are removed from "Result"
    str_replace_regex(Result, "[^0-9.-]+", "");  
    str_replace_regex(ExpVal, "[^0-9.-]+", "");    
    fResult=atodbl(Result);
    fExpVal=atodbl(ExpVal);
  
    TestStep( StepName, "Result: %.2f Expected: %.2f, Tolerance interval %.2f-%.2f", fResult, fExpVal, fExpVal-ToleranceUnits, fExpVal+ToleranceUnits);
     if ( abs(fResult-fExpVal) <= ToleranceUnits )
       testStepPass();
     else
       testStepFail();  
  }
  else if (TolerancePercent > 0)
  {
    //delete all characters except numbers and then convert string to number
    str_replace_regex(Result, "[^0-9.-]+", "");  
    str_replace_regex(ExpVal, "[^0-9.-]+", "");    
    fResult=atodbl(Result);
    fExpVal=atodbl(ExpVal);
    Tolerance = TolerancePercent * 0.01;    
    
    TestStep( StepName, "Result: %.2f Expected: %.2f, Tolerance interval %.2f-%.2f", Result, ExpVal, fExpVal - Tolerance * fExpVal, fExpVal + Tolerance * fExpVal);   
    if ( abs(fResult - fExpVal) <=  Tolerance * fExpVal)    
      testStepPass();
    else
      testStepFail();
  }  
  else
  {
      vCheckStepResultCameraText( StepName, ExpVal, ContainsExpVal, TolerateSimilarChars);
  }
}

//function to test NEGATIVE CASES with text indications. works as previous function but with inverted output
export testfunction CheckStepResultCameraNegativeText(char StepName[],char ExpVal[], int ContainsExpVal, int TolerateSimilarChars)

{
  vCheckStepResultCameraNegativeText( StepName, ExpVal, ContainsExpVal, TolerateSimilarChars);
}

void vCheckStepResultCameraNegativeText (char StepName[], char ExpVal[], int ContainsExpVal, int TolerateSimilarChars)
{   
  char Result[10000];
  
  str_replace(ExpVal," ",""); //spaces are removed from "ExpVal"
  GetOCRStepResult(StepName, Result);
  str_replace(Result," ",""); //spaces are removed from "Result"
  if ( strncmp(Result, "WrongStepName", 100) == 0)
  {
     TestStep( StepName, "Wrong StepName - '%s' not found !", StepName); 
     testStepFail();  
     return;     
  }

  if ( strncmp(ExpVal, "%", 1000) == 0 )
  {
    TestStep(StepName,"ReadText=%s , ExpectedText=any nonempty text", Result );
    if (strlen(Result) >0 )
      testStepPass();
    else
      testStepFail();     
  }
  
  else if (ContainsExpVal == 1)
  {
     if (strstr(Result, ExpVal) > -1)
     {    
       TestStep(StepName,"ReadText='%s' Should not contain ExpectedText=%s", Result, ExpVal); 
       //testStepPass();
      testStepFail();
     }
     else
     {
       TestStep(StepName,"ReadText=%s doesn't contain ExpectedText=%s", Result, ExpVal); 
       //testStepFail();  
      testStepPass();
     }
  }
  else if (TolerateSimilarChars == 1 )
  {
     TestStep(StepName,"ReadText=%s , ExpectedText should be different than '%s'", Result, ExpVal); 
     if (CompareStringsWithTolerance(Result, ExpVal) == 1)
       //testStepPass();  
      testStepFail();  
     else
       //testStepFail();
      testStepPass();
  }
  else
  {
    TestStep(StepName,"ReadText=%s , ExpectedText should be different than: '%s'", Result, ExpVal);
    if (strncmp(ExpVal,Result,10000) == 0 )
      //testStepPass();
      testStepFail();
    else
      //testStepFail();
      testStepPass();
  }
  strncpy(Resultchar,Result,200);
  
}

//checks if given Telltales are on and all others are off
//precondition - all checked Telltales and no other Inspection steps should be in one State
//State - input param, State which contains all Telltales
//one or more Telltales with '|' as delimeter e.g: Tell1|Tell2|Tell3
export testfunction CheckTellTales(char State[], char CheckedTellTales[])
{
  char TellTalesByState[10000];
  char TellTale[100], TellTaleWPipes[100];
  char CheckedTellTalesWPipes[1000];
  int TellTalesNo, i, err; 
  
  err = 0;
  snprintf(CheckedTellTalesWPipes, 1000, "|%s|", CheckedTellTales);   //adds '|' at start and end
  GetStepsByState(State, TellTalesByState );
  TellTalesNo=GetItemsNo(TellTalesByState);
  testStep ("", "Telltales in State %s: %s", State, TellTalesByState);
  testStep ("", "Telltales to be active: %s", CheckedTellTales);
  
  for (i=0; i < TellTalesNo; i++)
  {
     GetStrIndexValue(TellTalesByState, TellTale, i);
     snprintf(TellTaleWPipes, 100, "|%s|", TellTale); 
     
     if ( GetStepResult(TellTale) && strstr( CheckedTellTalesWPipes, TellTaleWPipes ) != -1 )
     {  
        testStep("", "%s OK: is On and should be On", TellTale);
     }     
     else if ( GetStepResult(TellTale) && strstr( CheckedTellTalesWPipes, TellTaleWPipes ) == -1)
     {    
       testStep("", "%s NOK: is On and should be Off", TellTale);
       err++;
     }
     else if ( (GetStepResult(TellTale) == 0) && strstr( CheckedTellTalesWPipes, TellTaleWPipes ) != -1)
     {
       testStep("", "%s NOK: is Off and should be On", TellTale);      
       err++;
     }
  }
  
  if (err)
    testStepFail();
  else
    testStepPass();  
}

//Loads Inspection with InspName  
export testfunction LoadInspection(char InspName[])
{  
  Load_Inspection(InspName);
}

int Load_Inspection(char InspName[])
{
  long result;
  char InspPath[200];
  //char LastInspName[200];
  //Adicionado por Anderson Morelli para debugar a fun? loadinspection
  int z = 0;

  //when Inspection was already loaded -> return
  if (strncmp(LastInspName, InspName, 100) == 0)
    return 1;

  //create absolute path to Inspection and check if this path is correct 
  getAbsFilePath(RelativeInspPath, InspPath, 256); 
  strncat(InspPath, "\\", 256);
  strncat(InspPath, InspName, 256);     
  
  SysSetVariableString(sysvar::Test::sInspPath, InspPath);  
  @sysvar::Test::iCommand = 1;   
  result = 1;    
  
  while (z!=5)
  {
    while ( @sysvar::Test::iCommand != 12 && @sysvar::Test::iCommand != 19 && result != 0) 
    {
      result = TestWaitForSysVar(sysvar::Test::iCommand, 60000);
    }
    if (@sysvar::Test::iCommand == 12)
      z = 5;
    else
      z=z+1;
    testWaitForTimeout(1000);
  }
  z=0;
  //when inspection successfully loaded
  if (@sysvar::Test::iCommand == 12)
  {    
    strncpy (LastInspName, InspName, 100);
    return 1;
  }
  else
  {
    write ("Inspection %s is not valid", InspName);
    //TestStep("Run", "Inspection %s is not valid!", InspName ); 
    TestStep("Run", "Inspection %s is not valid!", InspPath );
    testStepFail();  
    return 0;
  }
}

//runs Inspection
//InspName -optional parameter, when set then it loads and runs Inspection with this name in one step
//when InspName not set, then it runs last loaded Inspection
export testfunction RunInspection(char InspName[])
{  
   Run_Inspection(InspName);
}

void Run_Inspection(char InspName[])
{  
  long result;
  if (strlen( InspName) > 0)
  {
      result = Load_Inspection(InspName);
      if (result==0) return;     //load failed
  }
  
  @sysvar::Test::iCommand = 2;   
  result =1; 
  while ( @sysvar::Test::iCommand != 11 && @sysvar::Test::iCommand != 19 && result != 0) 
  {
    result = TestWaitForSysVar(sysvar::Test::iCommand, 60000);
  }
  
  if ( @sysvar::Test::iCommand == 11)
    TestStep("Run", "Inspection %s started ", InspName ); 
}

//Adds Inspection Image to report
//must precondition for this: path to image is set to Inspection variable ImgPath in Inspection 
export testfunction AddInspectionImageToReport()
{
  AddInspection_ImageToReport();
}

void AddInspection_ImageToReport()
{
  char ImgPath[200], ImgPathLeft[200], ImgPathRight[200];
  
  SysGetVariableString(sysvar::Test::sImgPath, sImgPath, 100 );   
  SysGetVariableString(sysvar::Test::sImgPathLeft, sImgPathLeft, 100 );
  SysGetVariableString(sysvar::Test::sImgPathRight, sImgPathRight, 100 );

  
  testReportAddImage("LEFT Camera", sImgPathLeft, "", "200");//left camera image
  testReportAddImage("CENTER Camera", sImgPath, "", "200");//center camera image  
  testReportAddImage("RIGHT Camera", sImgPathRight, "", "200");//right camera image
}



//****************** default function is now AddInspectionImageToReport()*************
//Adds Inspection Image to report
//Stepname - path to image is taken from String result of Stepname Dois 
/*export testfunction AddInspectionImageToReport(char StepName[])
{
  AddInspection_ImageToReport(StepName); 
}

void AddInspection_ImageToReport(char StepName[]) // With this function it's possible to add to report a picture of a selected camera using the following stepnames: CENTER = Central camera; LEFT = Left camera; RIGHT = right camera; TOP = Top Camera (only for 2810/3410 platform).
{
  char ImagePath[200];
  GetStringStepResult( StepName, ImagePath );
  //write("*******************"); ****** commented by E. Sassi
  //write("%s",ImagePath);  ****** commented by E. Sassi
  //write("*******************");  ****** commented by E. Sassi
  str_replace_regex(ImagePath, "R=", "");
  str_replace_regex(ImagePath, "ES", "E S");
  str_replace_regex(ImagePath, "ImgPath=", "");
  //str_replace_regex(ImagePath, ".*=\\s", "");  ****** commented by E. Sassi due to make sure that the ImagePath is "replacing" the correct text for 3 differents snapshots.
  write("ImagePath=%s", ImagePath);
  //write("####################");
  //write("%s",ImagePath);
  //write("####################");
  testReportAddImage("", ImagePath, "", "200");
}*/ ///****************** default function is now AddInspectionImageToReport()*************

//stores string result from StepName to system variable sv for later usage
//StepName - result of this step will be stored
//sv - System variable without Namespace declared in TAE in Preparation seq
export testfunction StoreStepResultToSysVar(char StepName[], sysvarString *sv )
{
  char Result[1000];
  GetOCRStepResult(StepName, Result); 
  SysSetVariableString(sv, Result ); 
  TestStep("", "Value %s stored to System variable", Result);
}

//converts string result from StepName to float and stores it to float system variable sv for later usage
//StepName - string result of this step will be converted to float and stored
//sv - float System variable without Namespace declared in TAE in Preparation seq
export testfunction StoreConvertedStepResultToSysVar(char StepName[], sysvarFloat *sv )
{  
  char Result[100];
  float fResult;
  
  GetOCRStepResult(StepName, Result);
  str_replace_regex(Result, "[^0-9.-]+", "");  
  fResult=atodbl(Result);
  
  SysSetVariableFloat(sv, fResult);
  TestStep("", "Value %f from Stepname %s stored to System variable", fResult, StepName);
}

//stores numeric result from StepName to float system variable sv for later usage
//StepName - float result of this step will be stored
//sv - float System variable without Namespace declared in TAE in Preparation seq
export testfunction StoreNumericStepResultToSysVar(char StepName[], sysvarFloat *sv )
{
  float fResult;
  fResult=GetStepResult(StepName);   
  SysSetVariableFloat(sv, fResult);
  TestStep("", "Value %f stored to System variable", fResult);
}

//stores value signal to SysVar for later use
//sv - System variable without Namespace declared in TAE in Preparation seq
//sg - signal, which value is stored 
export testfunction StoreSignalToSysvar(sysvarFloat *sv, signal *sg )  
{
  @sv=$sg;      
  TestStep("", "Value %f stored to System variable", @sv);      
}

//modifies value of float SysVar
//sv - System variable without Namespace declared in TAE in Preparation seq
//operator +,-,*,/, NEG can be used
//value - used with operator
export testfunction ChangeSysVar( sysvarFloat *sv, char operator[], float value )
{
  float prev;
  prev=@sv;
  
  if (strncmp(operator,"+",5) == 0)
    @sv=@sv+value;
  else if (strncmp(operator,"-",5) == 0)
    @sv=@sv-value;
  else if (strncmp(operator,"*",5) == 0)
    @sv=@sv*value;
  else if (strncmp(operator,"/",5) == 0)
    @sv=@sv/value;
  else if (strncmp(operator,"NEG",5) == 0)
    @sv=-@sv;    
  testStep("", "SysVarChanged PrevValue=%f NewValue=%f", prev, @sv);  
}

//value from string SysVar is compared to result from StepName or string sValue with Tolerance of Uppercase/Lowercase and similar characters
//sv - name of system variable to which some value was stored in a previous step 
//StepName - string result from this StepName is taken for comparison
//sValue - optional param, string stored in SysVar can be compared to this string, in that case StepName is empty  
export testfunction CompareValueToSysVar(sysvarString *sv, char StepName[], char sValue[])
{
  char Result[1000]; 
  char sSysVarValue[1000];

  SysGetVariableString(sv, sSysVarValue, 1000);
  if (strlen(StepName)>0)  
  {    
    GetOCRStepResult(StepName, Result);  
    TestStep("", "SysVar=%s StepnameVal=%s StepName=%s", sSysVarValue, Result, StepName);     
    if (CompareStringsWithTolerance(Result, sSysVarValue) == 1)
      testStepPass();
    else
      testStepFail();    
  }  
  else if (strlen (sValue)>0)
  {
    TestStep("","SysVar=%s sValue=%s", sSysVarValue, sValue); 
    if (strncmp(sSysVarValue, sValue, 1000 )== 0)
      testStepPass();
    else
      testStepFail();        
  }
  else 
    testStepFail("Input StepName or string sValue for comparison"); 
}

//string result from StepName is converted to float and compared to float SysVar 
//sv - float system variable to which some value was stored in a previous step 
//StepName - string result from this StepName is converted to float and then taken for comparison
//Tolerance - optional parameter, when empty the values must be the same
export testfunction CompareConvertedValueToSysVar(sysvarFloat *sv, char StepName[], float Tolerance)
{
  float fResult; 
  float fSysVarValue;
  char Result[100];  

  fSysVarValue = sysGetVariableFloat(sv);
  GetOCRStepResult(StepName, Result);
  str_replace_regex(Result, "[^0-9.-]+", "");    
  fResult=atodbl(Result);
  
  TestStep("", "SysVar=%f StepnameVal=%f StepName=%s", fSysVarValue, fResult, StepName);     
  if ( abs(fSysVarValue-fResult) <= Tolerance)
    testStepPass();
  else
    testStepFail();      
}

//value from float SysVar is compared to float result from StepName 
//sv - float system variable to which some value was stored in a previous step 
//StepName - float result from this StepName is taken for comparison
//Tolerance - optional parameter, when empty the values must be the same
export testfunction CompareNumericValueToSysVar(sysvarFloat *sv, char StepName[], float Tolerance)
{
  float fResult; 
  float fSysVarValue;

  fSysVarValue = sysGetVariableFloat(sv);
  fResult = GetStepResult(StepName);              
  TestStep("", "SysVar=%f StepnameVal=%f StepName=%s", fSysVarValue, fResult, StepName);     
  if ( abs(fSysVarValue-fResult) <= Tolerance)
    testStepPass();
  else
    testStepFail();      
}

//value of Signal sv is compared to SysVar sg with some Tolerance
//Tolerance -optional, default is 0
export testfunction CompareSignalToSysVar( sysvarfloat *sv, signal *sg, float Tolerance)
{
    TestStep("","SysVar value: %f Signal %s value: %f Tolerance: %f", @sv, sg.name, $sg, Tolerance); 
    if (abs (@sv - $sg) <= Tolerance )
      testStepPass();
    else
      testStepFail();               
}

//reads values from Excel table:
//ExcelPath - path to Excel table
//IDValue - ID of Row, which will be selected
//ExcelColumns - names of Columns which will be returned with '|' delimeter, e.g "Col1|Col2|Col3"
//ExcelSheet -name of Sheet, optional parameter, when no specified first sheet used 
//IDColumn - name of Column with IDs, optional parameter, when no specified first column used

//ExcelColumnVals - name of glabal variable used for returning results from Excel table,
//if there are more columns in ExcelColumns param then there also more values in ExcelColumnVals with '|' delimeter  
//values can be then accessed by this function:  GetStrIndexValue(ExcelColumnVals, CANSignal, 0 ) - returns the value from first spec. column to string CANSignal 
void GetValuesFromExcel(char ExcelPath[], char IDValue[], char ExcelColumns[], char ExcelSheet[], char IDColumn[] )
{
  long result =1; 

  SysSetVariableString(sysvar::Test::sExcelPath, ExcelPath);  
  SysSetVariableString(sysvar::Test::sIDValue, IDValue);  
  SysSetVariableString(sysvar::Test::sExcelColumns, ExcelColumns);  
  SysSetVariableString(sysvar::Test::sExcelSheet, ExcelSheet);  
  SysSetVariableString(sysvar::Test::sIDColumn, IDColumn);    
  testWaitForTimeout(20);  //necessary delay to change variables
  
  @sysvar::Test::iCommand = 30;
  result =1;   
  while ( @sysvar::Test::iCommand != 31 && @sysvar::Test::iCommand != 39 && result != 0) 
  {
    result = TestWaitForSysVar(sysvar::Test::iCommand, 20000);
  }  
  
  SysGetVariableString(sysvar::Test::sExcelColumnValues, ExcelColumnVals, 1000); 
  write ("ExcelColumnValues=%s", ExcelColumnVals);
}

//This Function is used for sum two system variables
export testfunction Sum_Sysvar (sysvarFloat *sv1, sysvarFloat *sv2, sysvarFloat *svR )
{
  testModuleTitle("SUMSYSVAR");
  write("SUMSYSVAR");
  
   @svR = @sv1 +@sv2;   
  
}

export testfunction SearchVEHICLEINFO(char MenuName[])
{  
  Search_VEHICLEINFO(MenuName);
}
void Search_VEHICLEINFO(char MenuName[])
{
  char OldInspName[200];
  int cont = 0;
  int i = 0;
  char Result[200];
  
  //strncpy(OldInspName, LastInspName,100);
  //testWaitForTimeout(1000);
  
  //Load_Inspection("Check_Menu.vbai");
  
  testWaitForTimeout(1000);
  sysSetVariableInt(sysvar::RoadMap::LeftKeyStuck,1);
  testWaitForTimeout (50);
  sysSetVariableInt(sysvar::RoadMap::LeftKeyStuck,0);
  testWaitForTimeout (1000);
  Run_Inspection(InspName);
  
  GetOCRStepResult("Menu Search Loop", Result);
  TestStep("------", "------------------------------------------------------------------------------------------------------"); 
  for(i=0;i<= strlen(Result);i++)
  {
    Result[i] = toUpper(Result[i]);
  }
  while (strncmp(Result,MenuName,1000)!=0 && cont != 15)
  {
    sysSetVariableInt(sysvar::RoadMap::RightKeyStuck,1);
    testWaitForTimeout (50);
    sysSetVariableInt(sysvar::RoadMap::RightKeyStuck,0);
    testWaitForTimeout(1000);
    Run_Inspection(InspName);
    GetOCRStepResult("SUBMENU", Result);
    for(i=0;i<= strlen(Result);i++)
    {
      Result[i] = toUpper(Result[i]);
    }
    TestStep("Menu Search Loop", "Text read: %s", Result); 
    TestStep("------", "------------------------------------------------------------------------------------------------------"); 
    cont++;
  }
  if (cont >= 15)
  {
    TestStep("Menu Search Loop", "Menu requested (%s) was not found",MenuName); 
    testStepFail(); 
  }
  else
  {
    testStepPass();
  }
  /*if (strlen(OldInspName) >0 )
    Load_Inspection(OldInspName);*/
  cont = 0;
}

export testfunction SearchMenuMultiLang(char MenuNameUK[],char MenuNameUS[],char MenuNameIT[],char MenuNameSP[])
{  
  Search_Menu_Multi(MenuNameUK,MenuNameUS,MenuNameIT,MenuNameSP);
}
void Search_Menu_Multi(char MenuNameUK[],char MenuNameUS[],char MenuNameIT[],char MenuNameSP[])
{
  char OldInspName[200];
  int cont = 0;
  int i = 0;
  char Result[200];
  
  //strncpy(OldInspName, LastInspName,100);
  //testWaitForTimeout(1000);
  
  //Load_Inspection("CMMulti.vbai");
  
  testWaitForTimeout(1000);
  sysSetVariableInt(sysvar::RoadMap::UPKeyStuck,1);
  testWaitForTimeout (50);
  sysSetVariableInt(sysvar::RoadMap::UPKeyStuck,0);
  testWaitForTimeout (2000);
  Run_Inspection(InspName);
  
  GetOCRStepResult("Menu Search Loop", Result);
  TestStep("------", "------------------------------------------------------------------------------------------------------"); 
  for(i=0;i<= strlen(Result);i++)
  {
    Result[i] = toUpper(Result[i]);
  }
  while (strncmp(Result,MenuNameUK,1000)!=0 && strncmp(Result,MenuNameUS,1000)!=0 && strncmp(Result,MenuNameIT,1000)!=0 &&  strncmp(Result,MenuNameSP,1000)!=0 && cont != 15)
  {
    sysSetVariableInt(sysvar::RoadMap::DownKeyStuck,1);
    testWaitForTimeout (50);
    sysSetVariableInt(sysvar::RoadMap::DownKeyStuck,0);
    testWaitForTimeout(2000);
    Run_Inspection(InspName);
    GetOCRStepResult("CheckMenu", Result);
    for(i=0;i<= strlen(Result);i++)
    {
      Result[i] = toUpper(Result[i]);
    }
    TestStep("Menu Search Loop", "Text read: %s", Result); 
    TestStep("------", "------------------------------------------------------------------------------------------------------"); 
    cont++;
  }
  if (cont >= 15)
  {
    TestStep("Menu Search Loop", "Menu requested was not found UK: %s",MenuNameUK);
    TestStep("Menu Search Loop", "Menu requested was not found US: %s",MenuNameUS);
    TestStep("Menu Search Loop", "Menu requested was not found IT: %s",MenuNameIT);
    TestStep("Menu Search Loop", "Menu requested was not found SP: %s",MenuNameSP);
    testStepFail(); 
  }
  else
  {
    testStepPass();
  }
  /*if (strlen(OldInspName) >0 )
  {
    testWaitForTimeout(1000);
    Load_Inspection(OldInspName);
  }*/
  cont = 0;
}

//SEARCH MENU COMPLETO LEVEL 2 // Added by Elivelton Sassi - 26.02.19 Due to check the Second level of the Menus (Speed Warning per example).

export testfunction SearchMenu_Level2(char MenuName[], char Name[], int direction)
{ 
  Search_Menu_Level2(MenuName, Name, direction);
}
void Search_Menu_Level2(char MenuName[], char Name[], int direction)
{
  //int testando[1][4] = {1,2,"LEFT","RIGHT"};
  char OldInspName[200];
  int cont = 0;
  int i = 0;
  char Result[200];
  //strncpy(OldInspName, LastInspName,100);
  //testWaitForTimeout(1000);
  //Load_Inspection("Check_Menu.vbai");
  //direction_b=["UP","DOWN","LEFT","RIGHT"];

  testWaitForTimeout(500);
  switch(direction)
  {
    case 1:
      sysSetVariableInt(sysvar::RoadMap::DownKeyStuck, 1);
      testWaitForTimeout (50);
      sysSetVariableInt(sysvar::RoadMap::DownKeyStuck, 0);
      break;
    case 2:
      sysSetVariableInt(sysvar::RoadMap::LeftKeyStuck, 1);
      testWaitForTimeout (50);
      sysSetVariableInt(sysvar::RoadMap::LeftKeyStuck, 0);
      break;
    case 3:
      sysSetVariableInt(sysvar::RoadMap::UPKeyStuck, 1);
      testWaitForTimeout (50);
      sysSetVariableInt(sysvar::RoadMap::UPKeyStuck, 0);
      break;
    case 4:
      sysSetVariableInt(sysvar::RoadMap::RightKeyStuck, 1);
      testWaitForTimeout (50);
      sysSetVariableInt(sysvar::RoadMap::RightKeyStuck, 0);
      break;      
  }
  testWaitForTimeout (500);
  Run_Inspection(InspName);
  GetOCRStepResult("Menu Search Loop", Result);
  TestStep("------", "------------------------------------------------------------------------------------------------------"); 
  for(i=0;i<= strlen(Result);i++)
  {
    Result[i] = toUpper(Result[i]);
  }
  while (strncmp(Result,MenuName,200)!=0 && cont != 20)
  {
  switch(direction)
  {
    case 1:
      sysSetVariableInt(sysvar::RoadMap::UPKeyStuck, 1);
      testWaitForTimeout (50);
      sysSetVariableInt(sysvar::RoadMap::UPKeyStuck, 0);
      break;
    case 2:
      sysSetVariableInt(sysvar::RoadMap::RightKeyStuck, 1);
      testWaitForTimeout (50);
      sysSetVariableInt(sysvar::RoadMap::RightKeyStuck, 0);
      break;
    case 3:
      sysSetVariableInt(sysvar::RoadMap::DownKeyStuck, 1);
      testWaitForTimeout (50);
      sysSetVariableInt(sysvar::RoadMap::DownKeyStuck, 0);
      break;
    case 4:
      sysSetVariableInt(sysvar::RoadMap::LeftKeyStuck, 1);
      testWaitForTimeout (50);
      sysSetVariableInt(sysvar::RoadMap::LeftKeyStuck, 0);
      break;      
    }
    testWaitForTimeout(500);//Wait Time
    Run_Inspection(InspName);
    GetOCRStepResult(Name, Result);//MENU
    for(i=0;i<= strlen(Result);i++)
    {
      Result[i] = toUpper(Result[i]);
    }
    TestStep("Menu Search Loop", "Text read: %s", Result); 
    TestStep("------", "------------------------------------------------------------------------------------------------------"); 
    cont++;
  }
  if (cont >= 20)
  {
    TestStep("Menu Search Loop", "Menu requested (%s) was not found",MenuName); 
    testStepFail(); 
  }
  else
  {
    testStepPass();
  }
  /*if (strlen(OldInspName) >0 )
    Load_Inspection(OldInspName);*/
  cont = 0;
}


//SEARCH MENU COMPLETO
export testfunction SearchMenu(char MenuName[], char Name[], int direction)
{ 
  Search_Menu(MenuName, Name, direction);
}
void Search_Menu(char MenuName[], char Name[], int direction)
{
  //int testando[1][4] = {1,2,"LEFT","RIGHT"};
  char OldInspName[200];
  int cont = 0;
  int i = 0;
  char Result[200];
  //strncpy(OldInspName, LastInspName,100);
  //testWaitForTimeout(1000);
  //Load_Inspection("Check_Menu.vbai");
  //direction_b=["UP","DOWN","LEFT","RIGHT"];

  testWaitForTimeout(500);
  switch(direction)
  {
    case 1:
      sysSetVariableInt(sysvar::RoadMap::DownKeyStuck, 1);
      testWaitForTimeout (150);
      sysSetVariableInt(sysvar::RoadMap::DownKeyStuck, 0);
      break;
    case 2:
      sysSetVariableInt(sysvar::RoadMap::LeftKeyStuck, 1);
      testWaitForTimeout (150);
      sysSetVariableInt(sysvar::RoadMap::LeftKeyStuck, 0);
      break;
    case 3:
      sysSetVariableInt(sysvar::RoadMap::UPKeyStuck, 1);
      testWaitForTimeout (150);
      sysSetVariableInt(sysvar::RoadMap::UPKeyStuck, 0);
      break;
    case 4:
      sysSetVariableInt(sysvar::RoadMap::RightKeyStuck, 1);
      testWaitForTimeout (150);
      sysSetVariableInt(sysvar::RoadMap::RightKeyStuck, 0);
      break; 
    case 5:
      sysSetVariableInt(sysvar::RoadMap::EnterKeyStuck, 1);
      testWaitForTimeout (150);
      sysSetVariableInt(sysvar::RoadMap::EnterKeyStuck, 0);
      break;
  }
  testWaitForTimeout (500);
  Run_Inspection(InspName);
  GetOCRStepResult("Menu Search Loop", Result);
  TestStep("------", "------------------------------------------------------------------------------------------------------"); 
  for(i=0;i<= strlen(Result);i++)
  {
    Result[i] = toUpper(Result[i]);
  }
  while (strncmp(Result,MenuName,200)!=0 && cont != 15)
  {
  switch(direction)
  {
    case 1:
      sysSetVariableInt(sysvar::RoadMap::UPKeyStuck, 1);
      testWaitForTimeout (150);
      sysSetVariableInt(sysvar::RoadMap::UPKeyStuck, 0);
      break;
    case 2:
      sysSetVariableInt(sysvar::RoadMap::RightKeyStuck, 1);
      testWaitForTimeout (150);
      sysSetVariableInt(sysvar::RoadMap::RightKeyStuck, 0);
      break;
    case 3:
      sysSetVariableInt(sysvar::RoadMap::DownKeyStuck, 1);
      testWaitForTimeout (150);
      sysSetVariableInt(sysvar::RoadMap::DownKeyStuck, 0);
      break;
    case 4:
      sysSetVariableInt(sysvar::RoadMap::LeftKeyStuck, 1);
      testWaitForTimeout (150);
      sysSetVariableInt(sysvar::RoadMap::LeftKeyStuck, 0);
      break;  
    case 5:
      sysSetVariableInt(sysvar::RoadMap::EnterKeyStuck, 1);
      testWaitForTimeout (150);
      sysSetVariableInt(sysvar::RoadMap::EnterKeyStuck, 0);
      break;
    }
    testWaitForTimeout(500);//Wait Time
    Run_Inspection(InspName);
    GetOCRStepResult(Name, Result);//MENU
    for(i=0;i<= strlen(Result);i++)
    {
      Result[i] = toUpper(Result[i]);
    }
    TestStep("Menu Search Loop", "Text read: %s", Result); 
    TestStep("------", "------------------------------------------------------------------------------------------------------"); 
    cont++;
  }
  if (cont >= 15)
  {
    TestStep("Menu Search Loop", "Menu requested (%s) was not found",MenuName); 
    testStepFail(); 
  }
  else
  {
    testStepPass();
  }
  /*if (strlen(OldInspName) >0 )
    Load_Inspection(OldInspName);*/
  cont = 0;
}
//END MENU COMPLETO

//SEARCH MENU COMPLETO
export testfunction SearchMenu1(char MenuName[], char Name[], int direction)
{ 
  Search_Menu(MenuName, Name, direction);
}
void Search_Menu1(char MenuName[], char Name[], int direction)
{
  //int testando[1][4] = {1,2,"LEFT","RIGHT"};
  char OldInspName[200];
  int cont = 0;
  int i = 0;
  char Result[200];
  //strncpy(OldInspName, LastInspName,100);
  //testWaitForTimeout(1000);
  //Load_Inspection("Check_Menu.vbai");
  //direction_b=["UP","DOWN","LEFT","RIGHT"];

  testWaitForTimeout(500);
  switch(direction)
  {
    case 1:
      sysSetVariableInt(sysvar::RoadMap::DownKeyStuck, 1);
      testWaitForTimeout (50);
      sysSetVariableInt(sysvar::RoadMap::DownKeyStuck, 0);
      break;
    case 2:
      sysSetVariableInt(sysvar::RoadMap::LeftKeyStuck, 1);
      testWaitForTimeout (50);
      sysSetVariableInt(sysvar::RoadMap::LeftKeyStuck, 0);
      break;
    case 3:
      sysSetVariableInt(sysvar::RoadMap::UPKeyStuck, 1);
      testWaitForTimeout (50);
      sysSetVariableInt(sysvar::RoadMap::UPKeyStuck, 0);
      break;
    case 4:
      sysSetVariableInt(sysvar::RoadMap::RightKeyStuck, 1);
      testWaitForTimeout (50);
      sysSetVariableInt(sysvar::RoadMap::RightKeyStuck, 0);
      break;      
  }
  testWaitForTimeout (500);
  Run_Inspection(InspName);
  GetOCRStepResult("Menu Search Loop", Result);
  TestStep("------", "------------------------------------------------------------------------------------------------------"); 
  for(i=0;i<= strlen(Result);i++)
  {
    Result[i] = toUpper(Result[i]);
  }
  while (strncmp(Result,MenuName,200)!=0 && cont != 15)
  {
  switch(direction)
  {
    case 1:
      sysSetVariableInt(sysvar::RoadMap::UPKeyStuck, 1);
      testWaitForTimeout (50);
      sysSetVariableInt(sysvar::RoadMap::UPKeyStuck, 0);
      break;
    case 2:
      sysSetVariableInt(sysvar::RoadMap::RightKeyStuck, 1);
      testWaitForTimeout (50);
      sysSetVariableInt(sysvar::RoadMap::RightKeyStuck, 0);
      break;
    case 3:
      sysSetVariableInt(sysvar::RoadMap::DownKeyStuck, 1);
      testWaitForTimeout (50);
      sysSetVariableInt(sysvar::RoadMap::DownKeyStuck, 0);
      break;
    case 4:
      sysSetVariableInt(sysvar::RoadMap::LeftKeyStuck, 1);
      testWaitForTimeout (50);
      sysSetVariableInt(sysvar::RoadMap::LeftKeyStuck, 0);
      break;      
    }
    testWaitForTimeout(500);//Wait Time
    Run_Inspection(InspName);
    GetOCRStepResult(Name, Result);//MENU
    for(i=0;i<= strlen(Result);i++)
    {
      Result[i] = toUpper(Result[i]);
    }
    TestStep("Menu Search Loop", "Text read: %s", Result); 
    TestStep("------", "------------------------------------------------------------------------------------------------------"); 
    cont++;
  }
  if (cont >= 15)
  {
    TestStep("Menu Search Loop", "Menu Passenger AirBag was not found",MenuName);
    testStepPass(); 
  }
  else
  {
    //testStepPass();
  }
  /*if (strlen(OldInspName) >0 )
    Load_Inspection(OldInspName);*/
  cont = 0;
}
//END MENU COMPLETO

//SEARCH TITLE COMPLETO added By Elivelton Sassi

export testfunction SearchTitle(char TitleName[], char StepName[], int direction)
{ 
  Search_Title(TitleName, StepName, direction);
}
void Search_Title(char TitleName[], char StepName[], int direction)
{
  //int testando[1][4] = {1,2,"LEFT","RIGHT"};
  char OldInspName[200];
  int cont = 0;
  int i = 0;
  char Result[200];
  //strncpy(OldInspName, LastInspName,100);
  //testWaitForTimeout(1000);
  //Load_Inspection("Check_Menu.vbai");
  //direction_b=["UP","DOWN","LEFT","RIGHT"];

  testWaitForTimeout(500);
  switch(direction)
  {
    case 1:
      sysSetVariableInt(sysvar::RoadMap::DownKeyStuck, 1);
      testWaitForTimeout (100);
      sysSetVariableInt(sysvar::RoadMap::DownKeyStuck, 0);
      break;
    case 2:
      sysSetVariableInt(sysvar::RoadMap::LeftKeyStuck, 1);
      testWaitForTimeout (100);
      sysSetVariableInt(sysvar::RoadMap::LeftKeyStuck, 0);
      break;
    case 3:
      sysSetVariableInt(sysvar::RoadMap::UPKeyStuck, 1);
      testWaitForTimeout (100);
      sysSetVariableInt(sysvar::RoadMap::UPKeyStuck, 0);
      break;
    case 4:
      sysSetVariableInt(sysvar::RoadMap::RightKeyStuck, 1);
      testWaitForTimeout (100);
      sysSetVariableInt(sysvar::RoadMap::RightKeyStuck, 0);
      break;      
  }
  testWaitForTimeout (500);
  Run_Inspection(InspName);
  GetOCRStepResult("Title Search Loop", Result);
  TestStep("------", "------------------------------------------------------------------------------------------------------"); 
  for(i=0;i<= strlen(Result);i++)
  {
    Result[i] = toUpper(Result[i]);
  }
  while (strncmp(Result,TitleName,200)!=0 && cont != 15)
  {
  switch(direction)
  {
    case 1:
      sysSetVariableInt(sysvar::RoadMap::UPKeyStuck, 1);
      testWaitForTimeout (50);
      sysSetVariableInt(sysvar::RoadMap::UPKeyStuck, 0);
      break;
    case 2:
      sysSetVariableInt(sysvar::RoadMap::RightKeyStuck, 1);
      testWaitForTimeout (50);
      sysSetVariableInt(sysvar::RoadMap::RightKeyStuck, 0);
      break;
    case 3:
      sysSetVariableInt(sysvar::RoadMap::DownKeyStuck, 1);
      testWaitForTimeout (50);
      sysSetVariableInt(sysvar::RoadMap::DownKeyStuck, 0);
      break;
    case 4:
      sysSetVariableInt(sysvar::RoadMap::LeftKeyStuck, 1);
      testWaitForTimeout (50);
      sysSetVariableInt(sysvar::RoadMap::LeftKeyStuck, 0);
      break;      
    }
    testWaitForTimeout(500);//Wait Time
    Run_Inspection(InspName);
    GetOCRStepResult(StepName, Result);//MENU
    for(i=0;i<= strlen(Result);i++)
    {
      Result[i] = toUpper(Result[i]);
    }
    TestStep("Menu Search Loop", "Text read: %s", Result); 
    TestStep("------", "------------------------------------------------------------------------------------------------------"); 
    cont++;
  }
  if (cont >= 15)
  {
    TestStep("Menu Search Loop", "Menu requested (%s) was not found",TitleName); 
    testStepFail(); 
  }
  else
  {
    testStepPass();
  }
  /*if (strlen(OldInspName) >0 )
    Load_Inspection(OldInspName);*/
  cont = 0;
}
//END TITLE COMPLETO


//SEARCH DATA
export testfunction SearchDate(char Date[], char StepName[])
{ 
  Search_Date(Date, StepName);
}
void Search_Date(char Date[], char StepName[])
{
  char OldInspName[200];
  int cont = 0;
  char Result[200];
  long iResult = 0;
  long iDate = 0;
  int contador = 5;
  int num = 0;
  int a;
  int pass = 0;
  
  testWaitForTimeout (2000);
  Run_Inspection(InspName);
  GetOCRStepResult("Data Search Loop", Result);
  TestStep("------", "------------------------------------------------------------------------------------------------------");
  testWaitForTimeout(2000);
  Run_Inspection(InspName);
  GetOCRStepResult(StepName, Result);//MENU

  iResult = atol(Result);
  iDate = atol(Date);

    iDate = atol(Date);
    for(i=0; i<=contador; i++)
    {
        testWaitForTimeout (2000);
        Run_Inspection(InspName);
        GetOCRStepResult("Data Search Loop", Result);
        TestStep("------", "------------------------------------------------------------------------------------------------------");
        testWaitForTimeout(2000);
        Run_Inspection(InspName);
        GetOCRStepResult(StepName, Result);//MENU
        
        iResult = atol(Result);
        write("iResult = %d", iResult);
        write("iDate = %d", iDate);
        if (iResult != iDate)
        {
            num = iDate - iResult;
            for(a=1; a<=abs(num); a++)
            {   
                write("num up = %d", num);
                if(iResult < iDate)
                {
                    testWaitForTimeout (500);
                    sysSetVariableInt(sysvar::RoadMap::UPKeyStuck, 1);
                    testWaitForTimeout (500);
                    sysSetVariableInt(sysvar::RoadMap::UPKeyStuck, 0);
                    testWaitForTimeout (500);
                    write("UP");
                }
                else
                {
                    if(iResult > iDate)
                    {       
                            write("num down = %d", num);
                            testWaitForTimeout (500);
                            sysSetVariableInt(sysvar::RoadMap::DownKeyStuck, 1);
                            testWaitForTimeout (500);
                            sysSetVariableInt(sysvar::RoadMap::DownKeyStuck, 0);
                            testWaitForTimeout (500);
                            write("DOWN");
                    }
                        
                }
            }
        }
        else
        {
            i = contador;
            pass = 1;
        }
    }
  if(pass == 1)
  {
    TestStep("Set Date Search", "Read =(%d)",iResult, "Expected = (%d)", iDate);
    testStepPass();
  }else
    {
      TestStep("Set Date Search", "Read =(%d)",iResult, "Expected = (%d)", iDate); 
      testStepFail();
    }
}

//switches IPC to DIGITIAL or ANALOG screen -> requires a pre-loaded inspection!
export testfunction ANLG_DIG_Screen(char StringToSearch[], char StepName[])//String to search: "HOLD OK FOR ANALOG" or "HOLD OK FOR DIGITAL"
{ 
  ANALOG_DIG_Screen(StringToSearch, StepName);
}
void ANALOG_DIG_Screen(char StringToSearch[], char StepName[])
{
  int cont = 0;
  int i = 0;
  char Result[200];
  const int countMax = 3;//max number of try

  testWaitForTimeout(500);
  // press enter to show text
  sysSetVariableInt(sysvar::RoadMap::EnterKeyStuck, 1);
  testWaitForTimeout (50);
  sysSetVariableInt(sysvar::RoadMap::EnterKeyStuck, 0);
  
  
  Run_Inspection(InspName);
  GetOCRStepResult(StepName, Result);
  //GetOCRStepResult("Analogic/Digital search", Result);
  TestStep("------", "------------------------------------------------------------"); 
  
  for(i=0;i<= strlen(Result);i++)
  {
    Result[i] = toUpper(Result[i]);
  }//to Uppercase
  
  
  while (strncmp(Result,StringToSearch,200)!=0 && cont != countMax)
  {
    sysSetVariableInt(sysvar::RoadMap::EnterKeyStuck, 1);
	  testWaitForTimeout (1000);//hold OK
	  sysSetVariableInt(sysvar::RoadMap::EnterKeyStuck, 0);
    testWaitForTimeout(500);
    Run_Inspection(InspName);
	
    GetOCRStepResult(StepName, Result);
    for(i=0;i<= strlen(Result);i++)
    {
      Result[i] = toUpper(Result[i]);
    }
    TestStep("Analog/Digital search", "Text read: %s", Result); 
    TestStep("------", "---------------------------------------------------------"); 
    cont++;
  }
  if (cont >= countMax)
  {
    TestStep("Error!", "Could not switch Analog/Digital in display"); 
    testStepFail(); 
  }
  else
  {
    testStepPass();
  }
  cont = 0;
}
//END ANALOG-DIGITAL

export testfunction ProxiWriteCounterReset() //Reset Proxi Write Counter value to 0
{
	DIAGNOSTIC_REQUEST_IPC_msg.id=0x18DA60F1x;
	DIAGNOSTIC_REQUEST_IPC_msg.dlc = 8;
	DIAGNOSTIC_REQUEST_IPC_msg.byte(0) = 0x10; 
	DIAGNOSTIC_REQUEST_IPC_msg.byte(1) = 0x0B;
	DIAGNOSTIC_REQUEST_IPC_msg.byte(2) = 0x31;
	DIAGNOSTIC_REQUEST_IPC_msg.byte(3) = 0x01;
	DIAGNOSTIC_REQUEST_IPC_msg.byte(4) = 0x00;
	DIAGNOSTIC_REQUEST_IPC_msg.byte(5) = 0x61;
	DIAGNOSTIC_REQUEST_IPC_msg.byte(6) = 0x80;
	DIAGNOSTIC_REQUEST_IPC_msg.byte(7) = 0x00;
	output(DIAGNOSTIC_REQUEST_IPC_msg);
	testWaitForTimeout(10);
  
  DIAGNOSTIC_REQUEST_IPC_msg.id=0x18DA60F1x;
	DIAGNOSTIC_REQUEST_IPC_msg.dlc = 8;
  DIAGNOSTIC_REQUEST_IPC_msg.byte(0) = 0x21;
	DIAGNOSTIC_REQUEST_IPC_msg.byte(1) = 0x80; 
	DIAGNOSTIC_REQUEST_IPC_msg.byte(2) = 0x01;
	DIAGNOSTIC_REQUEST_IPC_msg.byte(3) = 0xFF;
	DIAGNOSTIC_REQUEST_IPC_msg.byte(4) = 0x01;
	DIAGNOSTIC_REQUEST_IPC_msg.byte(5) = 0x00;
  DIAGNOSTIC_REQUEST_IPC_msg.byte(6) = 0x00;
  DIAGNOSTIC_REQUEST_IPC_msg.byte(7) = 0x00;
	output(DIAGNOSTIC_REQUEST_IPC_msg);
	testWaitForTimeout(10);
}

//Set Command Ignition

export testfunction Command_Ignition_IGN_START ()
{
  int cmdign = 0;
  cmdign = sysGetVariableInt(sysvar::RoadMap::CmdIgnSts);
  testModuleTitle("Command_Ignition_IGN_START");
  write("Command_Ignition_IGN_START");
  switch(cmdign)
  {
    case 2:
      testWaitForTimeout(delay_time);
      sysSetVariableInt(sysvar::RoadMap::CmdIgnSts,4);
    break;

    case 3:
      testWaitForTimeout(delay_time);
      sysSetVariableInt(sysvar::RoadMap::CmdIgnSts,4);
    break;
            
    case 4:
	  sysSetVariableInt(sysvar::RoadMap::CmdIgnSts,4);
    break;
    
	case 5:
	  sysSetVariableInt(sysvar::RoadMap::CmdIgnSts,4);
    break;
	
	case 6:
	  sysSetVariableInt(sysvar::RoadMap::CmdIgnSts,4);
    break;

    case 7:
	  sysSetVariableInt(sysvar::RoadMap::CmdIgnSts,4);
    break;

    case 8:
	  sysSetVariableInt(sysvar::RoadMap::CmdIgnSts,4);
    break;
    	
  }    
}

export testfunction Command_Ignition_IGN_RUN ()
{
  int cmdign = 0;
  cmdign = sysGetVariableInt(sysvar::RoadMap::CmdIgnSts);
  testModuleTitle("Command_Ignition_IGN_RUN");
  write("Command_Ignition_IGN_RUN");
  switch(cmdign)
  {
    case 2:
      testWaitForTimeout (delay);
      sysSetVariableInt(sysvar::RoadMap::CmdIgnSts,4);
      testWaitForTimeout (delay);
      sysSetVariableInt(sysvar::RoadMap::CmdIgnSts,5);
      testWaitForTimeout (delay);
    break;

    case 3:
      testWaitForTimeout (delay);
      sysSetVariableInt(sysvar::RoadMap::CmdIgnSts,4);
      testWaitForTimeout (delay);
      sysSetVariableInt(sysvar::RoadMap::CmdIgnSts,5);
      testWaitForTimeout (delay);
    break;
            
    case 4:
      testWaitForTimeout (delay);
      sysSetVariableInt(sysvar::RoadMap::CmdIgnSts,5);   
    break;
      
    case 5:
      testWaitForTimeout (delay);
      sysSetVariableInt(sysvar::RoadMap::CmdIgnSts,5);
    break;
      
    case 6:
      testWaitForTimeout (delay);
      sysSetVariableInt(sysvar::RoadMap::CmdIgnSts,5);
    break;
      
    case 7:
      testWaitForTimeout (delay);
      sysSetVariableInt(sysvar::RoadMap::CmdIgnSts,5);
    break;
      
    case 8:
      testWaitForTimeout (delay);
      sysSetVariableInt(sysvar::RoadMap::CmdIgnSts,5);
    break;
	
  }
}

export testfunction Command_Ignition_IGN_ACC()
{
  testModuleTitle("Command_Ignition_IGN_ACC");
  write("Command_Ignition_IGN_ACC");
  testWaitForTimeout(delay);
  sysSetVariableInt(sysvar::RoadMap::CmdIgnSts,3);
}

export testfunction Command_Ignition_IGN_LK()
{
  testModuleTitle("Command_Ignition_IGN_LK");
  write("Command_Ignition_IGN_LK");
  testWaitForTimeout(delay);
  sysSetVariableInt(sysvar::RoadMap::CmdIgnSts,1);
}

export testfunction Command_Ignition_Initialization()
{
  testModuleTitle("Command_Ignition_Initialization");
  write("Command_Ignition_Initialization");
  testWaitForTimeout(delay);
  sysSetVariableInt(sysvar::RoadMap::CmdIgnSts,0);
}

export testfunction ResetCCAN()
{
	resetCanEx(1);
}

export testfunction ResetBHCAN()
{
	resetCanEx(2);
}

export testfunction CCANMissingMessage()
{
  CANstressOpen("Test Module/CANStress/CCAN_MissingMessage1.cst");
  CANStressStart();
  if(CANstressWaitForFinished(15000) == 0)
  {
   resetCanEx(1);
    resetCanEx(2);
  }
  else
  {
    write("CANStress test timeout!");
  }
}

export testfunction BHCANMissingMessage()
{
	CANstressOpen("Test Module/CANStress/BHCAN_MissingMessage1.cst");
  CANStressStart();
  if(CANstressWaitForFinished(15000) == 0)
  {
   resetCanEx(1);
   resetCanEx(2);
  }
  else
  {
   write("CANStress test timeout!");
  }
}

export testfunction CCANBusOff()
{
  CANstressOpen("Test Module/CANStress/CCAN_Busoff1.cst");
//CANstressSetDevice(3);
//CANstressSetContinuousDisturbanceTimeLimited(2000,4);
//CANstressSetResistor(3,0);
  CANStressStart();
  if(CANstressWaitForFinished(5000) == 0)
  {
    resetCanEx(1);
    resetCanEx(2);
  }
  else
  {
    write("CANStress test timeout!");
  }
}

export testfunction BHCANBusOff()
{
  CANstressOpen("Test Module/CANStress/BHCAN_Busoff1.cst");
  //  CANstressSetDevice(1);
  //  CANstressSetContinuousDisturbanceTimeLimited(2000,4);
  //  CANstressSetResistor(3,0);
  CANStressStart();
  if(CANstressWaitForFinished(5000) == 0)
  {
    resetCanEx(1);
    resetCanEx(2);
  }
  else
  {
    write("CANStress test timeout!");
  }
}