/*@!Encoding:1252*/
//Changelog


includes
{
 //#include "VBAIResults.can"
}

variables
{
	const CMRIF_01 = 13;
	const CMRIF_02 = 14;
	const CMRIF_03 = 12;
	const CMRIF_04 = 11;
	const CMRIF_05 = 10;
	const CMRIF_06 = 5;
	const CMRIF_07 = 8;
	const CMRIF_08 = 7;
	const CMRIF_09 = 9;
	const N_ServiceCouponLim_0 = 0;
	const N_ServiceCouponLim_1 = 1;
	const N_ServiceCouponLim_2 = 2;
	const N_ServiceCouponLim_3 = 3;
	const N_ServiceCouponLim_4 = 4;
	const N_ServiceCouponLim_5 = 5;
	const N_ServiceCouponLim_6 = 6;
	const N_ServiceCouponLim_7 = 7;
	const N_ServiceCouponLim_8 = 8;
	const N_ServiceCouponLim_9 = 9;
	const N_ServiceCouponLim_10 = 10;
	const N_ServiceCouponLim_11 = 11;
	const N_ServiceCouponLim_12 = 12;
	const N_ServiceCouponLim_13 = 13;
	const N_ServiceCouponLim_14 = 14;
	const N_ServiceCouponLim_15 = 15;
	const Speedometer_Tolerance_0 = 0;
	const Speedometer_Tolerance_1 = 1;
	const Speedometer_Tolerance_2 = 2;
	const Speedometer_Tolerance_3 = 3;
	const Speedometer_Tolerance_4 = 4;
	const Speedometer_Tolerance_5 = 5;
	const Speedometer_Tolerance_6 = 6;
	const Speedometer_Tolerance_7 = 7;
	const Speedometer_Tolerance_8 = 8;
	const Speedometer_Tolerance_9 = 9;
	const Speedometer_Tolerance_10 = 10;
	const Speedometer_Tolerance_11 = 11;
	const Speedometer_Tolerance_12 = 12;
	const Speedometer_Tolerance_13 = 13;
	const Speedometer_Tolerance_14 = 14;
	const Speedometer_Tolerance_15 = 15;
	const Speedometer_Tolerance_16 = 16;
	const Tank_Fuel_Capacity_51L = 51;
	const Advanced_Driver_Program_Kind_Button_Sport = 2;
	const AHBM_Present  = 0;
	const AHBM_Absent = 0;
	const AHBM_Feature_Menu_Present = 1;
	const AHBM_Feature_Menu_Absent = 0;
	const Alarm_System_Present = 1;
	const Alarm_System_Absent = 0;
	const Ambient_Dimmer_Switch_Present = 1;
	const Ambient_Dimmer_Switch_Absent = 0;
	const Ambient_Lighting_Function_Present = 1;
	const Ambient_Lighting_Function_Absent = 0;
	const Anti_Fog_Sensor_Humidity_Present = 1;
	const Anti_Fog_Sensor_Humidity_Absent = 0;
	const Audio_Repetition_Present = 1;
	const Audio_Repetition_Absent = 0;
	const Auto_Close_Menu_Present = 1;
	const Auto_Close_Menu_Absent = 0;
	const Auto_Door_Unlock_Menu_Present = 1;
	const Auto_Door_Unlock_Menu_Absent = 0;
	const Auto_Park_Brake_Menu_Present = 1;
	const Auto_Park_Brake_Menu_Absent = 0;
	const Automatic_Reset_TripB_Menu_Present = 1;
	const Automatic_Reset_TripB_Menu_Absent = 0;
	const Bonnet_Switch_Present = 1;
	const Bonnet_Switch_Absent = 0;
	const Cornering_Light_Present = 1;
	const Cornering_Light_Absent = 0;
	const Com_Module_Present = 1;
	const Com_Module_Absent = 0;
	const Clutch_Interlock_Message_Present = 1;
	const Clutch_Interlock_Message_Absent = 0;
	const Cruise_Control_Present = 1;
	const Cruise_Control_Absent = 0;
	const DPF_Presence_Present = 1;
	const DPF_Presence_Absent = 0;
	const Driver_Side_Left = 0;
	const Driver_Side_Right = 1;
	const DMS_Redirect_Menu_Present = 1;
	const DMS_Redirect_Menu_Absent = 0;
	const DST_Presence_Present = 1;
	const DST_Presence_Absent = 0;
	const DRL_Menu_Enable_Present = 1;
	const DRL_Menu_Enable_Absent = 0;
	const EPB_Maintenance_Menu_Present = 1;
	const EPB_Maintenance_Menu_Absent = 0;
	const Front_Psng_Disable_Switch_Via_Menu_Present = 1;
	const Front_Psng_Disable_Switch_Via_Menu_Absent = 0;
	const Greeting_Lights_Menu_Present = 1;
	const Greeting_Lights_Menu_Absent = 0;
	const Hill_Descendent_Control_Present = 1;
	const Hill_Descendent_Control_Absent = 0;
	const Hill_Holder_System_Present = 1;
	const Hill_Holder_System_Absent = 0;
	const Hill_Start_Menu_Presence_Present = 1;
	const Hill_Start_Menu_Presence_Absent = 0;
	const Horn_Chirp_Menu_Present = 1;
	const Horn_Chirp_Menu_Absent = 0;
	const Ignition_Pre_Start_Logic_Disabled = 0;
	const Ignition_Pre_Start_Logic_Enable = 1;
	const IPC_Internal_Light_Sensor_Present = 1;
	const IPC_Internal_Light_Sensor_Absent = 0;
	const Key_In_Warning_Present = 1;
	const Key_In_Warning_Absent = 0;
	const Key_Less_Go_Present = 1;
	const Key_Less_Go_Absent = 0;
	const Left_Seat_Bag_Present = 1;
	const Left_Seat_Bag_Absent = 0;
	const NAV_Presence_Present = 1;
	const NAV_Presence_Absent = 0;
	const Nav_Repetition_Present = 1;
	const Nav_Repetition_Absent = 0;
	const Nav_Repetition_Menu_Present = 1;
	const Nav_Repetition_Menu_Absent = 0;
	const Over_Speed_Warning_Present = 1;
	const Over_Speed_Warning_Absent = 0;
	const Odo_Units_Change_Present = 1;
	const Odo_Units_Change_Absent = 0;
	const Phone_Repetition_Menu_Present = 1;
	const Phone_Repetition_Menu_Absent = 0;
	const PAM_Configuration_Rear = 0;
	const PAM_Configuration_Front_Rear = 1;
	const Passengers_Knee_Bag_Present = 1;
	const Passengers_Knee_Bag_Absent = 0;
	const Passive_Entry_Menu_Present = 1;
	const Passive_Entry_Menu_Absent = 0;	
	const Rain_Sensor_Present = 1;
	const Rain_Sensor_Absent = 0;
	const Remote_Door_Unlock_Menu_Present = 1;
	const Remote_Door_Unlock_Menu_Absent = 0;
	const Remote_start_Present = 1;
	const Remote_start_Absent = 0;
	const Right_Seat_Bag_Present = 1;
	const Right_Seat_Bag_Absent = 0;
	const SBR_Logic_NHSTA = 0;
	const SBR_Logic_Europe_others = 1;
	const Semi_Automatic_Parking_System_Present = 1;
	const Semi_Automatic_Parking_System_Absent = 0;
	const Side_Distance_Warning_Present = 1;
	const Side_Distance_Warning_Absent = 0;
	const Sound_Horn_Remote_Start_Menu_Present = 1;
	const Sound_Horn_Remote_Start_Menu_Absent = 0;
	const Speed_Limiter_Present = 1;
	const Speed_Limiter_Absent = 0;
	const Stop_And_Start_Present = 1;
	const Stop_And_Start_Absent = 0;
	const TPMS_Variant_Base = 0;
	const TPMS_Variant_Premium = 1;
	const Tip_Start_Present = 1;
	const Tip_Start_Absent = 0;
	const Trunk_Door_Present = 1;
	const Trunk_Door_Absent = 0;
	const Tyre_Pressure_System_Present = 1;
	const Tyre_Pressure_System_Absent = 0;
	const Type_Pressure_Unit_Menu_Present = 1;
	const Type_Pressure_Unit_Menu_Absent = 0;
	const Twilight_Sensor_Present = 1;
	const Twilight_Sensor_Absent = 0;
	const Ultrasonic_Sensor_Present = 1;
	const Ultrasonic_Sensor_Absent = 0;
	const Welcome_Movement_Present = 1;
	const Welcome_Movement_Absent = 0;  
	const External_Temperature_Sensor_Menu_Present = 1;
	const External_Temperature_Sensor_Menu_Absent = 0;
	const Flash_Light_With_Lock_Menu_Present = 1;
	const Flash_Light_With_Lock_Menu_Absent = 0;
	const Adaptive_Cruise_Control_Absent = 0;
	const Adaptive_Cruise_Control_ACC = 1;
	const Adaptive_Cruise_Control_ACC_Plus = 2;
	const Additional_Languages_Default = 0;
	const Additional_Languages_Default_Russian = 1;
	const Additional_Languages_Default_Brazilian = 2;
	const Additional_Languages_Default_Russian_Brazilian = 3;
	const Cluster_Display_Type_No_Display_Available = 0;
	const Cluster_Display_Type_Base_Display = 1;
	const Cluster_Display_Type_Medium_Display = 2;
	const Cluster_Display_Type_High_Display = 3;
	const Cluster_Display_Type_TFT_BW_Display = 4;
	const Cluster_Display_Type_TFT_Color_display = 5;
	const Compass_Display_Absent = 0;
	const Compass_Display_Present_on_VP = 1;
	const Compass_Display_Present_on_IPC = 2;
	const Compass_Display_Present_on_IPC_and_VP = 3;
	const Present_on_IPC_and_VP = 3;
	const Country_Code_World = 0;
	const Country_Code_United_States_of_America = 2;
	const Country_Code_Canada = 4;
	const Country_Code_United_Kingdom = 5;
	const Country_Code_Japan = 6;
	const Country_Code_Mexico = 14;
	const Country_Code_Brazil = 15;
	const Country_Code_Chile = 45;
	const Country_Code_Colombia = 47;
	const Country_Code_France = 71;
	const Country_Code_India = 94;
	const Country_Code_Italy = 100;
	const Country_Code_Peru = 154;
	const Country_Code_South_Africa = 175;
	const Country_Code_Turkey = 198;
	const Country_Code_Argentina = 211;
	const Country_Code_Paraguay = 153;
	const Country_Code_China_Mainland = 16;
	const Country_Code_Belgium = 21;
	const Country_Code_Netherlands = 140;
	const Country_Code_Uruguai = 207;
	const Dimming_Level_Selector_Type_Absent = 0;
	const Dimming_Level_Selector_Type_Eight_Levels = 1;
	const Dimming_Level_Selector_Type_Nine_Levels = 2; 
	const Drive_Style_Selector_Absent = 0;
	const Drive_Style_Selector_Drive_Selector = 1;
	const Drive_Style_Selector_Terrain_Selector = 2;
	const Drive_Type_Variant_FWD = 0;
	const Drive_Type_Variant_RWD = 1;
	const Drive_Type_Variant_Single_Speed_AWD = 2;
	const Drive_Type_Variant_2_Speed_4WD = 3;
	const Drive_Type_Variant_2_Speed_4WD_with_Elocker = 4;
	const Electronic_Brake_System_Absent = 0;
	const Electronic_Brake_System_ABS = 1;
	const Electronic_Brake_System_Not_Used = 2;
	const Electronic_Brake_System_Single_Speed_Not_Used = 2;
	const Electronic_Brake_System_VDC_Hill_Holder_ASR = 3;
	const Engine_Type_Invalid = 0;
	const Engine_Type_2_4L_Tiger_Shark_185hp = 7;
	const Engine_Type_2_0L_Mjet_170hp = 8;
	const Engine_Type_1_8_ETorq_140hp = 10;
	const Engine_Type_2_0L_Tiger_Shark_170hp = 12;
	const Engine_Type_1_3_GSE_180hp = 13;
	const Engine_Type_1_3_FLEX = 14;
	const Engine_Type_1_3_bz = 15;
	const Forward_Collision_Mitigation_Absent = 0;
	const Full_Speed_FCW_with_Cyclist_and_PEB = 1;
	const Full_Speed_FCW_with_Pedestrian_Emergency_Braking = 2;
	const Forward_Collision_Mitigation_Full_Speed_FCW_with_Mitigation = 3;
	const Front_Passenger_Bag_Absent = 0;
	const Front_Passenger_Bag_Present_Monostage = 1;
	const Front_Passenger_Bag_Present_Dual_Stage = 2;
	const Front_Passenger_Bag_Present_Tri_Stage = 3;
	const Fuel_Type_Invalid = 0;
	const Fuel_Type_Gasoline = 1;
	const Fuel_Type_Diesel = 2;
	const Fuel_Type_CNG = 3;
	const Fuel_Type_GPL = 4;
	const Fuel_Type_Electric = 5;
	const Fuel_Type_Hybrid = 6;
	const Fuel_Type_Flex = 7;
	const Gear_Box_Type_Not_Valid = 0;
	const Gear_Box_Type_MTX = 1;
	const Gear_Box_Type_MTA = 2;
  const Gear_Box_Type_DDCT = 3;
	const Gear_Box_Type_ATX = 4;
  const Gear_Box_Type_Not_Used = 5;
	const Gear_Box_Type_Variant_Invalid = 0;
	const Gear_Box_Type_Variant_C510_MTX = 1;
	const Gear_Box_Type_Variant_C635_MTX = 2;
	const Gear_Box_Type_Variant_C635_DCT = 3;
	const Gear_Box_Type_Variant_948_TE_AT9 = 4;
	const Gear_Box_Type_Variant_F21_250_Gen_III_AT6 = 5;
	const GSI_Type_Not_Present = 1;
	const GSI_Type_GSI = 1;
	const GSI_Type_GSI_II = 2;
	const GSI_Type_Enhanced_GSI = 3;
	const Half_HMI_Setting_Level_1_absent = 0;
	const Half_HMI_Setting_Level_2_full = 1;
	const Half_HMI_Setting_Level_3_base = 2;
	const Half_HMI_Setting_Level_4_other = 3;
	const Half_Torque_Sensibility_Level_1_absent = 0;
	const Half_Torque_Sensibility_Level_2_full = 1;
	const Half_Torque_Sensibility_Level_3_base = 2;
	const Half_Torque_Sensibility_Level_4_other = 3;
	const Heated_Cold_Start_System_Absent = 0;
	const Heated_Cold_Start_System_Glow_Plug = 1;
	const Heated_Cold_Start_System_HCSS = 2;
	const Heated_Cold_Start_System_Auxiliary_Fuel_Tank = 3;
	const Mirrors_System_Absent = 0;
	const Mirrors_System_Standard = 1;
	const Mirrors_System_Passenger_Tilt = 2;
	const Mirrors_System_Memory = 3;
	const Number_Of_Doors_No_doors_Special_Version = 0;
	const Number_Of_Doors_2_Doors = 1;
	const Number_Of_Doors_3_Doors = 2;
	const Number_Of_Doors_4_Doors = 3;
	const RRM_VP_LEVEL_Absent_RRU = 0;
	const RRM_VP_LEVEL_Level_1_VP1_B7 = 1;
	const RRM_VP_LEVEL_Level_2_VP2 = 2;
	const RRM_VP_LEVEL_Level_3_VP3 = 3;
	const RRM_VP_LEVEL_Level_4_VP4 = 3;
	const RRM_VP_LEVEL_Radio_High_Level = 3;
	const RRM_VPx_Steering_Wheel_Absent = 0;
	const RRM_VPx_Steering_Wheel_08_LIN_Front_Button = 3;
	const RRM_VPx_Steering_Wheel_14_LIN_button_EMEA = 4;
	const RRM_VPx_Steering_Wheel_14_LIN_button_NAFTA = 5;
	const Siren_Absent = 0;
	const Siren_Horn = 1;
	const Siren_Siren = 2;
	const Siren_Not_Used = 3;
	const Special_Package_VP_None = 0;
	const Special_Package_VP_Theme_1 = 1;
	const Special_Package_VP_Theme_2 = 2;
	const Steering_Ratio_Rack_Pinion_Type_15_7 = 0;
	const Stop_And_Start_Type_FGA_Type = 0;
	const Stop_And_Start_Type_CG_Type = 1;
  
  // CAN Configuration
	const CAN_node0_BCM_Present = 1;
	const CAN_node0_BCM_Absent = 0;
	const CAN_node1_ECM_Present = 1;
	const CAN_node1_ECM_Absent = 0;
	const CAN_node2_EPS_Present = 1;
	const CAN_node2_EPS_Absent = 0;
	const CAN_node3_IPC_Present = 1;
	const CAN_node3_IPC_Absent = 0;
	const CAN_node5_RRM_Present = 1;
	const CAN_node5_RRM_Absent = 0;
	const CAN_node6_BSM_Present = 1;
	const CAN_node6_BSM_Absent = 0;
	const CAN_node8_DDM_DMM_FDM_UDM_Present = 1;
	const CAN_node8_DDM_DMM_FDM_UDM_Absent = 0;
	const CAN_node10_ECC_ACM_MCM_MHM_Present = 1;
	const CAN_node10_ECC_ACM_MCM_MHM_Absent = 0;
	const CAN_node11_MTA_TCM_DCTM_Present = 1;
	const CAN_node11_MTA_TCM_DCTM_Absent = 0;
	const CAN_node22_GSM_STM_AGSM_DCSM_Present = 1;
	const CAN_node22_GSM_STM_AGSM_DCSM_Absent = 0;
	const CAN_node24_PAM_Present = 1;
	const CAN_node24_PAM_Absent = 0;
	const CAN_node26_SDM_ORC_Present = 1;
	const CAN_node26_SDM_ORC_Absent = 0;
	const CAN_node30_HALF_Present = 1;
	const CAN_node30_HALF_Absent = 0;
	const CAN_node35_TBM_Present = 1;
	const CAN_node35_TBM_Absent = 0;
	const CAN_node36_LTM_ETM_HTM_Present = 1;
	const CAN_node36_LTM_ETM_HTM_Absent = 0;
	const CAN_node46_AMP_Present = 1;
	const CAN_node46_AMP_Absent = 0;
	const CAN_node47_CDM_Present = 1;
	const CAN_node47_CDM_Absent = 0;
	const CAN_node49_VTM_Present = 1;
	const CAN_node49_VTM_Absent = 0;
	const CAN_node50_ICS_HCPM_Present = 1;
	const CAN_node50_ICS_HCPM_Absent = 0;
	const CAN_node51_LBSS_Present = 1;
	const CAN_node51_LBSS_Absent = 0;
	const CAN_node52_RBSS_Present = 1;
	const CAN_node52_RBSS_Absent = 0;
	const CAN_node57_DASM_Present = 1;
	const CAN_node57_DASM_Absent = 0;
	const CAN_node63_TTM_Present = 1;
	const CAN_node63_TTM_Absent = 0;
	const CAN_node65_RFHM_Present = 1;
	const CAN_node65_RFHM_Absent = 0;
	const CAN_node67_DTCM_Present = 1;
	const CAN_node67_DTCM_Absent = 0;  
 
    // EOL Configuration
  	const CAN_node_eol0_BCM_Present = 1;
	const CAN_node_eol0_BCM_Absent = 0;
	const CAN_node_eol1_ECM_Present = 1;
	const CAN_node_eol1_ECM_Absent = 0;
	const CAN_node_eol2_EPS_Present = 1;
	const CAN_node_eol2_EPS_Absent = 0;
	const CAN_node_eol3_IPC_Present = 1;
	const CAN_node_eol3_IPC_Absent = 0;
	const CAN_node_eol6_BSM_Present = 1;
	const CAN_node_eol6_BSM_Absent = 0;
	const CAN_node_eol8_DDM_DMM_FDM_UDM_Present = 1;
	const CAN_node_eol8_DDM_DMM_FDM_UDM_Absent = 0;
	const CAN_node_eol10_ECC_ACM_MCM_MHM_Present = 1;
	const CAN_node_eol10_ECC_ACM_MCM_MHM_Absent = 0;
	const CAN_node_eol11_MTA_TCM_DCTM_Present = 1;
	const CAN_node_eol11_MTA_TCM_DCTM_Absent = 0;
	const CAN_node_eol22_GSM_STM_AGSM_DCSM_Present = 1;
	const CAN_node_eol22_GSM_STM_AGSM_DCSM_Absent = 0;
	const CAN_node_eol24_PAM_Present = 1;
	const CAN_node_eol24_PAM_Absent = 0;
	const CAN_node_eol26_SDM_ORC_Present = 1;
	const CAN_node_eol26_SDM_ORC_Absent = 0;
	const CAN_node_eol30_HALF_Present = 1;
	const CAN_node_eol30_HALF_Absent = 0;
	const CAN_node_eol35_TBM_Present = 1;
	const CAN_node_eol35_TBM_Absent = 0;
	const CAN_node_eol36_LTM_ETM_HTM_Present = 1;
	const CAN_node_eol36_LTM_ETM_HTM_Absent = 0;
	const CAN_node_eol46_AMP_Present = 1;
	const CAN_node_eol46_AMP_Absent = 0;
	const CAN_node_eol51_LBSS_Present = 1;
	const CAN_node_eol51_LBSS_Absent = 0;
	const CAN_node_eol52_RBSS_Present = 1;
	const CAN_node_eol52_RBSS_Absent = 0;
	const CAN_node_eol57_DASM_Present = 1;
	const CAN_node_eol57_DASM_Absent = 0;
	const CAN_node_eol63_TTM_Present = 1;
	const CAN_node_eol63_TTM_Absent = 0;
	const CAN_node_eol65_RFHM_Present = 1;
	const CAN_node_eol65_RFHM_Absent = 0;
  
     
}

//******************************************PROXI parameters*********************************************

export testfunction AHBM_Present ()
{
  testModuleTitle("AHBM_Present");
  //write("AHBM_Present");
  
    sysSetVariableInt(sysvar::SysVar_PROXI::DIAG_ProxiLesen,1);
    testWaitForTimeout (200);
    sysSetVariableInt(sysvar::SysVar_PROXI::DIAG_ProxiLesen,0);
    testWaitForTimeout (200);
    sysSetVariableInt(sysvar::SysVar_PROXI::pByte68Bit5,AHBM_Present);		
    sysSetVariableInt(sysvar::SysVar_PROXI::DIAG_eLoadAll,1);
    testWaitForTimeout (200);
    sysSetVariableInt(sysvar::SysVar_PROXI::DIAG_eLoadAll,0);
testWaitForTimeout (2000);
    sysSetVariableInt(sysvar::SysVar_PROXI::DIAG_eSendProxi,1);
    testWaitForTimeout (200);
    sysSetVariableInt(sysvar::SysVar_PROXI::DIAG_eSendProxi,0);
    testWaitForTimeout (200);
				
}

export testfunction AHBM_Absent ()
{
  testModuleTitle("AHBM_Absent");
  //write("AHBM_Absent");
  
    sysSetVariableInt(sysvar::SysVar_PROXI::DIAG_ProxiLesen,1);
    testWaitForTimeout (200);
    sysSetVariableInt(sysvar::SysVar_PROXI::DIAG_ProxiLesen,0);
    testWaitForTimeout (200);
    sysSetVariableInt(sysvar::SysVar_PROXI::pByte68Bit5,AHBM_Absent);		
    sysSetVariableInt(sysvar::SysVar_PROXI::DIAG_eLoadAll,1);
    testWaitForTimeout (200);
    sysSetVariableInt(sysvar::SysVar_PROXI::DIAG_eLoadAll,0);
testWaitForTimeout (2000);
    sysSetVariableInt(sysvar::SysVar_PROXI::DIAG_eSendProxi,1);
    testWaitForTimeout (200);
    sysSetVariableInt(sysvar::SysVar_PROXI::DIAG_eSendProxi,0);
    testWaitForTimeout (200);
				
}

	export testfunction AHBM_Feature_Menu_Present ()
{
  testModuleTitle("AHBM_Feature_Menu_Present");
  //write("AHBM_Feature_Menu_Present");
  
    sysSetVariableInt(sysvar::SysVar_PROXI::DIAG_ProxiLesen,1);
    testWaitForTimeout (200);
    sysSetVariableInt(sysvar::SysVar_PROXI::DIAG_ProxiLesen,0);
    testWaitForTimeout (200);
    sysSetVariableInt(sysvar::SysVar_PROXI::pByte133Bit4,AHBM_Feature_Menu_Present);		
    sysSetVariableInt(sysvar::SysVar_PROXI::DIAG_eLoadAll,1);
    testWaitForTimeout (200);
    sysSetVariableInt(sysvar::SysVar_PROXI::DIAG_eLoadAll,0);
testWaitForTimeout (2000);
    sysSetVariableInt(sysvar::SysVar_PROXI::DIAG_eSendProxi,1);
    testWaitForTimeout (200);
    sysSetVariableInt(sysvar::SysVar_PROXI::DIAG_eSendProxi,0);
    testWaitForTimeout (200);
				
}

export testfunction AHBM_Feature_Menu_Absent ()
{
  testModuleTitle("AHBM_Feature_Menu_Absent");
  //write("AHBM_Feature_Menu_Absent");
  
    sysSetVariableInt(sysvar::SysVar_PROXI::DIAG_ProxiLesen,1);
    testWaitForTimeout (200);
    sysSetVariableInt(sysvar::SysVar_PROXI::DIAG_ProxiLesen,0);
    testWaitForTimeout (200);
    sysSetVariableInt(sysvar::SysVar_PROXI::pByte133Bit4,AHBM_Feature_Menu_Absent);		
    sysSetVariableInt(sysvar::SysVar_PROXI::DIAG_eLoadAll,1);
    testWaitForTimeout (200);
    sysSetVariableInt(sysvar::SysVar_PROXI::DIAG_eLoadAll,0);
testWaitForTimeout (2000);
    sysSetVariableInt(sysvar::SysVar_PROXI::DIAG_eSendProxi,1);
    testWaitForTimeout (200);
    sysSetVariableInt(sysvar::SysVar_PROXI::DIAG_eSendProxi,0);
    testWaitForTimeout (200);
				
}

export testfunction Alarm_System_Present ()
{
  testModuleTitle("Alarm_System_Present ");
  //write("Alarm_System_Present ");
  
    sysSetVariableInt(sysvar::SysVar_PROXI::DIAG_ProxiLesen,1);
    testWaitForTimeout (200);
    sysSetVariableInt(sysvar::SysVar_PROXI::DIAG_ProxiLesen,0);
    testWaitForTimeout (200);
    sysSetVariableInt(sysvar::SysVar_PROXI::pByte70Bit0,Alarm_System_Present);		
    sysSetVariableInt(sysvar::SysVar_PROXI::DIAG_eLoadAll,1);
    testWaitForTimeout (200);
    sysSetVariableInt(sysvar::SysVar_PROXI::DIAG_eLoadAll,0);
testWaitForTimeout (2000);
    sysSetVariableInt(sysvar::SysVar_PROXI::DIAG_eSendProxi,1);
    testWaitForTimeout (200);
    sysSetVariableInt(sysvar::SysVar_PROXI::DIAG_eSendProxi,0);
    testWaitForTimeout (200);
				
}

export testfunction Alarm_System_Absent ()
{
  testModuleTitle("Alarm_System_Absent ");
  //write("Alarm_System_Absent ");
  
    sysSetVariableInt(sysvar::SysVar_PROXI::DIAG_ProxiLesen,1);
    testWaitForTimeout (200);
    sysSetVariableInt(sysvar::SysVar_PROXI::DIAG_ProxiLesen,0);
    testWaitForTimeout (200);
    sysSetVariableInt(sysvar::SysVar_PROXI::pByte70Bit0,Alarm_System_Absent);		
    sysSetVariableInt(sysvar::SysVar_PROXI::DIAG_eLoadAll,1);
    testWaitForTimeout (200);
    sysSetVariableInt(sysvar::SysVar_PROXI::DIAG_eLoadAll,0);
testWaitForTimeout (2000);
    sysSetVariableInt(sysvar::SysVar_PROXI::DIAG_eSendProxi,1);
    testWaitForTimeout (200);
    sysSetVariableInt(sysvar::SysVar_PROXI::DIAG_eSendProxi,0);
    testWaitForTimeout (200);
				
}

	

	export testfunction Ambient_Dimmer_Switch_Present ()
{
  testModuleTitle("Ambient_Dimmer_Switch_Present");
  //write("Ambient_Dimmer_Switch_Present");
  
    sysSetVariableInt(sysvar::SysVar_PROXI::DIAG_ProxiLesen,1);
    testWaitForTimeout (200);
    sysSetVariableInt(sysvar::SysVar_PROXI::DIAG_ProxiLesen,0);
    testWaitForTimeout (200);
    sysSetVariableInt(sysvar::SysVar_PROXI::pByte122Bit7,Ambient_Dimmer_Switch_Present);		
    sysSetVariableInt(sysvar::SysVar_PROXI::DIAG_eLoadAll,1);
    testWaitForTimeout (200);
    sysSetVariableInt(sysvar::SysVar_PROXI::DIAG_eLoadAll,0);
testWaitForTimeout (2000);
    sysSetVariableInt(sysvar::SysVar_PROXI::DIAG_eSendProxi,1);
    testWaitForTimeout (200);
    sysSetVariableInt(sysvar::SysVar_PROXI::DIAG_eSendProxi,0);
    testWaitForTimeout (200);
				
}

export testfunction Ambient_Dimmer_Switch_Absent ()
{
  testModuleTitle("Ambient_Dimmer_Switch_Absent");
  //write("Ambient_Dimmer_Switch_Absent");
  
    sysSetVariableInt(sysvar::SysVar_PROXI::DIAG_ProxiLesen,1);
    testWaitForTimeout (200);
    sysSetVariableInt(sysvar::SysVar_PROXI::DIAG_ProxiLesen,0);
    testWaitForTimeout (200);
    sysSetVariableInt(sysvar::SysVar_PROXI::pByte122Bit7,Ambient_Dimmer_Switch_Absent);		
    sysSetVariableInt(sysvar::SysVar_PROXI::DIAG_eLoadAll,1);
    testWaitForTimeout (200);
    sysSetVariableInt(sysvar::SysVar_PROXI::DIAG_eLoadAll,0);
testWaitForTimeout (2000);
    sysSetVariableInt(sysvar::SysVar_PROXI::DIAG_eSendProxi,1);
    testWaitForTimeout (200);
    sysSetVariableInt(sysvar::SysVar_PROXI::DIAG_eSendProxi,0);
    testWaitForTimeout (200);
				
}

	export testfunction Ambient_Lighting_Function_Present ()
{
  testModuleTitle("Ambient_Lighting_Function_Present");
  //write("Ambient_Lighting_Function_Present");
  
    sysSetVariableInt(sysvar::SysVar_PROXI::DIAG_ProxiLesen,1);
    testWaitForTimeout (200);
    sysSetVariableInt(sysvar::SysVar_PROXI::DIAG_ProxiLesen,0);
    testWaitForTimeout (200);
    sysSetVariableInt(sysvar::SysVar_PROXI::pByte134Bit7,Ambient_Lighting_Function_Present);		
    sysSetVariableInt(sysvar::SysVar_PROXI::DIAG_eLoadAll,1);
    testWaitForTimeout (200);
    sysSetVariableInt(sysvar::SysVar_PROXI::DIAG_eLoadAll,0);
testWaitForTimeout (2000);
    sysSetVariableInt(sysvar::SysVar_PROXI::DIAG_eSendProxi,1);
    testWaitForTimeout (200);
    sysSetVariableInt(sysvar::SysVar_PROXI::DIAG_eSendProxi,0);
    testWaitForTimeout (200);
				
}

export testfunction Ambient_Lighting_Function_Absent ()
{
  testModuleTitle("Ambient_Lighting_Function_Absent");
  //write("Ambient_Lighting_Function_Absent");
  
    sysSetVariableInt(sysvar::SysVar_PROXI::DIAG_ProxiLesen,1);
    testWaitForTimeout (200);
    sysSetVariableInt(sysvar::SysVar_PROXI::DIAG_ProxiLesen,0);
    testWaitForTimeout (200);
    sysSetVariableInt(sysvar::SysVar_PROXI::pByte134Bit7,Ambient_Lighting_Function_Absent);		
    sysSetVariableInt(sysvar::SysVar_PROXI::DIAG_eLoadAll,1);
    testWaitForTimeout (200);
    sysSetVariableInt(sysvar::SysVar_PROXI::DIAG_eLoadAll,0);
testWaitForTimeout (2000);
    sysSetVariableInt(sysvar::SysVar_PROXI::DIAG_eSendProxi,1);
    testWaitForTimeout (200);
    sysSetVariableInt(sysvar::SysVar_PROXI::DIAG_eSendProxi,0);
    testWaitForTimeout (200);
				
}

	export testfunction Anti_Fog_Sensor_Humidity_Present ()
{
  testModuleTitle("Anti_Fog_Sensor_Humidity_Present");
  //write("Anti_Fog_Sensor_Humidity_Present");
  
    sysSetVariableInt(sysvar::SysVar_PROXI::DIAG_ProxiLesen,1);
    testWaitForTimeout (200);
    sysSetVariableInt(sysvar::SysVar_PROXI::DIAG_ProxiLesen,0);
    testWaitForTimeout (200);
    sysSetVariableInt(sysvar::SysVar_PROXI::pByte77Bit6,Anti_Fog_Sensor_Humidity_Present);		
    sysSetVariableInt(sysvar::SysVar_PROXI::DIAG_eLoadAll,1);
    testWaitForTimeout (200);
    sysSetVariableInt(sysvar::SysVar_PROXI::DIAG_eLoadAll,0);
testWaitForTimeout (2000);
    sysSetVariableInt(sysvar::SysVar_PROXI::DIAG_eSendProxi,1);
    testWaitForTimeout (200);
    sysSetVariableInt(sysvar::SysVar_PROXI::DIAG_eSendProxi,0);
    testWaitForTimeout (200);
				
}

export testfunction Anti_Fog_Sensor_Humidity_Absent ()
{
  testModuleTitle("Anti_Fog_Sensor_Humidity_Absent");
  //write("Anti_Fog_Sensor_Humidity_Absent");
  
    sysSetVariableInt(sysvar::SysVar_PROXI::DIAG_ProxiLesen,1);
    testWaitForTimeout (200);
    sysSetVariableInt(sysvar::SysVar_PROXI::DIAG_ProxiLesen,0);
    testWaitForTimeout (200);
    sysSetVariableInt(sysvar::SysVar_PROXI::pByte77Bit6,Anti_Fog_Sensor_Humidity_Absent);		
    sysSetVariableInt(sysvar::SysVar_PROXI::DIAG_eLoadAll,1);
    testWaitForTimeout (200);
    sysSetVariableInt(sysvar::SysVar_PROXI::DIAG_eLoadAll,0);
testWaitForTimeout (2000);
    sysSetVariableInt(sysvar::SysVar_PROXI::DIAG_eSendProxi,1);
    testWaitForTimeout (200);
    sysSetVariableInt(sysvar::SysVar_PROXI::DIAG_eSendProxi,0);
    testWaitForTimeout (200);
				
}

	export testfunction Audio_Repetition_Present ()
{
  testModuleTitle("Audio_Repetition_Present");
  //write("Audio_Repetition_Present");
  
    sysSetVariableInt(sysvar::SysVar_PROXI::DIAG_ProxiLesen,1);
    testWaitForTimeout (200);
    sysSetVariableInt(sysvar::SysVar_PROXI::DIAG_ProxiLesen,0);
    testWaitForTimeout (200);
    sysSetVariableInt(sysvar::SysVar_PROXI::pByte121Bit7,Audio_Repetition_Present);		
    sysSetVariableInt(sysvar::SysVar_PROXI::DIAG_eLoadAll,1);
    testWaitForTimeout (200);
    sysSetVariableInt(sysvar::SysVar_PROXI::DIAG_eLoadAll,0);
testWaitForTimeout (2000);
    sysSetVariableInt(sysvar::SysVar_PROXI::DIAG_eSendProxi,1);
    testWaitForTimeout (200);
    sysSetVariableInt(sysvar::SysVar_PROXI::DIAG_eSendProxi,0);
    testWaitForTimeout (200);
				
}

export testfunction Audio_Repetition_Absent ()
{
  testModuleTitle("Audio_Repetition_Absent");
  //write("Audio_Repetition_Absent");
  
    sysSetVariableInt(sysvar::SysVar_PROXI::DIAG_ProxiLesen,1);
    testWaitForTimeout (200);
    sysSetVariableInt(sysvar::SysVar_PROXI::DIAG_ProxiLesen,0);
    testWaitForTimeout (200);
    sysSetVariableInt(sysvar::SysVar_PROXI::pByte121Bit7,Audio_Repetition_Absent);		
    sysSetVariableInt(sysvar::SysVar_PROXI::DIAG_eLoadAll,1);
    testWaitForTimeout (200);
    sysSetVariableInt(sysvar::SysVar_PROXI::DIAG_eLoadAll,0);
testWaitForTimeout (2000);
    sysSetVariableInt(sysvar::SysVar_PROXI::DIAG_eSendProxi,1);
    testWaitForTimeout (200);
    sysSetVariableInt(sysvar::SysVar_PROXI::DIAG_eSendProxi,0);
    testWaitForTimeout (200);
				
}

	export testfunction Auto_Close_Menu_Present ()
{
  testModuleTitle("Auto_Close_Menu_Present");
  //write("Auto_Close_Menu_Present");
  
    sysSetVariableInt(sysvar::SysVar_PROXI::DIAG_ProxiLesen,1);
    testWaitForTimeout (200);
    sysSetVariableInt(sysvar::SysVar_PROXI::DIAG_ProxiLesen,0);
    testWaitForTimeout (200);
    sysSetVariableInt(sysvar::SysVar_PROXI::pByte109Bit5,Auto_Close_Menu_Present);		
    sysSetVariableInt(sysvar::SysVar_PROXI::DIAG_eLoadAll,1);
    testWaitForTimeout (200);
    sysSetVariableInt(sysvar::SysVar_PROXI::DIAG_eLoadAll,0);
testWaitForTimeout (2000);
    sysSetVariableInt(sysvar::SysVar_PROXI::DIAG_eSendProxi,1);
    testWaitForTimeout (200);
    sysSetVariableInt(sysvar::SysVar_PROXI::DIAG_eSendProxi,0);
    testWaitForTimeout (200);
				
}

export testfunction Auto_Close_Menu_Absent ()
{
  testModuleTitle("Auto_Close_Menu_Absent");
  //write("Auto_Close_Menu_Absent");
  
    sysSetVariableInt(sysvar::SysVar_PROXI::DIAG_ProxiLesen,1);
    testWaitForTimeout (200);
    sysSetVariableInt(sysvar::SysVar_PROXI::DIAG_ProxiLesen,0);
    testWaitForTimeout (200);
    sysSetVariableInt(sysvar::SysVar_PROXI::pByte109Bit5,Auto_Close_Menu_Absent);		
    sysSetVariableInt(sysvar::SysVar_PROXI::DIAG_eLoadAll,1);
    testWaitForTimeout (200);
    sysSetVariableInt(sysvar::SysVar_PROXI::DIAG_eLoadAll,0);
testWaitForTimeout (2000);
    sysSetVariableInt(sysvar::SysVar_PROXI::DIAG_eSendProxi,1);
    testWaitForTimeout (200);
    sysSetVariableInt(sysvar::SysVar_PROXI::DIAG_eSendProxi,0);
    testWaitForTimeout (200);
				
}

	export testfunction Auto_Door_Unlock_Menu_Present ()
{
  testModuleTitle("Auto_Door_Unlock_Menu_Present");
  //write("Auto_Door_Unlock_Menu_Present");
  
    sysSetVariableInt(sysvar::SysVar_PROXI::DIAG_ProxiLesen,1);
    testWaitForTimeout (200);
    sysSetVariableInt(sysvar::SysVar_PROXI::DIAG_ProxiLesen,0);
    testWaitForTimeout (200);
    sysSetVariableInt(sysvar::SysVar_PROXI::pByte133Bit3,Auto_Door_Unlock_Menu_Present);		
    sysSetVariableInt(sysvar::SysVar_PROXI::DIAG_eLoadAll,1);
    testWaitForTimeout (200);
    sysSetVariableInt(sysvar::SysVar_PROXI::DIAG_eLoadAll,0);
testWaitForTimeout (2000);
    sysSetVariableInt(sysvar::SysVar_PROXI::DIAG_eSendProxi,1);
    testWaitForTimeout (200);
    sysSetVariableInt(sysvar::SysVar_PROXI::DIAG_eSendProxi,0);
    testWaitForTimeout (200);
				
}

export testfunction Auto_Door_Unlock_Menu_Absent ()
{
  testModuleTitle("Auto_Door_Unlock_Menu_Absent");
  //write("Auto_Door_Unlock_Menu_Absent");
  
    sysSetVariableInt(sysvar::SysVar_PROXI::DIAG_ProxiLesen,1);
    testWaitForTimeout (200);
    sysSetVariableInt(sysvar::SysVar_PROXI::DIAG_ProxiLesen,0);
    testWaitForTimeout (200);
    sysSetVariableInt(sysvar::SysVar_PROXI::pByte133Bit3,Auto_Door_Unlock_Menu_Absent);		
    sysSetVariableInt(sysvar::SysVar_PROXI::DIAG_eLoadAll,1);
    testWaitForTimeout (200);
    sysSetVariableInt(sysvar::SysVar_PROXI::DIAG_eLoadAll,0);
testWaitForTimeout (2000);
    sysSetVariableInt(sysvar::SysVar_PROXI::DIAG_eSendProxi,1);
    testWaitForTimeout (200);
    sysSetVariableInt(sysvar::SysVar_PROXI::DIAG_eSendProxi,0);
    testWaitForTimeout (200);
				
}

	export testfunction Auto_Park_Brake_Menu_Present ()
{
  testModuleTitle("Auto_Park_Brake_Menu_Present");
  //write("Auto_Park_Brake_Menu_Present");
  
    sysSetVariableInt(sysvar::SysVar_PROXI::DIAG_ProxiLesen,1);
    testWaitForTimeout (200);
    sysSetVariableInt(sysvar::SysVar_PROXI::DIAG_ProxiLesen,0);
    testWaitForTimeout (200);
    sysSetVariableInt(sysvar::SysVar_PROXI::pByte132Bit3,Auto_Park_Brake_Menu_Present);		
    sysSetVariableInt(sysvar::SysVar_PROXI::DIAG_eLoadAll,1);
    testWaitForTimeout (200);
    sysSetVariableInt(sysvar::SysVar_PROXI::DIAG_eLoadAll,0);
testWaitForTimeout (2000);
    sysSetVariableInt(sysvar::SysVar_PROXI::DIAG_eSendProxi,1);
    testWaitForTimeout (200);
    sysSetVariableInt(sysvar::SysVar_PROXI::DIAG_eSendProxi,0);
    testWaitForTimeout (200);
				
}

export testfunction Auto_Park_Brake_Menu_Absent ()
{
  testModuleTitle("Auto_Park_Brake_Menu_Absent");
  //write("Auto_Park_Brake_Menu_Absent");
  
    sysSetVariableInt(sysvar::SysVar_PROXI::DIAG_ProxiLesen,1);
    testWaitForTimeout (200);
    sysSetVariableInt(sysvar::SysVar_PROXI::DIAG_ProxiLesen,0);
    testWaitForTimeout (200);
    sysSetVariableInt(sysvar::SysVar_PROXI::pByte132Bit3,Auto_Park_Brake_Menu_Absent);		
    sysSetVariableInt(sysvar::SysVar_PROXI::DIAG_eLoadAll,1);
    testWaitForTimeout (200);
    sysSetVariableInt(sysvar::SysVar_PROXI::DIAG_eLoadAll,0);
testWaitForTimeout (2000);
    sysSetVariableInt(sysvar::SysVar_PROXI::DIAG_eSendProxi,1);
    testWaitForTimeout (200);
    sysSetVariableInt(sysvar::SysVar_PROXI::DIAG_eSendProxi,0);
    testWaitForTimeout (200);
				
}

	export testfunction Automatic_Reset_TripB_Menu_Present ()
{
  testModuleTitle("Automatic_Reset_TripB_Menu_Present");
  //write("Automatic_Reset_TripB_Menu_Present");
  
    sysSetVariableInt(sysvar::SysVar_PROXI::DIAG_ProxiLesen,1);
    testWaitForTimeout (200);
    sysSetVariableInt(sysvar::SysVar_PROXI::DIAG_ProxiLesen,0);
    testWaitForTimeout (200);
    sysSetVariableInt(sysvar::SysVar_PROXI::pByte132Bit4,Automatic_Reset_TripB_Menu_Present);		
    sysSetVariableInt(sysvar::SysVar_PROXI::DIAG_eLoadAll,1);
    testWaitForTimeout (200);
    sysSetVariableInt(sysvar::SysVar_PROXI::DIAG_eLoadAll,0);
testWaitForTimeout (2000);
    sysSetVariableInt(sysvar::SysVar_PROXI::DIAG_eSendProxi,1);
    testWaitForTimeout (200);
    sysSetVariableInt(sysvar::SysVar_PROXI::DIAG_eSendProxi,0);
    testWaitForTimeout (200);
				
}

export testfunction Automatic_Reset_TripB_Menu_Absent ()
{
  testModuleTitle("Automatic_Reset_TripB_Menu_Absent");
  //write("Automatic_Reset_TripB_Menu_Absent");
  
    sysSetVariableInt(sysvar::SysVar_PROXI::DIAG_ProxiLesen,1);
    testWaitForTimeout (200);
    sysSetVariableInt(sysvar::SysVar_PROXI::DIAG_ProxiLesen,0);
    testWaitForTimeout (200);
    sysSetVariableInt(sysvar::SysVar_PROXI::pByte132Bit4,Automatic_Reset_TripB_Menu_Absent);		
    sysSetVariableInt(sysvar::SysVar_PROXI::DIAG_eLoadAll,1);
    testWaitForTimeout (200);
    sysSetVariableInt(sysvar::SysVar_PROXI::DIAG_eLoadAll,0);
testWaitForTimeout (2000);
    sysSetVariableInt(sysvar::SysVar_PROXI::DIAG_eSendProxi,1);
    testWaitForTimeout (200);
    sysSetVariableInt(sysvar::SysVar_PROXI::DIAG_eSendProxi,0);
    testWaitForTimeout (200);
				
}

	export testfunction Bonnet_Switch_Present ()
{
  testModuleTitle("Bonnet_Switch_Present");
  //write("Bonnet_Switch_Present");
  
    sysSetVariableInt(sysvar::SysVar_PROXI::DIAG_ProxiLesen,1);
    testWaitForTimeout (200);
    sysSetVariableInt(sysvar::SysVar_PROXI::DIAG_ProxiLesen,0);
    testWaitForTimeout (200);
    sysSetVariableInt(sysvar::SysVar_PROXI::pByte60Bit5,Bonnet_Switch_Present);		
    sysSetVariableInt(sysvar::SysVar_PROXI::DIAG_eLoadAll,1);
    testWaitForTimeout (200);
    sysSetVariableInt(sysvar::SysVar_PROXI::DIAG_eLoadAll,0);
testWaitForTimeout (2000);
    sysSetVariableInt(sysvar::SysVar_PROXI::DIAG_eSendProxi,1);
    testWaitForTimeout (200);
    sysSetVariableInt(sysvar::SysVar_PROXI::DIAG_eSendProxi,0);
    testWaitForTimeout (200);
				
}

export testfunction Bonnet_Switch_Absent ()
{
  testModuleTitle("Bonnet_Switch_Absent");
  //write("Bonnet_Switch_Absent");
  
    sysSetVariableInt(sysvar::SysVar_PROXI::DIAG_ProxiLesen,1);
    testWaitForTimeout (200);
    sysSetVariableInt(sysvar::SysVar_PROXI::DIAG_ProxiLesen,0);
    testWaitForTimeout (200);
    sysSetVariableInt(sysvar::SysVar_PROXI::pByte60Bit5,Bonnet_Switch_Absent);		
    sysSetVariableInt(sysvar::SysVar_PROXI::DIAG_eLoadAll,1);
    testWaitForTimeout (200);
    sysSetVariableInt(sysvar::SysVar_PROXI::DIAG_eLoadAll,0);
testWaitForTimeout (2000);
    sysSetVariableInt(sysvar::SysVar_PROXI::DIAG_eSendProxi,1);
    testWaitForTimeout (200);
    sysSetVariableInt(sysvar::SysVar_PROXI::DIAG_eSendProxi,0);
    testWaitForTimeout (200);
				
}

	export testfunction Cornering_Light_Present ()
{
  testModuleTitle("Cornering_Light_Present");
  //write("Cornering_Light_Present");
  
    sysSetVariableInt(sysvar::SysVar_PROXI::DIAG_ProxiLesen,1);
    testWaitForTimeout (200);
    sysSetVariableInt(sysvar::SysVar_PROXI::DIAG_ProxiLesen,0);
    testWaitForTimeout (200);
    sysSetVariableInt(sysvar::SysVar_PROXI::pByte59Bit7,Cornering_Light_Present);		
    sysSetVariableInt(sysvar::SysVar_PROXI::DIAG_eLoadAll,1);
    testWaitForTimeout (200);
    sysSetVariableInt(sysvar::SysVar_PROXI::DIAG_eLoadAll,0);
testWaitForTimeout (2000);
    sysSetVariableInt(sysvar::SysVar_PROXI::DIAG_eSendProxi,1);
    testWaitForTimeout (200);
    sysSetVariableInt(sysvar::SysVar_PROXI::DIAG_eSendProxi,0);
    testWaitForTimeout (200);
				
}

export testfunction Cornering_Light_Absent ()
{
  testModuleTitle("Cornering_Light_Absent");
  //write("Cornering_Light_Absent");
  
    sysSetVariableInt(sysvar::SysVar_PROXI::DIAG_ProxiLesen,1);
    testWaitForTimeout (200);
    sysSetVariableInt(sysvar::SysVar_PROXI::DIAG_ProxiLesen,0);
    testWaitForTimeout (200);
    sysSetVariableInt(sysvar::SysVar_PROXI::pByte59Bit7,Cornering_Light_Absent);		
    sysSetVariableInt(sysvar::SysVar_PROXI::DIAG_eLoadAll,1);
    testWaitForTimeout (200);
    sysSetVariableInt(sysvar::SysVar_PROXI::DIAG_eLoadAll,0);
testWaitForTimeout (2000);
    sysSetVariableInt(sysvar::SysVar_PROXI::DIAG_eSendProxi,1);
    testWaitForTimeout (200);
    sysSetVariableInt(sysvar::SysVar_PROXI::DIAG_eSendProxi,0);
    testWaitForTimeout (200);
				
}

	export testfunction Com_Module_Present ()
{
  testModuleTitle("Com_Module_Present");
  //write("Com_Module_Present");
  
    sysSetVariableInt(sysvar::SysVar_PROXI::DIAG_ProxiLesen,1);
    testWaitForTimeout (200);
    sysSetVariableInt(sysvar::SysVar_PROXI::DIAG_ProxiLesen,0);
    testWaitForTimeout (200);
    sysSetVariableInt(sysvar::SysVar_PROXI::pByte112Bit0,Com_Module_Present);		
    sysSetVariableInt(sysvar::SysVar_PROXI::DIAG_eLoadAll,1);
    testWaitForTimeout (200);
    sysSetVariableInt(sysvar::SysVar_PROXI::DIAG_eLoadAll,0);
testWaitForTimeout (2000);
    sysSetVariableInt(sysvar::SysVar_PROXI::DIAG_eSendProxi,1);
    testWaitForTimeout (200);
    sysSetVariableInt(sysvar::SysVar_PROXI::DIAG_eSendProxi,0);
    testWaitForTimeout (200);
				
}

export testfunction Com_Module_Absent ()
{
  testModuleTitle("Com_Module_Absent");
  //write("Com_Module_Absent");
  
    sysSetVariableInt(sysvar::SysVar_PROXI::DIAG_ProxiLesen,1);
    testWaitForTimeout (200);
    sysSetVariableInt(sysvar::SysVar_PROXI::DIAG_ProxiLesen,0);
    testWaitForTimeout (200);
    sysSetVariableInt(sysvar::SysVar_PROXI::pByte112Bit0,Com_Module_Absent);		
    sysSetVariableInt(sysvar::SysVar_PROXI::DIAG_eLoadAll,1);
    testWaitForTimeout (200);
    sysSetVariableInt(sysvar::SysVar_PROXI::DIAG_eLoadAll,0);
testWaitForTimeout (2000);
    sysSetVariableInt(sysvar::SysVar_PROXI::DIAG_eSendProxi,1);
    testWaitForTimeout (200);
    sysSetVariableInt(sysvar::SysVar_PROXI::DIAG_eSendProxi,0);
    testWaitForTimeout (200);
				
}

export testfunction Clutch_Interlock_Message_Present ()
{
  testModuleTitle("Clutch_Interlock_Message_Present");
  //write("Clutch_Interlock_Message_Present");
  
    sysSetVariableInt(sysvar::SysVar_PROXI::DIAG_ProxiLesen,1);
    testWaitForTimeout (200);
    sysSetVariableInt(sysvar::SysVar_PROXI::DIAG_ProxiLesen,0);
    testWaitForTimeout (200);
    sysSetVariableInt(sysvar::SysVar_PROXI::pByte101Bit7,Clutch_Interlock_Message_Present);		
    sysSetVariableInt(sysvar::SysVar_PROXI::DIAG_eLoadAll,1);
    testWaitForTimeout (200);
    sysSetVariableInt(sysvar::SysVar_PROXI::DIAG_eLoadAll,0);
testWaitForTimeout (2000);
    sysSetVariableInt(sysvar::SysVar_PROXI::DIAG_eSendProxi,1);
    testWaitForTimeout (200);
    sysSetVariableInt(sysvar::SysVar_PROXI::DIAG_eSendProxi,0);
    testWaitForTimeout (200);
				
}

export testfunction Clutch_Interlock_Message_Absent ()
{
  testModuleTitle("Clutch_Interlock_Message_Absent");
  //write("Clutch_Interlock_Message_Absent");
  
    sysSetVariableInt(sysvar::SysVar_PROXI::DIAG_ProxiLesen,1);
    testWaitForTimeout (200);
    sysSetVariableInt(sysvar::SysVar_PROXI::DIAG_ProxiLesen,0);
    testWaitForTimeout (200);
    sysSetVariableInt(sysvar::SysVar_PROXI::pByte101Bit7,Clutch_Interlock_Message_Absent);		
    sysSetVariableInt(sysvar::SysVar_PROXI::DIAG_eLoadAll,1);
    testWaitForTimeout (200);
    sysSetVariableInt(sysvar::SysVar_PROXI::DIAG_eLoadAll,0);
testWaitForTimeout (2000);
    sysSetVariableInt(sysvar::SysVar_PROXI::DIAG_eSendProxi,1);
    testWaitForTimeout (200);
    sysSetVariableInt(sysvar::SysVar_PROXI::DIAG_eSendProxi,0);
    testWaitForTimeout (200);
				
}

export testfunction Cruise_Control_Present ()
{
  testModuleTitle("Cruise_Control_Present");
  //write("Cruise_Control_Present");
  
    sysSetVariableInt(sysvar::SysVar_PROXI::DIAG_ProxiLesen,1);
    testWaitForTimeout (200);
    sysSetVariableInt(sysvar::SysVar_PROXI::DIAG_ProxiLesen,0);
    testWaitForTimeout (200);
    sysSetVariableInt(sysvar::SysVar_PROXI::pByte92Bit1,Cruise_Control_Present);		
    sysSetVariableInt(sysvar::SysVar_PROXI::DIAG_eLoadAll,1);
    testWaitForTimeout (200);
    sysSetVariableInt(sysvar::SysVar_PROXI::DIAG_eLoadAll,0);
testWaitForTimeout (2000);
    sysSetVariableInt(sysvar::SysVar_PROXI::DIAG_eSendProxi,1);
    testWaitForTimeout (200);
    sysSetVariableInt(sysvar::SysVar_PROXI::DIAG_eSendProxi,0);
    testWaitForTimeout (200);
				
}

export testfunction Cruise_Control_Absent ()
{
  testModuleTitle("Cruise_Control_Absent");
  //write("Cruise_Control_Absent");
  
    sysSetVariableInt(sysvar::SysVar_PROXI::DIAG_ProxiLesen,1);
    testWaitForTimeout (200);
    sysSetVariableInt(sysvar::SysVar_PROXI::DIAG_ProxiLesen,0);
    testWaitForTimeout (200);
    sysSetVariableInt(sysvar::SysVar_PROXI::pByte92Bit1,Cruise_Control_Absent);		
    sysSetVariableInt(sysvar::SysVar_PROXI::DIAG_eLoadAll,1);
    testWaitForTimeout (200);
    sysSetVariableInt(sysvar::SysVar_PROXI::DIAG_eLoadAll,0);
testWaitForTimeout (2000);
    sysSetVariableInt(sysvar::SysVar_PROXI::DIAG_eSendProxi,1);
    testWaitForTimeout (200);
    sysSetVariableInt(sysvar::SysVar_PROXI::DIAG_eSendProxi,0);
    testWaitForTimeout (200);
				
}

	export testfunction DPF_Presence_Present ()
{
  testModuleTitle("DPF_Presence_Present");
  //write("DPF_Presence_Present");
  
    sysSetVariableInt(sysvar::SysVar_PROXI::DIAG_ProxiLesen,1);
    testWaitForTimeout (200);
    sysSetVariableInt(sysvar::SysVar_PROXI::DIAG_ProxiLesen,0);
    testWaitForTimeout (200);
    sysSetVariableInt(sysvar::SysVar_PROXI::pByte109Bit3,DPF_Presence_Present);		
    sysSetVariableInt(sysvar::SysVar_PROXI::DIAG_eLoadAll,1);
    testWaitForTimeout (200);
    sysSetVariableInt(sysvar::SysVar_PROXI::DIAG_eLoadAll,0);
testWaitForTimeout (2000);
    sysSetVariableInt(sysvar::SysVar_PROXI::DIAG_eSendProxi,1);
    testWaitForTimeout (200);
    sysSetVariableInt(sysvar::SysVar_PROXI::DIAG_eSendProxi,0);
    testWaitForTimeout (200);
				
}

export testfunction DPF_Presence_Absent ()
{
  testModuleTitle("DPF_Presence_Absent");
  //write("DPF_Presence_Absent");
  
    sysSetVariableInt(sysvar::SysVar_PROXI::DIAG_ProxiLesen,1);
    testWaitForTimeout (200);
    sysSetVariableInt(sysvar::SysVar_PROXI::DIAG_ProxiLesen,0);
    testWaitForTimeout (200);
    sysSetVariableInt(sysvar::SysVar_PROXI::pByte109Bit3,DPF_Presence_Absent);		
    sysSetVariableInt(sysvar::SysVar_PROXI::DIAG_eLoadAll,1);
    testWaitForTimeout (200);
    sysSetVariableInt(sysvar::SysVar_PROXI::DIAG_eLoadAll,0);
testWaitForTimeout (2000);
    sysSetVariableInt(sysvar::SysVar_PROXI::DIAG_eSendProxi,1);
    testWaitForTimeout (200);
    sysSetVariableInt(sysvar::SysVar_PROXI::DIAG_eSendProxi,0);
    testWaitForTimeout (200);
				
}

	export testfunction Driver_Side_Left ()
{
  testModuleTitle("Driver_Side_Left");
  //write("Driver_Side_Left");
  
    sysSetVariableInt(sysvar::SysVar_PROXI::DIAG_ProxiLesen,1);
    testWaitForTimeout (200);
    sysSetVariableInt(sysvar::SysVar_PROXI::DIAG_ProxiLesen,0);
    testWaitForTimeout (200);
    sysSetVariableInt(sysvar::SysVar_PROXI::pByte58Bit3,Driver_Side_Left);		
    sysSetVariableInt(sysvar::SysVar_PROXI::DIAG_eLoadAll,1);
    testWaitForTimeout (200);
    sysSetVariableInt(sysvar::SysVar_PROXI::DIAG_eLoadAll,0);
testWaitForTimeout (2000);
    sysSetVariableInt(sysvar::SysVar_PROXI::DIAG_eSendProxi,1);
    testWaitForTimeout (200);
    sysSetVariableInt(sysvar::SysVar_PROXI::DIAG_eSendProxi,0);
    testWaitForTimeout (200);
				
}

export testfunction Driver_Side_Right ()
{
  testModuleTitle("Driver_Side_Right");
  //write("Driver_Side_Right");
  
    sysSetVariableInt(sysvar::SysVar_PROXI::DIAG_ProxiLesen,1);
    testWaitForTimeout (200);
    sysSetVariableInt(sysvar::SysVar_PROXI::DIAG_ProxiLesen,0);
    testWaitForTimeout (200);
    sysSetVariableInt(sysvar::SysVar_PROXI::pByte58Bit3,Driver_Side_Right);		
    sysSetVariableInt(sysvar::SysVar_PROXI::DIAG_eLoadAll,1);
    testWaitForTimeout (200);
    sysSetVariableInt(sysvar::SysVar_PROXI::DIAG_eLoadAll,0);
testWaitForTimeout (2000);
    sysSetVariableInt(sysvar::SysVar_PROXI::DIAG_eSendProxi,1);
    testWaitForTimeout (200);
    sysSetVariableInt(sysvar::SysVar_PROXI::DIAG_eSendProxi,0);
    testWaitForTimeout (200);
				
}



	export testfunction DMS_Redirect_Menu_Present ()
{
  testModuleTitle("DMS_Redirect_Menu_Present");
  //write("DMS_Redirect_Menu_Present");
  
    sysSetVariableInt(sysvar::SysVar_PROXI::DIAG_ProxiLesen,1);
    testWaitForTimeout (200);
    sysSetVariableInt(sysvar::SysVar_PROXI::DIAG_ProxiLesen,0);
    testWaitForTimeout (200);
    sysSetVariableInt(sysvar::SysVar_PROXI::pByte137Bit2,DMS_Redirect_Menu_Present);		
    sysSetVariableInt(sysvar::SysVar_PROXI::DIAG_eLoadAll,1);
    testWaitForTimeout (200);
    sysSetVariableInt(sysvar::SysVar_PROXI::DIAG_eLoadAll,0);
testWaitForTimeout (2000);
    sysSetVariableInt(sysvar::SysVar_PROXI::DIAG_eSendProxi,1);
    testWaitForTimeout (200);
    sysSetVariableInt(sysvar::SysVar_PROXI::DIAG_eSendProxi,0);
    testWaitForTimeout (200);
				
}

export testfunction DMS_Redirect_Menu_Absent ()
{
  testModuleTitle("DMS_Redirect_Menu_Absent");
  //write("DMS_Redirect_Menu_Absent");
  
    sysSetVariableInt(sysvar::SysVar_PROXI::DIAG_ProxiLesen,1);
    testWaitForTimeout (200);
    sysSetVariableInt(sysvar::SysVar_PROXI::DIAG_ProxiLesen,0);
    testWaitForTimeout (200);
    sysSetVariableInt(sysvar::SysVar_PROXI::pByte137Bit2,DMS_Redirect_Menu_Absent);		
    sysSetVariableInt(sysvar::SysVar_PROXI::DIAG_eLoadAll,1);
    testWaitForTimeout (200);
    sysSetVariableInt(sysvar::SysVar_PROXI::DIAG_eLoadAll,0);
testWaitForTimeout (2000);
    sysSetVariableInt(sysvar::SysVar_PROXI::DIAG_eSendProxi,1);
    testWaitForTimeout (200);
    sysSetVariableInt(sysvar::SysVar_PROXI::DIAG_eSendProxi,0);
    testWaitForTimeout (200);
				
}

	export testfunction DST_Presence_Present ()
{
  testModuleTitle("DST_Presence_Present");
  //write("DST_Presence_Present");
  
    sysSetVariableInt(sysvar::SysVar_PROXI::DIAG_ProxiLesen,1);
    testWaitForTimeout (200);
    sysSetVariableInt(sysvar::SysVar_PROXI::DIAG_ProxiLesen,0);
    testWaitForTimeout (200);
    sysSetVariableInt(sysvar::SysVar_PROXI::pByte88Bit7,DST_Presence_Present);		
    sysSetVariableInt(sysvar::SysVar_PROXI::DIAG_eLoadAll,1);
    testWaitForTimeout (200);
    sysSetVariableInt(sysvar::SysVar_PROXI::DIAG_eLoadAll,0);
testWaitForTimeout (2000);
    sysSetVariableInt(sysvar::SysVar_PROXI::DIAG_eSendProxi,1);
    testWaitForTimeout (200);
    sysSetVariableInt(sysvar::SysVar_PROXI::DIAG_eSendProxi,0);
    testWaitForTimeout (200);
				
}

export testfunction DST_Presence_Absent ()
{
  testModuleTitle("DST_Presence_Absent");
  //write("DST_Presence_Absent");
  
    sysSetVariableInt(sysvar::SysVar_PROXI::DIAG_ProxiLesen,1);
    testWaitForTimeout (200);
    sysSetVariableInt(sysvar::SysVar_PROXI::DIAG_ProxiLesen,0);
    testWaitForTimeout (200);
    sysSetVariableInt(sysvar::SysVar_PROXI::pByte88Bit7,DST_Presence_Absent);		
    sysSetVariableInt(sysvar::SysVar_PROXI::DIAG_eLoadAll,1);
    testWaitForTimeout (200);
    sysSetVariableInt(sysvar::SysVar_PROXI::DIAG_eLoadAll,0);
testWaitForTimeout (2000);
    sysSetVariableInt(sysvar::SysVar_PROXI::DIAG_eSendProxi,1);
    testWaitForTimeout (200);
    sysSetVariableInt(sysvar::SysVar_PROXI::DIAG_eSendProxi,0);
    testWaitForTimeout (200);
				
}

	export testfunction DRL_Menu_Enable_Present ()
{
  testModuleTitle("DRL_Menu_Enable_Present");
  //write("DRL_Menu_Enable_Present");
  
    sysSetVariableInt(sysvar::SysVar_PROXI::DIAG_ProxiLesen,1);
    testWaitForTimeout (200);
    sysSetVariableInt(sysvar::SysVar_PROXI::DIAG_ProxiLesen,0);
    testWaitForTimeout (200);
    sysSetVariableInt(sysvar::SysVar_PROXI::pByte109Bit4,DRL_Menu_Enable_Present);		
    sysSetVariableInt(sysvar::SysVar_PROXI::DIAG_eLoadAll,1);
    testWaitForTimeout (200);
    sysSetVariableInt(sysvar::SysVar_PROXI::DIAG_eLoadAll,0);
testWaitForTimeout (2000);
    sysSetVariableInt(sysvar::SysVar_PROXI::DIAG_eSendProxi,1);
    testWaitForTimeout (200);
    sysSetVariableInt(sysvar::SysVar_PROXI::DIAG_eSendProxi,0);
    testWaitForTimeout (200);
				
}

export testfunction DRL_Menu_Enable_Absent ()
{
  testModuleTitle("DRL_Menu_Enable_Absent");
  //write("DRL_Menu_Enable_Absent");
  
    sysSetVariableInt(sysvar::SysVar_PROXI::DIAG_ProxiLesen,1);
    testWaitForTimeout (200);
    sysSetVariableInt(sysvar::SysVar_PROXI::DIAG_ProxiLesen,0);
    testWaitForTimeout (200);
    sysSetVariableInt(sysvar::SysVar_PROXI::pByte109Bit4,DRL_Menu_Enable_Absent);		
    sysSetVariableInt(sysvar::SysVar_PROXI::DIAG_eLoadAll,1);
    testWaitForTimeout (200);
    sysSetVariableInt(sysvar::SysVar_PROXI::DIAG_eLoadAll,0);
testWaitForTimeout (2000);
    sysSetVariableInt(sysvar::SysVar_PROXI::DIAG_eSendProxi,1);
    testWaitForTimeout (200);
    sysSetVariableInt(sysvar::SysVar_PROXI::DIAG_eSendProxi,0);
    testWaitForTimeout (200);
				
}
	
export testfunction CAN_node0_BCM_Present ()
{
  testModuleTitle("CAN_node0_BCM_Present");
  //write("CAN_node0_BCM_Present");
  
    sysSetVariableInt(sysvar::SysVar_PROXI::DIAG_ProxiLesen,1);
    testWaitForTimeout (200);
    sysSetVariableInt(sysvar::SysVar_PROXI::DIAG_ProxiLesen,0);
    testWaitForTimeout (200);
    sysSetVariableInt(sysvar::SysVar_PROXI::pByte26Bit0,CAN_node0_BCM_Present);		
    sysSetVariableInt(sysvar::SysVar_PROXI::DIAG_eLoadAll,1);
    testWaitForTimeout (200);
    sysSetVariableInt(sysvar::SysVar_PROXI::DIAG_eLoadAll,0);
testWaitForTimeout (2000);
    sysSetVariableInt(sysvar::SysVar_PROXI::DIAG_eSendProxi,1);
    testWaitForTimeout (200);
    sysSetVariableInt(sysvar::SysVar_PROXI::DIAG_eSendProxi,0);
    testWaitForTimeout (200);
				
}

	export testfunction EPB_Maintenance_Menu_Present ()
{
  testModuleTitle("EPB_Maintenance_Menu_Present");
  //write("EPB_Maintenance_Menu_Present");
  
    sysSetVariableInt(sysvar::SysVar_PROXI::DIAG_ProxiLesen,1);
    testWaitForTimeout (200);
    sysSetVariableInt(sysvar::SysVar_PROXI::DIAG_ProxiLesen,0);
    testWaitForTimeout (200);
    sysSetVariableInt(sysvar::SysVar_PROXI::pByte133Bit2,EPB_Maintenance_Menu_Present);		
    sysSetVariableInt(sysvar::SysVar_PROXI::DIAG_eLoadAll,1);
    testWaitForTimeout (200);
    sysSetVariableInt(sysvar::SysVar_PROXI::DIAG_eLoadAll,0);
testWaitForTimeout (2000);
    sysSetVariableInt(sysvar::SysVar_PROXI::DIAG_eSendProxi,1);
    testWaitForTimeout (200);
    sysSetVariableInt(sysvar::SysVar_PROXI::DIAG_eSendProxi,0);
    testWaitForTimeout (200);
				
}

export testfunction EPB_Maintenance_Menu_Absent ()
{
  testModuleTitle("EPB_Maintenance_Menu_Absent");
  //write("EPB_Maintenance_Menu_Absent");
  
    sysSetVariableInt(sysvar::SysVar_PROXI::DIAG_ProxiLesen,1);
    testWaitForTimeout (200);
    sysSetVariableInt(sysvar::SysVar_PROXI::DIAG_ProxiLesen,0);
    testWaitForTimeout (200);
    sysSetVariableInt(sysvar::SysVar_PROXI::pByte133Bit2,EPB_Maintenance_Menu_Absent);		
    sysSetVariableInt(sysvar::SysVar_PROXI::DIAG_eLoadAll,1);
    testWaitForTimeout (200);
    sysSetVariableInt(sysvar::SysVar_PROXI::DIAG_eLoadAll,0);
testWaitForTimeout (2000);
    sysSetVariableInt(sysvar::SysVar_PROXI::DIAG_eSendProxi,1);
    testWaitForTimeout (200);
    sysSetVariableInt(sysvar::SysVar_PROXI::DIAG_eSendProxi,0);
    testWaitForTimeout (200);
				
}

	export testfunction External_Temperature_Sensor_Menu_Present ()
{
  testModuleTitle("External_Temperature_Sensor_Menu_Present");
  //write("External_Temperature_Sensor_Menu_Present");
  
    sysSetVariableInt(sysvar::SysVar_PROXI::DIAG_ProxiLesen,1);
    testWaitForTimeout (200);
    sysSetVariableInt(sysvar::SysVar_PROXI::DIAG_ProxiLesen,0);
    testWaitForTimeout (200);
    sysSetVariableInt(sysvar::SysVar_PROXI::pByte109Bit7,External_Temperature_Sensor_Menu_Present);		
    sysSetVariableInt(sysvar::SysVar_PROXI::DIAG_eLoadAll,1);
    testWaitForTimeout (200);
    sysSetVariableInt(sysvar::SysVar_PROXI::DIAG_eLoadAll,0);
testWaitForTimeout (2000);
    sysSetVariableInt(sysvar::SysVar_PROXI::DIAG_eSendProxi,1);
    testWaitForTimeout (200);
    sysSetVariableInt(sysvar::SysVar_PROXI::DIAG_eSendProxi,0);
    testWaitForTimeout (200);
				
}

export testfunction External_Temperature_Sensor_Menu_Absent ()
{
  testModuleTitle("External_Temperature_Sensor_Menu_Absent");
  //write("External_Temperature_Sensor_Menu_Absent");
  
    sysSetVariableInt(sysvar::SysVar_PROXI::DIAG_ProxiLesen,1);
    testWaitForTimeout (200);
    sysSetVariableInt(sysvar::SysVar_PROXI::DIAG_ProxiLesen,0);
    testWaitForTimeout (200);
    sysSetVariableInt(sysvar::SysVar_PROXI::pByte109Bit7,External_Temperature_Sensor_Menu_Absent);		
    sysSetVariableInt(sysvar::SysVar_PROXI::DIAG_eLoadAll,1);
    testWaitForTimeout (200);
    sysSetVariableInt(sysvar::SysVar_PROXI::DIAG_eLoadAll,0);
testWaitForTimeout (2000);
    sysSetVariableInt(sysvar::SysVar_PROXI::DIAG_eSendProxi,1);
    testWaitForTimeout (200);
    sysSetVariableInt(sysvar::SysVar_PROXI::DIAG_eSendProxi,0);
    testWaitForTimeout (200);
				
}

	export testfunction Flash_Light_With_Lock_Menu_Present ()
{
  testModuleTitle("Flash_Light_With_Lock_Menu_Present");
  //write("Flash_Light_With_Lock_Menu_Present");
  
    sysSetVariableInt(sysvar::SysVar_PROXI::DIAG_ProxiLesen,1);
    testWaitForTimeout (200);
    sysSetVariableInt(sysvar::SysVar_PROXI::DIAG_ProxiLesen,0);
    testWaitForTimeout (200);
    sysSetVariableInt(sysvar::SysVar_PROXI::pByte133Bit1,Flash_Light_With_Lock_Menu_Present);		
    sysSetVariableInt(sysvar::SysVar_PROXI::DIAG_eLoadAll,1);
    testWaitForTimeout (200);
    sysSetVariableInt(sysvar::SysVar_PROXI::DIAG_eLoadAll,0);
testWaitForTimeout (2000);
    sysSetVariableInt(sysvar::SysVar_PROXI::DIAG_eSendProxi,1);
    testWaitForTimeout (200);
    sysSetVariableInt(sysvar::SysVar_PROXI::DIAG_eSendProxi,0);
    testWaitForTimeout (200);
				
}

export testfunction Flash_Light_With_Lock_Menu_Absent ()
{
  testModuleTitle("Flash_Light_With_Lock_Menu_Absent");
  //write("Flash_Light_With_Lock_Menu_Absent");
  
    sysSetVariableInt(sysvar::SysVar_PROXI::DIAG_ProxiLesen,1);
    testWaitForTimeout (200);
    sysSetVariableInt(sysvar::SysVar_PROXI::DIAG_ProxiLesen,0);
    testWaitForTimeout (200);
    sysSetVariableInt(sysvar::SysVar_PROXI::pByte133Bit1,Flash_Light_With_Lock_Menu_Absent);		
    sysSetVariableInt(sysvar::SysVar_PROXI::DIAG_eLoadAll,1);
    testWaitForTimeout (200);
    sysSetVariableInt(sysvar::SysVar_PROXI::DIAG_eLoadAll,0);
testWaitForTimeout (2000);
    sysSetVariableInt(sysvar::SysVar_PROXI::DIAG_eSendProxi,1);
    testWaitForTimeout (200);
    sysSetVariableInt(sysvar::SysVar_PROXI::DIAG_eSendProxi,0);
    testWaitForTimeout (200);
				
}

		export testfunction Front_Psng_Disable_Switch_Via_Menu_Present ()
{
  testModuleTitle("Front_Psng_Disable_Switch_Via_Menu_Present");
  //write("Front_Psng_Disable_Switch_Via_Menu_Present");
  
    sysSetVariableInt(sysvar::SysVar_PROXI::DIAG_ProxiLesen,1);
    testWaitForTimeout (200);
    sysSetVariableInt(sysvar::SysVar_PROXI::DIAG_ProxiLesen,0);
    testWaitForTimeout (200);
    sysSetVariableInt(sysvar::SysVar_PROXI::pByte74Bit0,Front_Psng_Disable_Switch_Via_Menu_Present);		
    sysSetVariableInt(sysvar::SysVar_PROXI::DIAG_eLoadAll,1);
    testWaitForTimeout (200);
    sysSetVariableInt(sysvar::SysVar_PROXI::DIAG_eLoadAll,0);
testWaitForTimeout (2000);
    sysSetVariableInt(sysvar::SysVar_PROXI::DIAG_eSendProxi,1);
    testWaitForTimeout (200);
    sysSetVariableInt(sysvar::SysVar_PROXI::DIAG_eSendProxi,0);
    testWaitForTimeout (200);
				
}

export testfunction Front_Psng_Disable_Switch_Via_Menu_Absent ()
{
  testModuleTitle("Front_Psng_Disable_Switch_Via_Menu_Absent");
  //write("Front_Psng_Disable_Switch_Via_Menu_Absent");
  
    sysSetVariableInt(sysvar::SysVar_PROXI::DIAG_ProxiLesen,1);
    testWaitForTimeout (200);
    sysSetVariableInt(sysvar::SysVar_PROXI::DIAG_ProxiLesen,0);
    testWaitForTimeout (200);
    sysSetVariableInt(sysvar::SysVar_PROXI::pByte74Bit0,Front_Psng_Disable_Switch_Via_Menu_Absent);		
    sysSetVariableInt(sysvar::SysVar_PROXI::DIAG_eLoadAll,1);
    testWaitForTimeout (200);
    sysSetVariableInt(sysvar::SysVar_PROXI::DIAG_eLoadAll,0);
testWaitForTimeout (2000);
    sysSetVariableInt(sysvar::SysVar_PROXI::DIAG_eSendProxi,1);
    testWaitForTimeout (200);
    sysSetVariableInt(sysvar::SysVar_PROXI::DIAG_eSendProxi,0);
    testWaitForTimeout (200);
				
}

	export testfunction Greeting_Lights_Menu_Present ()
{
  testModuleTitle("Greeting_Lights_Menu_Present");
  //write("Greeting_Lights_Menu_Present");
  
    sysSetVariableInt(sysvar::SysVar_PROXI::DIAG_ProxiLesen,1);
    testWaitForTimeout (200);
    sysSetVariableInt(sysvar::SysVar_PROXI::DIAG_ProxiLesen,0);
    testWaitForTimeout (200);
    sysSetVariableInt(sysvar::SysVar_PROXI::pByte109Bit0,Greeting_Lights_Menu_Present);		
    sysSetVariableInt(sysvar::SysVar_PROXI::DIAG_eLoadAll,1);
    testWaitForTimeout (200);
    sysSetVariableInt(sysvar::SysVar_PROXI::DIAG_eLoadAll,0);
testWaitForTimeout (2000);
    sysSetVariableInt(sysvar::SysVar_PROXI::DIAG_eSendProxi,1);
    testWaitForTimeout (200);
    sysSetVariableInt(sysvar::SysVar_PROXI::DIAG_eSendProxi,0);
    testWaitForTimeout (200);
				
}

export testfunction Greeting_Lights_Menu_Absent ()
{
  testModuleTitle("Greeting_Lights_Menu_Absent");
  //write("Greeting_Lights_Menu_Absent");
  
    sysSetVariableInt(sysvar::SysVar_PROXI::DIAG_ProxiLesen,1);
    testWaitForTimeout (200);
    sysSetVariableInt(sysvar::SysVar_PROXI::DIAG_ProxiLesen,0);
    testWaitForTimeout (200);
    sysSetVariableInt(sysvar::SysVar_PROXI::pByte109Bit0,Greeting_Lights_Menu_Absent);		
    sysSetVariableInt(sysvar::SysVar_PROXI::DIAG_eLoadAll,1);
    testWaitForTimeout (200);
    sysSetVariableInt(sysvar::SysVar_PROXI::DIAG_eLoadAll,0);
testWaitForTimeout (2000);
    sysSetVariableInt(sysvar::SysVar_PROXI::DIAG_eSendProxi,1);
    testWaitForTimeout (200);
    sysSetVariableInt(sysvar::SysVar_PROXI::DIAG_eSendProxi,0);
    testWaitForTimeout (200);
				
}

	export testfunction Hill_Descendent_Control_Present ()
{
  testModuleTitle("Hill_Descendent_Control_Present");
  //write("Hill_Descendent_Control_Present");
  
    sysSetVariableInt(sysvar::SysVar_PROXI::DIAG_ProxiLesen,1);
    testWaitForTimeout (200);
    sysSetVariableInt(sysvar::SysVar_PROXI::DIAG_ProxiLesen,0);
    testWaitForTimeout (200);
    sysSetVariableInt(sysvar::SysVar_PROXI::pByte87Bit3,Hill_Descendent_Control_Present);		
    sysSetVariableInt(sysvar::SysVar_PROXI::DIAG_eLoadAll,1);
    testWaitForTimeout (200);
    sysSetVariableInt(sysvar::SysVar_PROXI::DIAG_eLoadAll,0);
testWaitForTimeout (2000);
    sysSetVariableInt(sysvar::SysVar_PROXI::DIAG_eSendProxi,1);
    testWaitForTimeout (200);
    sysSetVariableInt(sysvar::SysVar_PROXI::DIAG_eSendProxi,0);
    testWaitForTimeout (200);
				
}

export testfunction Hill_Descendent_Control_Absent ()
{
  testModuleTitle("Hill_Descendent_Control_Absent");
  //write("Hill_Descendent_Control_Absent");
  
    sysSetVariableInt(sysvar::SysVar_PROXI::DIAG_ProxiLesen,1);
    testWaitForTimeout (200);
    sysSetVariableInt(sysvar::SysVar_PROXI::DIAG_ProxiLesen,0);
    testWaitForTimeout (200);
    sysSetVariableInt(sysvar::SysVar_PROXI::pByte87Bit3,Hill_Descendent_Control_Absent);		
    sysSetVariableInt(sysvar::SysVar_PROXI::DIAG_eLoadAll,1);
    testWaitForTimeout (200);
    sysSetVariableInt(sysvar::SysVar_PROXI::DIAG_eLoadAll,0);
testWaitForTimeout (2000);
    sysSetVariableInt(sysvar::SysVar_PROXI::DIAG_eSendProxi,1);
    testWaitForTimeout (200);
    sysSetVariableInt(sysvar::SysVar_PROXI::DIAG_eSendProxi,0);
    testWaitForTimeout (200);
				
}

	export testfunction Hill_Holder_System_Present ()
{
  testModuleTitle("Hill_Holder_System_Present");
  //write("Hill_Holder_System_Present");
  
    sysSetVariableInt(sysvar::SysVar_PROXI::DIAG_ProxiLesen,1);
    testWaitForTimeout (200);
    sysSetVariableInt(sysvar::SysVar_PROXI::DIAG_ProxiLesen,0);
    testWaitForTimeout (200);
    sysSetVariableInt(sysvar::SysVar_PROXI::pByte59Bit3,Hill_Holder_System_Present);		
    sysSetVariableInt(sysvar::SysVar_PROXI::DIAG_eLoadAll,1);
    testWaitForTimeout (200);
    sysSetVariableInt(sysvar::SysVar_PROXI::DIAG_eLoadAll,0);
testWaitForTimeout (2000);
    sysSetVariableInt(sysvar::SysVar_PROXI::DIAG_eSendProxi,1);
    testWaitForTimeout (200);
    sysSetVariableInt(sysvar::SysVar_PROXI::DIAG_eSendProxi,0);
    testWaitForTimeout (200);
				
}

export testfunction Hill_Holder_System_Absent ()
{
  testModuleTitle("Hill_Holder_System_Absent");
  //write("Hill_Holder_System_Absent");
  
    sysSetVariableInt(sysvar::SysVar_PROXI::DIAG_ProxiLesen,1);
    testWaitForTimeout (200);
    sysSetVariableInt(sysvar::SysVar_PROXI::DIAG_ProxiLesen,0);
    testWaitForTimeout (200);
    sysSetVariableInt(sysvar::SysVar_PROXI::pByte59Bit3,Hill_Holder_System_Absent);		
    sysSetVariableInt(sysvar::SysVar_PROXI::DIAG_eLoadAll,1);
    testWaitForTimeout (200);
    sysSetVariableInt(sysvar::SysVar_PROXI::DIAG_eLoadAll,0);
testWaitForTimeout (2000);
    sysSetVariableInt(sysvar::SysVar_PROXI::DIAG_eSendProxi,1);
    testWaitForTimeout (200);
    sysSetVariableInt(sysvar::SysVar_PROXI::DIAG_eSendProxi,0);
    testWaitForTimeout (200);
				
}

	export testfunction Horn_Chirp_Menu_Present ()
{
  testModuleTitle("Horn_Chirp_Menu_Present");
  //write("Horn_Chirp_Menu_Present");
  
    sysSetVariableInt(sysvar::SysVar_PROXI::DIAG_ProxiLesen,1);
    testWaitForTimeout (200);
    sysSetVariableInt(sysvar::SysVar_PROXI::DIAG_ProxiLesen,0);
    testWaitForTimeout (200);
    sysSetVariableInt(sysvar::SysVar_PROXI::pByte110Bit6,Horn_Chirp_Menu_Present);		
    sysSetVariableInt(sysvar::SysVar_PROXI::DIAG_eLoadAll,1);
    testWaitForTimeout (200);
    sysSetVariableInt(sysvar::SysVar_PROXI::DIAG_eLoadAll,0);
testWaitForTimeout (2000);
    sysSetVariableInt(sysvar::SysVar_PROXI::DIAG_eSendProxi,1);
    testWaitForTimeout (200);
    sysSetVariableInt(sysvar::SysVar_PROXI::DIAG_eSendProxi,0);
    testWaitForTimeout (200);
				
}

export testfunction Horn_Chirp_Menu_Absent ()
{
  testModuleTitle("Horn_Chirp_Menu_Absent");
  //write("Horn_Chirp_Menu_Absent");
  
    sysSetVariableInt(sysvar::SysVar_PROXI::DIAG_ProxiLesen,1);
    testWaitForTimeout (200);
    sysSetVariableInt(sysvar::SysVar_PROXI::DIAG_ProxiLesen,0);
    testWaitForTimeout (200);
    sysSetVariableInt(sysvar::SysVar_PROXI::pByte119Bit5,Horn_Chirp_Menu_Absent);		
    sysSetVariableInt(sysvar::SysVar_PROXI::DIAG_eLoadAll,1);
    testWaitForTimeout (200);
    sysSetVariableInt(sysvar::SysVar_PROXI::DIAG_eLoadAll,0);
testWaitForTimeout (2000);
    sysSetVariableInt(sysvar::SysVar_PROXI::DIAG_eSendProxi,1);
    testWaitForTimeout (200);
    sysSetVariableInt(sysvar::SysVar_PROXI::DIAG_eSendProxi,0);
    testWaitForTimeout (200);
				
}

	export testfunction Ignition_Pre_Start_Logic_Enable ()
{
  testModuleTitle("Ignition_Pre_Start_Logic_Enable");
  //write("Ignition_Pre_Start_Logic_Enable");
  
    sysSetVariableInt(sysvar::SysVar_PROXI::DIAG_ProxiLesen,1);
    testWaitForTimeout (200);
    sysSetVariableInt(sysvar::SysVar_PROXI::DIAG_ProxiLesen,0);
    testWaitForTimeout (200);
    sysSetVariableInt(sysvar::SysVar_PROXI::pByte94Bit7,Ignition_Pre_Start_Logic_Enable);		
    sysSetVariableInt(sysvar::SysVar_PROXI::DIAG_eLoadAll,1);
    testWaitForTimeout (200);
    sysSetVariableInt(sysvar::SysVar_PROXI::DIAG_eLoadAll,0);
testWaitForTimeout (2000);
    sysSetVariableInt(sysvar::SysVar_PROXI::DIAG_eSendProxi,1);
    testWaitForTimeout (200);
    sysSetVariableInt(sysvar::SysVar_PROXI::DIAG_eSendProxi,0);
    testWaitForTimeout (200);
				
}

export testfunction Ignition_Pre_Start_Logic_Disabled ()
{
  testModuleTitle("Ignition_Pre_Start_Logic_Disabled");
  //write("Ignition_Pre_Start_Logic_Disabled");
  
    sysSetVariableInt(sysvar::SysVar_PROXI::DIAG_ProxiLesen,1);
    testWaitForTimeout (200);
    sysSetVariableInt(sysvar::SysVar_PROXI::DIAG_ProxiLesen,0);
    testWaitForTimeout (200);
    sysSetVariableInt(sysvar::SysVar_PROXI::pByte94Bit7,Ignition_Pre_Start_Logic_Disabled);		
    sysSetVariableInt(sysvar::SysVar_PROXI::DIAG_eLoadAll,1);
    testWaitForTimeout (200);
    sysSetVariableInt(sysvar::SysVar_PROXI::DIAG_eLoadAll,0);
testWaitForTimeout (2000);
    sysSetVariableInt(sysvar::SysVar_PROXI::DIAG_eSendProxi,1);
    testWaitForTimeout (200);
    sysSetVariableInt(sysvar::SysVar_PROXI::DIAG_eSendProxi,0);
    testWaitForTimeout (200);
				
}

	export testfunction IPC_Internal_Light_Sensor_Present ()
{
  testModuleTitle("IPC_Internal_Light_Sensor_Present");
  //write("IPC_Internal_Light_Sensor_Present");
  
    sysSetVariableInt(sysvar::SysVar_PROXI::DIAG_ProxiLesen,1);
    testWaitForTimeout (200);
    sysSetVariableInt(sysvar::SysVar_PROXI::DIAG_ProxiLesen,0);
    testWaitForTimeout (200);
    sysSetVariableInt(sysvar::SysVar_PROXI::pByte76Bit2,IPC_Internal_Light_Sensor_Present);		
    sysSetVariableInt(sysvar::SysVar_PROXI::DIAG_eLoadAll,1);
    testWaitForTimeout (200);
    sysSetVariableInt(sysvar::SysVar_PROXI::DIAG_eLoadAll,0);
testWaitForTimeout (2000);
    sysSetVariableInt(sysvar::SysVar_PROXI::DIAG_eSendProxi,1);
    testWaitForTimeout (200);
    sysSetVariableInt(sysvar::SysVar_PROXI::DIAG_eSendProxi,0);
    testWaitForTimeout (200);
				
}

export testfunction IPC_Internal_Light_Sensor_Absent ()
{
  testModuleTitle("IPC_Internal_Light_Sensor_Absent");
  //write("IPC_Internal_Light_Sensor_Absent");
  
    sysSetVariableInt(sysvar::SysVar_PROXI::DIAG_ProxiLesen,1);
    testWaitForTimeout (200);
    sysSetVariableInt(sysvar::SysVar_PROXI::DIAG_ProxiLesen,0);
    testWaitForTimeout (200);
    sysSetVariableInt(sysvar::SysVar_PROXI::pByte76Bit2,IPC_Internal_Light_Sensor_Absent);		
    sysSetVariableInt(sysvar::SysVar_PROXI::DIAG_eLoadAll,1);
    testWaitForTimeout (200);
    sysSetVariableInt(sysvar::SysVar_PROXI::DIAG_eLoadAll,0);
testWaitForTimeout (2000);
    sysSetVariableInt(sysvar::SysVar_PROXI::DIAG_eSendProxi,1);
    testWaitForTimeout (200);
    sysSetVariableInt(sysvar::SysVar_PROXI::DIAG_eSendProxi,0);
    testWaitForTimeout (200);
				
}

	export testfunction Key_In_Warning_Present ()
{
  testModuleTitle("Key_In_Warning_Present");
  //write("Key_In_Warning_Present");
  
    sysSetVariableInt(sysvar::SysVar_PROXI::DIAG_ProxiLesen,1);
    testWaitForTimeout (200);
    sysSetVariableInt(sysvar::SysVar_PROXI::DIAG_ProxiLesen,0);
    testWaitForTimeout (200);
    sysSetVariableInt(sysvar::SysVar_PROXI::pByte119Bit6,Key_In_Warning_Present);		
    sysSetVariableInt(sysvar::SysVar_PROXI::DIAG_eLoadAll,1);
    testWaitForTimeout (200);
    sysSetVariableInt(sysvar::SysVar_PROXI::DIAG_eLoadAll,0);
testWaitForTimeout (2000);
    sysSetVariableInt(sysvar::SysVar_PROXI::DIAG_eSendProxi,1);
    testWaitForTimeout (200);
    sysSetVariableInt(sysvar::SysVar_PROXI::DIAG_eSendProxi,0);
    testWaitForTimeout (200);
				
}

export testfunction Key_In_Warning_Absent ()
{
  testModuleTitle("Key_In_Warning_Absent");
  //write("Key_In_Warning_Absent");
  
    sysSetVariableInt(sysvar::SysVar_PROXI::DIAG_ProxiLesen,1);
    testWaitForTimeout (200);
    sysSetVariableInt(sysvar::SysVar_PROXI::DIAG_ProxiLesen,0);
    testWaitForTimeout (200);
    sysSetVariableInt(sysvar::SysVar_PROXI::pByte119Bit6,Key_In_Warning_Absent);		
    sysSetVariableInt(sysvar::SysVar_PROXI::DIAG_eLoadAll,1);
    testWaitForTimeout (200);
    sysSetVariableInt(sysvar::SysVar_PROXI::DIAG_eLoadAll,0);
testWaitForTimeout (2000);
    sysSetVariableInt(sysvar::SysVar_PROXI::DIAG_eSendProxi,1);
    testWaitForTimeout (200);
    sysSetVariableInt(sysvar::SysVar_PROXI::DIAG_eSendProxi,0);
    testWaitForTimeout (200);
				
}

	export testfunction Key_Less_Go_Present ()
{
  testModuleTitle("Key_Less_Go_Present");
  //write("Key_Less_Go_Present");
  
    sysSetVariableInt(sysvar::SysVar_PROXI::DIAG_ProxiLesen,1);
    testWaitForTimeout (200);
    sysSetVariableInt(sysvar::SysVar_PROXI::DIAG_ProxiLesen,0);
    testWaitForTimeout (200);
    sysSetVariableInt(sysvar::SysVar_PROXI::pByte72Bit4,Key_Less_Go_Present);		
    sysSetVariableInt(sysvar::SysVar_PROXI::DIAG_eLoadAll,1);
    testWaitForTimeout (200);
    sysSetVariableInt(sysvar::SysVar_PROXI::DIAG_eLoadAll,0);
testWaitForTimeout (2000);
    sysSetVariableInt(sysvar::SysVar_PROXI::DIAG_eSendProxi,1);
    testWaitForTimeout (200);
    sysSetVariableInt(sysvar::SysVar_PROXI::DIAG_eSendProxi,0);
    testWaitForTimeout (200);
				
}

export testfunction Key_Less_Go_Absent ()
{
  testModuleTitle("Key_Less_Go_Absent");
  //write("Key_Less_Go_Absent");
  
    sysSetVariableInt(sysvar::SysVar_PROXI::DIAG_ProxiLesen,1);
    testWaitForTimeout (200);
    sysSetVariableInt(sysvar::SysVar_PROXI::DIAG_ProxiLesen,0);
    testWaitForTimeout (200);
    sysSetVariableInt(sysvar::SysVar_PROXI::pByte72Bit4,Key_Less_Go_Absent);		
    sysSetVariableInt(sysvar::SysVar_PROXI::DIAG_eLoadAll,1);
    testWaitForTimeout (200);
    sysSetVariableInt(sysvar::SysVar_PROXI::DIAG_eLoadAll,0);
testWaitForTimeout (2000);
    sysSetVariableInt(sysvar::SysVar_PROXI::DIAG_eSendProxi,1);
    testWaitForTimeout (200);
    sysSetVariableInt(sysvar::SysVar_PROXI::DIAG_eSendProxi,0);
    testWaitForTimeout (200);
				
}

	export testfunction Left_Seat_Bag_Present ()
{
  testModuleTitle("Left_Seat_Bag_Present");
  //write("Left_Seat_Bag_Present");
  
    sysSetVariableInt(sysvar::SysVar_PROXI::DIAG_ProxiLesen,1);
    testWaitForTimeout (200);
    sysSetVariableInt(sysvar::SysVar_PROXI::DIAG_ProxiLesen,0);
    testWaitForTimeout (200);
    sysSetVariableInt(sysvar::SysVar_PROXI::pByte80Bit0,Left_Seat_Bag_Present);		
    sysSetVariableInt(sysvar::SysVar_PROXI::DIAG_eLoadAll,1);
    testWaitForTimeout (200);
    sysSetVariableInt(sysvar::SysVar_PROXI::DIAG_eLoadAll,0);
testWaitForTimeout (2000);
    sysSetVariableInt(sysvar::SysVar_PROXI::DIAG_eSendProxi,1);
    testWaitForTimeout (200);
    sysSetVariableInt(sysvar::SysVar_PROXI::DIAG_eSendProxi,0);
    testWaitForTimeout (200);
				
}

export testfunction Left_Seat_Bag_Absent ()
{
  testModuleTitle("Left_Seat_Bag_Absent");
  //write("Left_Seat_Bag_Absent");
  
    sysSetVariableInt(sysvar::SysVar_PROXI::DIAG_ProxiLesen,1);
    testWaitForTimeout (200);
    sysSetVariableInt(sysvar::SysVar_PROXI::DIAG_ProxiLesen,0);
    testWaitForTimeout (200);
    sysSetVariableInt(sysvar::SysVar_PROXI::pByte80Bit0,Left_Seat_Bag_Absent);		
    sysSetVariableInt(sysvar::SysVar_PROXI::DIAG_eLoadAll,1);
    testWaitForTimeout (200);
    sysSetVariableInt(sysvar::SysVar_PROXI::DIAG_eLoadAll,0);
testWaitForTimeout (2000);
    sysSetVariableInt(sysvar::SysVar_PROXI::DIAG_eSendProxi,1);
    testWaitForTimeout (200);
    sysSetVariableInt(sysvar::SysVar_PROXI::DIAG_eSendProxi,0);
    testWaitForTimeout (200);
				
}

	export testfunction NAV_Presence_Present ()
{
  testModuleTitle("NAV_Presence_Present");
  //write("NAV_Presence_Present");
  
    sysSetVariableInt(sysvar::SysVar_PROXI::DIAG_ProxiLesen,1);
    testWaitForTimeout (200);
    sysSetVariableInt(sysvar::SysVar_PROXI::DIAG_ProxiLesen,0);
    testWaitForTimeout (200);
    sysSetVariableInt(sysvar::SysVar_PROXI::pByte121Bit2,NAV_Presence_Present);		
    sysSetVariableInt(sysvar::SysVar_PROXI::DIAG_eLoadAll,1);
    testWaitForTimeout (200);
    sysSetVariableInt(sysvar::SysVar_PROXI::DIAG_eLoadAll,0);
testWaitForTimeout (2000);
    sysSetVariableInt(sysvar::SysVar_PROXI::DIAG_eSendProxi,1);
    testWaitForTimeout (200);
    sysSetVariableInt(sysvar::SysVar_PROXI::DIAG_eSendProxi,0);
    testWaitForTimeout (200);
				
}

export testfunction NAV_Presence_Absent ()
{
  testModuleTitle("NAV_Presence_Absent");
  //write("NAV_Presence_Absent");
  
    sysSetVariableInt(sysvar::SysVar_PROXI::DIAG_ProxiLesen,1);
    testWaitForTimeout (200);
    sysSetVariableInt(sysvar::SysVar_PROXI::DIAG_ProxiLesen,0);
    testWaitForTimeout (200);
    sysSetVariableInt(sysvar::SysVar_PROXI::pByte121Bit2,NAV_Presence_Absent);		
    sysSetVariableInt(sysvar::SysVar_PROXI::DIAG_eLoadAll,1);
    testWaitForTimeout (200);
    sysSetVariableInt(sysvar::SysVar_PROXI::DIAG_eLoadAll,0);
testWaitForTimeout (2000);
    sysSetVariableInt(sysvar::SysVar_PROXI::DIAG_eSendProxi,1);
    testWaitForTimeout (200);
    sysSetVariableInt(sysvar::SysVar_PROXI::DIAG_eSendProxi,0);
    testWaitForTimeout (200);
				
}

	export testfunction Nav_Repetition_Present ()
{
  testModuleTitle("Nav_Repetition_Present");
  //write("Nav_Repetition_Present");
  
    sysSetVariableInt(sysvar::SysVar_PROXI::DIAG_ProxiLesen,1);
    testWaitForTimeout (200);
    sysSetVariableInt(sysvar::SysVar_PROXI::DIAG_ProxiLesen,0);
    testWaitForTimeout (200);
    sysSetVariableInt(sysvar::SysVar_PROXI::pByte123Bit6,Nav_Repetition_Present);		
    sysSetVariableInt(sysvar::SysVar_PROXI::DIAG_eLoadAll,1);
    testWaitForTimeout (200);
    sysSetVariableInt(sysvar::SysVar_PROXI::DIAG_eLoadAll,0);
testWaitForTimeout (2000);
    sysSetVariableInt(sysvar::SysVar_PROXI::DIAG_eSendProxi,1);
    testWaitForTimeout (200);
    sysSetVariableInt(sysvar::SysVar_PROXI::DIAG_eSendProxi,0);
    testWaitForTimeout (200);
				
}

export testfunction Nav_Repetition_Absent ()
{
  testModuleTitle("Nav_Repetition_Absent");
  //write("Nav_Repetition_Absent");
  
    sysSetVariableInt(sysvar::SysVar_PROXI::DIAG_ProxiLesen,1);
    testWaitForTimeout (200);
    sysSetVariableInt(sysvar::SysVar_PROXI::DIAG_ProxiLesen,0);
    testWaitForTimeout (200);
    sysSetVariableInt(sysvar::SysVar_PROXI::pByte123Bit6,Nav_Repetition_Absent);		
    sysSetVariableInt(sysvar::SysVar_PROXI::DIAG_eLoadAll,1);
    testWaitForTimeout (200);
    sysSetVariableInt(sysvar::SysVar_PROXI::DIAG_eLoadAll,0);
testWaitForTimeout (2000);
    sysSetVariableInt(sysvar::SysVar_PROXI::DIAG_eSendProxi,1);
    testWaitForTimeout (200);
    sysSetVariableInt(sysvar::SysVar_PROXI::DIAG_eSendProxi,0);
    testWaitForTimeout (200);
				
}
	export testfunction Nav_Repetition_Menu_Present ()
{
  testModuleTitle("Nav_Repetition_Menu_Present");
  //write("Nav_Repetition_Menu_Present");
  
    sysSetVariableInt(sysvar::SysVar_PROXI::DIAG_ProxiLesen,1);
    testWaitForTimeout (200);
    sysSetVariableInt(sysvar::SysVar_PROXI::DIAG_ProxiLesen,0);
    testWaitForTimeout (200);
    sysSetVariableInt(sysvar::SysVar_PROXI::pByte132Bit5,Nav_Repetition_Menu_Present);		
    sysSetVariableInt(sysvar::SysVar_PROXI::DIAG_eLoadAll,1);
    testWaitForTimeout (200);
    sysSetVariableInt(sysvar::SysVar_PROXI::DIAG_eLoadAll,0);
testWaitForTimeout (2000);
    sysSetVariableInt(sysvar::SysVar_PROXI::DIAG_eSendProxi,1);
    testWaitForTimeout (200);
    sysSetVariableInt(sysvar::SysVar_PROXI::DIAG_eSendProxi,0);
    testWaitForTimeout (200);
				
}

export testfunction Nav_Repetition_Menu_Absent ()
{
  testModuleTitle("Nav_Repetition_Menu_Absent");
  //write("Nav_Repetition_Menu_Absent");
  
    sysSetVariableInt(sysvar::SysVar_PROXI::DIAG_ProxiLesen,1);
    testWaitForTimeout (200);
    sysSetVariableInt(sysvar::SysVar_PROXI::DIAG_ProxiLesen,0);
    testWaitForTimeout (200);
    sysSetVariableInt(sysvar::SysVar_PROXI::pByte132Bit5,Nav_Repetition_Menu_Absent);		
    sysSetVariableInt(sysvar::SysVar_PROXI::DIAG_eLoadAll,1);
    testWaitForTimeout (200);
    sysSetVariableInt(sysvar::SysVar_PROXI::DIAG_eLoadAll,0);
testWaitForTimeout (2000);
    sysSetVariableInt(sysvar::SysVar_PROXI::DIAG_eSendProxi,1);
    testWaitForTimeout (200);
    sysSetVariableInt(sysvar::SysVar_PROXI::DIAG_eSendProxi,0);
    testWaitForTimeout (200);
				
}

	export testfunction Over_Speed_Warning_Present ()
{
  testModuleTitle("Over_Speed_Warning_Present");
  //write("Over_Speed_Warning_Present");
  
    sysSetVariableInt(sysvar::SysVar_PROXI::DIAG_ProxiLesen,1);
    testWaitForTimeout (200);
    sysSetVariableInt(sysvar::SysVar_PROXI::DIAG_ProxiLesen,0);
    testWaitForTimeout (200);
    sysSetVariableInt(sysvar::SysVar_PROXI::pByte109Bit1,Over_Speed_Warning_Present);		
    sysSetVariableInt(sysvar::SysVar_PROXI::DIAG_eLoadAll,1);
    testWaitForTimeout (200);
    sysSetVariableInt(sysvar::SysVar_PROXI::DIAG_eLoadAll,0);
testWaitForTimeout (2000);
    sysSetVariableInt(sysvar::SysVar_PROXI::DIAG_eSendProxi,1);
    testWaitForTimeout (200);
    sysSetVariableInt(sysvar::SysVar_PROXI::DIAG_eSendProxi,0);
    testWaitForTimeout (200);
				
}

export testfunction Over_Speed_Warning_Absent ()
{
  testModuleTitle("Over_Speed_Warning_Absent");
  //write("Over_Speed_Warning_Absent");
  
    sysSetVariableInt(sysvar::SysVar_PROXI::DIAG_ProxiLesen,1);
    testWaitForTimeout (200);
    sysSetVariableInt(sysvar::SysVar_PROXI::DIAG_ProxiLesen,0);
    testWaitForTimeout (200);
    sysSetVariableInt(sysvar::SysVar_PROXI::pByte109Bit1,Over_Speed_Warning_Absent);		
    sysSetVariableInt(sysvar::SysVar_PROXI::DIAG_eLoadAll,1);
    testWaitForTimeout (200);
    sysSetVariableInt(sysvar::SysVar_PROXI::DIAG_eLoadAll,0);
testWaitForTimeout (2000);
    sysSetVariableInt(sysvar::SysVar_PROXI::DIAG_eSendProxi,1);
    testWaitForTimeout (200);
    sysSetVariableInt(sysvar::SysVar_PROXI::DIAG_eSendProxi,0);
    testWaitForTimeout (200);
				
}

	export testfunction Odo_Units_Change_Present ()
{
  testModuleTitle("Odo_Units_Change_Present");
  //write("Odo_Units_Change_Present");
  
    sysSetVariableInt(sysvar::SysVar_PROXI::DIAG_ProxiLesen,1);
    testWaitForTimeout (200);
    sysSetVariableInt(sysvar::SysVar_PROXI::DIAG_ProxiLesen,0);
    testWaitForTimeout (200);
    sysSetVariableInt(sysvar::SysVar_PROXI::pByte109Bit2,Odo_Units_Change_Present);		
    sysSetVariableInt(sysvar::SysVar_PROXI::DIAG_eLoadAll,1);
    testWaitForTimeout (200);
    sysSetVariableInt(sysvar::SysVar_PROXI::DIAG_eLoadAll,0);
testWaitForTimeout (2000);
    sysSetVariableInt(sysvar::SysVar_PROXI::DIAG_eSendProxi,1);
    testWaitForTimeout (200);
    sysSetVariableInt(sysvar::SysVar_PROXI::DIAG_eSendProxi,0);
    testWaitForTimeout (200);
				
}

export testfunction Odo_Units_Change_Absent ()
{
  testModuleTitle("Odo_Units_Change_Absent");
  //write("Odo_Units_Change_Absent");
  
    sysSetVariableInt(sysvar::SysVar_PROXI::DIAG_ProxiLesen,1);
    testWaitForTimeout (200);
    sysSetVariableInt(sysvar::SysVar_PROXI::DIAG_ProxiLesen,0);
    testWaitForTimeout (200);
    sysSetVariableInt(sysvar::SysVar_PROXI::pByte109Bit2,Odo_Units_Change_Absent);		
    sysSetVariableInt(sysvar::SysVar_PROXI::DIAG_eLoadAll,1);
    testWaitForTimeout (200);
    sysSetVariableInt(sysvar::SysVar_PROXI::DIAG_eLoadAll,0);
testWaitForTimeout (2000);
    sysSetVariableInt(sysvar::SysVar_PROXI::DIAG_eSendProxi,1);
    testWaitForTimeout (200);
    sysSetVariableInt(sysvar::SysVar_PROXI::DIAG_eSendProxi,0);
    testWaitForTimeout (200);
				
}

	export testfunction Phone_Repetition_Menu_Present ()
{
  testModuleTitle("Phone_Repetition_Menu_Present");
  //write("Phone_Repetition_Menu_Present");
  
    sysSetVariableInt(sysvar::SysVar_PROXI::DIAG_ProxiLesen,1);
    testWaitForTimeout (200);
    sysSetVariableInt(sysvar::SysVar_PROXI::DIAG_ProxiLesen,0);
    testWaitForTimeout (200);
    sysSetVariableInt(sysvar::SysVar_PROXI::pByte132Bit6,Phone_Repetition_Menu_Present);		
    sysSetVariableInt(sysvar::SysVar_PROXI::DIAG_eLoadAll,1);
    testWaitForTimeout (200);
    sysSetVariableInt(sysvar::SysVar_PROXI::DIAG_eLoadAll,0);
testWaitForTimeout (2000);
    sysSetVariableInt(sysvar::SysVar_PROXI::DIAG_eSendProxi,1);
    testWaitForTimeout (200);
    sysSetVariableInt(sysvar::SysVar_PROXI::DIAG_eSendProxi,0);
    testWaitForTimeout (200);
				
}

export testfunction Phone_Repetition_Menu_Absent ()
{
  testModuleTitle("Phone_Repetition_Menu_Absent");
  //write("Phone_Repetition_Menu_Absent");
  
    sysSetVariableInt(sysvar::SysVar_PROXI::DIAG_ProxiLesen,1);
    testWaitForTimeout (200);
    sysSetVariableInt(sysvar::SysVar_PROXI::DIAG_ProxiLesen,0);
    testWaitForTimeout (200);
    sysSetVariableInt(sysvar::SysVar_PROXI::pByte132Bit6,Phone_Repetition_Menu_Absent);		
    sysSetVariableInt(sysvar::SysVar_PROXI::DIAG_eLoadAll,1);
    testWaitForTimeout (200);
    sysSetVariableInt(sysvar::SysVar_PROXI::DIAG_eLoadAll,0);
testWaitForTimeout (2000);
    sysSetVariableInt(sysvar::SysVar_PROXI::DIAG_eSendProxi,1);
    testWaitForTimeout (200);
    sysSetVariableInt(sysvar::SysVar_PROXI::DIAG_eSendProxi,0);
    testWaitForTimeout (200);
				
}

	export testfunction PAM_Configuration_Rear ()
{
  testModuleTitle("PAM_Configuration_Rear");
  //write("PAM_Configuration_Rear");
  
    sysSetVariableInt(sysvar::SysVar_PROXI::DIAG_ProxiLesen,1);
    testWaitForTimeout (200);
    sysSetVariableInt(sysvar::SysVar_PROXI::DIAG_ProxiLesen,0);
    testWaitForTimeout (200);
    sysSetVariableInt(sysvar::SysVar_PROXI::pByte118Bit45,PAM_Configuration_Rear);		
    sysSetVariableInt(sysvar::SysVar_PROXI::DIAG_eLoadAll,1);
    testWaitForTimeout (200);
    sysSetVariableInt(sysvar::SysVar_PROXI::DIAG_eLoadAll,0);
testWaitForTimeout (2000);
    sysSetVariableInt(sysvar::SysVar_PROXI::DIAG_eSendProxi,1);
    testWaitForTimeout (200);
    sysSetVariableInt(sysvar::SysVar_PROXI::DIAG_eSendProxi,0);
    testWaitForTimeout (200);
				
}

export testfunction PAM_Configuration_Front_Rear ()
{
  testModuleTitle("PAM_Configuration_Front_Rear");
  //write("PAM_Configuration_Front_Rear");
  
    sysSetVariableInt(sysvar::SysVar_PROXI::DIAG_ProxiLesen,1);
    testWaitForTimeout (200);
    sysSetVariableInt(sysvar::SysVar_PROXI::DIAG_ProxiLesen,0);
    testWaitForTimeout (200);
    sysSetVariableInt(sysvar::SysVar_PROXI::pByte118Bit45,PAM_Configuration_Front_Rear);		
    sysSetVariableInt(sysvar::SysVar_PROXI::DIAG_eLoadAll,1);
    testWaitForTimeout (200);
    sysSetVariableInt(sysvar::SysVar_PROXI::DIAG_eLoadAll,0);
testWaitForTimeout (2000);
    sysSetVariableInt(sysvar::SysVar_PROXI::DIAG_eSendProxi,1);
    testWaitForTimeout (200);
    sysSetVariableInt(sysvar::SysVar_PROXI::DIAG_eSendProxi,0);
    testWaitForTimeout (200);
				
}

	export testfunction Passengers_Knee_Bag_Present ()
{
  testModuleTitle("Passengers_Knee_Bag_Present");
  //write("Passengers_Knee_Bag_Present");
  
    sysSetVariableInt(sysvar::SysVar_PROXI::DIAG_ProxiLesen,1);
    testWaitForTimeout (200);
    sysSetVariableInt(sysvar::SysVar_PROXI::DIAG_ProxiLesen,0);
    testWaitForTimeout (200);
    sysSetVariableInt(sysvar::SysVar_PROXI::pByte118Bit45,Passengers_Knee_Bag_Present);		
    sysSetVariableInt(sysvar::SysVar_PROXI::DIAG_eLoadAll,1);
    testWaitForTimeout (200);
    sysSetVariableInt(sysvar::SysVar_PROXI::DIAG_eLoadAll,0);
testWaitForTimeout (2000);
    sysSetVariableInt(sysvar::SysVar_PROXI::DIAG_eSendProxi,1);
    testWaitForTimeout (200);
    sysSetVariableInt(sysvar::SysVar_PROXI::DIAG_eSendProxi,0);
    testWaitForTimeout (200);
				
}

export testfunction Passengers_Knee_Bag_Absent ()
{
  testModuleTitle("Passengers_Knee_Bag_Absent");
  //write("Passengers_Knee_Bag_Absent");
  
    sysSetVariableInt(sysvar::SysVar_PROXI::DIAG_ProxiLesen,1);
    testWaitForTimeout (200);
    sysSetVariableInt(sysvar::SysVar_PROXI::DIAG_ProxiLesen,0);
    testWaitForTimeout (200);
    sysSetVariableInt(sysvar::SysVar_PROXI::pByte118Bit45,Passengers_Knee_Bag_Absent);		
    sysSetVariableInt(sysvar::SysVar_PROXI::DIAG_eLoadAll,1);
    testWaitForTimeout (200);
    sysSetVariableInt(sysvar::SysVar_PROXI::DIAG_eLoadAll,0);
testWaitForTimeout (2000);
    sysSetVariableInt(sysvar::SysVar_PROXI::DIAG_eSendProxi,1);
    testWaitForTimeout (200);
    sysSetVariableInt(sysvar::SysVar_PROXI::DIAG_eSendProxi,0);
    testWaitForTimeout (200);
				
}

	export testfunction Passive_Entry_Menu_Present ()
{
  testModuleTitle("Passive_Entry_Menu_Present");
  //write("Passive_Entry_Menu_Present");
  
    sysSetVariableInt(sysvar::SysVar_PROXI::DIAG_ProxiLesen,1);
    testWaitForTimeout (200);
    sysSetVariableInt(sysvar::SysVar_PROXI::DIAG_ProxiLesen,0);
    testWaitForTimeout (200);
    sysSetVariableInt(sysvar::SysVar_PROXI::pByte132Bit0,Passive_Entry_Menu_Present);		
    sysSetVariableInt(sysvar::SysVar_PROXI::DIAG_eLoadAll,1);
    testWaitForTimeout (200);
    sysSetVariableInt(sysvar::SysVar_PROXI::DIAG_eLoadAll,0);
testWaitForTimeout (2000);
    sysSetVariableInt(sysvar::SysVar_PROXI::DIAG_eSendProxi,1);
    testWaitForTimeout (200);
    sysSetVariableInt(sysvar::SysVar_PROXI::DIAG_eSendProxi,0);
    testWaitForTimeout (200);
				
}

export testfunction Passive_Entry_Menu_Absent ()
{
  testModuleTitle("Passive_Entry_Menu_Absent");
  //write("Passive_Entry_Menu_Absent");
  
    sysSetVariableInt(sysvar::SysVar_PROXI::DIAG_ProxiLesen,1);
    testWaitForTimeout (200);
    sysSetVariableInt(sysvar::SysVar_PROXI::DIAG_ProxiLesen,0);
    testWaitForTimeout (200);
    sysSetVariableInt(sysvar::SysVar_PROXI::pByte132Bit0,Passive_Entry_Menu_Absent);		
    sysSetVariableInt(sysvar::SysVar_PROXI::DIAG_eLoadAll,1);
    testWaitForTimeout (200);
    sysSetVariableInt(sysvar::SysVar_PROXI::DIAG_eLoadAll,0);
testWaitForTimeout (2000);
    sysSetVariableInt(sysvar::SysVar_PROXI::DIAG_eSendProxi,1);
    testWaitForTimeout (200);
    sysSetVariableInt(sysvar::SysVar_PROXI::DIAG_eSendProxi,0);
    testWaitForTimeout (200);
				
}

	export testfunction Rain_Sensor_Present ()
{
  testModuleTitle("Rain_Sensor_Present");
  //write("Rain_Sensor_Present");
  
    sysSetVariableInt(sysvar::SysVar_PROXI::DIAG_ProxiLesen,1);
    testWaitForTimeout (200);
    sysSetVariableInt(sysvar::SysVar_PROXI::DIAG_ProxiLesen,0);
    testWaitForTimeout (200);
    sysSetVariableInt(sysvar::SysVar_PROXI::pByte60Bit0,Rain_Sensor_Present);		
    sysSetVariableInt(sysvar::SysVar_PROXI::DIAG_eLoadAll,1);
    testWaitForTimeout (200);
    sysSetVariableInt(sysvar::SysVar_PROXI::DIAG_eLoadAll,0);
testWaitForTimeout (2000);
    sysSetVariableInt(sysvar::SysVar_PROXI::DIAG_eSendProxi,1);
    testWaitForTimeout (200);
    sysSetVariableInt(sysvar::SysVar_PROXI::DIAG_eSendProxi,0);
    testWaitForTimeout (200);
				
}

export testfunction Rain_Sensor_Absent ()
{
  testModuleTitle("Rain_Sensor_Absent");
  //write("Rain_Sensor_Absent");
  
    sysSetVariableInt(sysvar::SysVar_PROXI::DIAG_ProxiLesen,1);
    testWaitForTimeout (200);
    sysSetVariableInt(sysvar::SysVar_PROXI::DIAG_ProxiLesen,0);
    testWaitForTimeout (200);
    sysSetVariableInt(sysvar::SysVar_PROXI::pByte60Bit0,Rain_Sensor_Absent);		
    sysSetVariableInt(sysvar::SysVar_PROXI::DIAG_eLoadAll,1);
    testWaitForTimeout (200);
    sysSetVariableInt(sysvar::SysVar_PROXI::DIAG_eLoadAll,0);
testWaitForTimeout (2000);
    sysSetVariableInt(sysvar::SysVar_PROXI::DIAG_eSendProxi,1);
    testWaitForTimeout (200);
    sysSetVariableInt(sysvar::SysVar_PROXI::DIAG_eSendProxi,0);
    testWaitForTimeout (200);
				
}

	export testfunction Remote_start_Present ()
{
  testModuleTitle("Remote_start_Present");
  //write("Remote_start_Present");
  
    sysSetVariableInt(sysvar::SysVar_PROXI::DIAG_ProxiLesen,1);
    testWaitForTimeout (200);
    sysSetVariableInt(sysvar::SysVar_PROXI::DIAG_ProxiLesen,0);
    testWaitForTimeout (200);
    sysSetVariableInt(sysvar::SysVar_PROXI::pByte108Bit0,Remote_start_Present);		
    sysSetVariableInt(sysvar::SysVar_PROXI::DIAG_eLoadAll,1);
    testWaitForTimeout (200);
    sysSetVariableInt(sysvar::SysVar_PROXI::DIAG_eLoadAll,0);
testWaitForTimeout (2000);
    sysSetVariableInt(sysvar::SysVar_PROXI::DIAG_eSendProxi,1);
    testWaitForTimeout (200);
    sysSetVariableInt(sysvar::SysVar_PROXI::DIAG_eSendProxi,0);
    testWaitForTimeout (200);
				
}

export testfunction Remote_start_Absent ()
{
  testModuleTitle("Remote_start_Absent");
  //write("Remote_start_Absent");
  
    sysSetVariableInt(sysvar::SysVar_PROXI::DIAG_ProxiLesen,1);
    testWaitForTimeout (200);
    sysSetVariableInt(sysvar::SysVar_PROXI::DIAG_ProxiLesen,0);
    testWaitForTimeout (200);
    sysSetVariableInt(sysvar::SysVar_PROXI::pByte108Bit0,Remote_start_Absent);		
    sysSetVariableInt(sysvar::SysVar_PROXI::DIAG_eLoadAll,1);
    testWaitForTimeout (200);
    sysSetVariableInt(sysvar::SysVar_PROXI::DIAG_eLoadAll,0);
testWaitForTimeout (2000);
    sysSetVariableInt(sysvar::SysVar_PROXI::DIAG_eSendProxi,1);
    testWaitForTimeout (200);
    sysSetVariableInt(sysvar::SysVar_PROXI::DIAG_eSendProxi,0);
    testWaitForTimeout (200);
				
}

	export testfunction Right_Seat_Bag_Present ()
{
  testModuleTitle("Right_Seat_Bag_Present");
  //write("Right_Seat_Bag_Present");
  
    sysSetVariableInt(sysvar::SysVar_PROXI::DIAG_ProxiLesen,1);
    testWaitForTimeout (200);
    sysSetVariableInt(sysvar::SysVar_PROXI::DIAG_ProxiLesen,0);
    testWaitForTimeout (200);
    sysSetVariableInt(sysvar::SysVar_PROXI::pByte80Bit1,Right_Seat_Bag_Present);		
    sysSetVariableInt(sysvar::SysVar_PROXI::DIAG_eLoadAll,1);
    testWaitForTimeout (200);
    sysSetVariableInt(sysvar::SysVar_PROXI::DIAG_eLoadAll,0);
testWaitForTimeout (2000);
    sysSetVariableInt(sysvar::SysVar_PROXI::DIAG_eSendProxi,1);
    testWaitForTimeout (200);
    sysSetVariableInt(sysvar::SysVar_PROXI::DIAG_eSendProxi,0);
    testWaitForTimeout (200);
				
}

export testfunction Right_Seat_Bag_Absent ()
{
  testModuleTitle("Right_Seat_Bag_Absent");
  //write("Right_Seat_Bag_Absent");
  
    sysSetVariableInt(sysvar::SysVar_PROXI::DIAG_ProxiLesen,1);
    testWaitForTimeout (200);
    sysSetVariableInt(sysvar::SysVar_PROXI::DIAG_ProxiLesen,0);
    testWaitForTimeout (200);
    sysSetVariableInt(sysvar::SysVar_PROXI::pByte80Bit1,Right_Seat_Bag_Absent);		
    sysSetVariableInt(sysvar::SysVar_PROXI::DIAG_eLoadAll,1);
    testWaitForTimeout (200);
    sysSetVariableInt(sysvar::SysVar_PROXI::DIAG_eLoadAll,0);
testWaitForTimeout (2000);
    sysSetVariableInt(sysvar::SysVar_PROXI::DIAG_eSendProxi,1);
    testWaitForTimeout (200);
    sysSetVariableInt(sysvar::SysVar_PROXI::DIAG_eSendProxi,0);
    testWaitForTimeout (200);
				
}

	
	export testfunction SBR_Logic_NHSTA ()
{
  testModuleTitle("SBR_Logic_NHSTA");
  //write("SBR_Logic_NHSTA");
  
    sysSetVariableInt(sysvar::SysVar_PROXI::DIAG_ProxiLesen,1);
    testWaitForTimeout (200);
    sysSetVariableInt(sysvar::SysVar_PROXI::DIAG_ProxiLesen,0);
    testWaitForTimeout (200);
    sysSetVariableInt(sysvar::SysVar_PROXI::pByte80Bit4,SBR_Logic_NHSTA);		
    sysSetVariableInt(sysvar::SysVar_PROXI::DIAG_eLoadAll,1);
    testWaitForTimeout (200);
    sysSetVariableInt(sysvar::SysVar_PROXI::DIAG_eLoadAll,0);
testWaitForTimeout (2000);
    sysSetVariableInt(sysvar::SysVar_PROXI::DIAG_eSendProxi,1);
    testWaitForTimeout (200);
    sysSetVariableInt(sysvar::SysVar_PROXI::DIAG_eSendProxi,0);
    testWaitForTimeout (200);
				
}

export testfunction SBR_Logic_Europe_others ()
{
  testModuleTitle("SBR_Logic_Europe_others");
  //write("SBR_Logic_Europe_others");
  
    sysSetVariableInt(sysvar::SysVar_PROXI::DIAG_ProxiLesen,1);
    testWaitForTimeout (200);
    sysSetVariableInt(sysvar::SysVar_PROXI::DIAG_ProxiLesen,0);
    testWaitForTimeout (200);
    sysSetVariableInt(sysvar::SysVar_PROXI::pByte80Bit4,SBR_Logic_Europe_others);		
    sysSetVariableInt(sysvar::SysVar_PROXI::DIAG_eLoadAll,1);
    testWaitForTimeout (200);
    sysSetVariableInt(sysvar::SysVar_PROXI::DIAG_eLoadAll,0);
testWaitForTimeout (2000);
    sysSetVariableInt(sysvar::SysVar_PROXI::DIAG_eSendProxi,1);
    testWaitForTimeout (200);
    sysSetVariableInt(sysvar::SysVar_PROXI::DIAG_eSendProxi,0);
    testWaitForTimeout (200);
				
}

	
	export testfunction Semi_Automatic_Parking_System_Present ()
{
  testModuleTitle("Semi_Automatic_Parking_System_Present");
  //write("Semi_Automatic_Parking_System_Present");
  
    sysSetVariableInt(sysvar::SysVar_PROXI::DIAG_ProxiLesen,1);
    testWaitForTimeout (200);
    sysSetVariableInt(sysvar::SysVar_PROXI::DIAG_ProxiLesen,0);
    testWaitForTimeout (200);
    sysSetVariableInt(sysvar::SysVar_PROXI::pByte104Bit3,Semi_Automatic_Parking_System_Present);		
    sysSetVariableInt(sysvar::SysVar_PROXI::DIAG_eLoadAll,1);
    testWaitForTimeout (200);
    sysSetVariableInt(sysvar::SysVar_PROXI::DIAG_eLoadAll,0);
testWaitForTimeout (2000);
    sysSetVariableInt(sysvar::SysVar_PROXI::DIAG_eSendProxi,1);
    testWaitForTimeout (200);
    sysSetVariableInt(sysvar::SysVar_PROXI::DIAG_eSendProxi,0);
    testWaitForTimeout (200);
				
}

export testfunction Semi_Automatic_Parking_System_Absent ()
{
  testModuleTitle("Semi_Automatic_Parking_System_Absent");
  //write("Semi_Automatic_Parking_System_Absent");
  
    sysSetVariableInt(sysvar::SysVar_PROXI::DIAG_ProxiLesen,1);
    testWaitForTimeout (200);
    sysSetVariableInt(sysvar::SysVar_PROXI::DIAG_ProxiLesen,0);
    testWaitForTimeout (200);
    sysSetVariableInt(sysvar::SysVar_PROXI::pByte104Bit3,Semi_Automatic_Parking_System_Absent);		
    sysSetVariableInt(sysvar::SysVar_PROXI::DIAG_eLoadAll,1);
    testWaitForTimeout (200);
    sysSetVariableInt(sysvar::SysVar_PROXI::DIAG_eLoadAll,0);
testWaitForTimeout (2000);
    sysSetVariableInt(sysvar::SysVar_PROXI::DIAG_eSendProxi,1);
    testWaitForTimeout (200);
    sysSetVariableInt(sysvar::SysVar_PROXI::DIAG_eSendProxi,0);
    testWaitForTimeout (200);
				
}

	
	export testfunction Side_Distance_Warning_Present ()
{
  testModuleTitle("Side Distance Warning_Present");
  //write("Side Distance Warning_Present");
  
    sysSetVariableInt(sysvar::SysVar_PROXI::DIAG_ProxiLesen,1);
    testWaitForTimeout (200);
    sysSetVariableInt(sysvar::SysVar_PROXI::DIAG_ProxiLesen,0);
    testWaitForTimeout (200);
    sysSetVariableInt(sysvar::SysVar_PROXI::pByte86Bit7,Side_Distance_Warning_Present);		
    sysSetVariableInt(sysvar::SysVar_PROXI::DIAG_eLoadAll,1);
    testWaitForTimeout (200);
    sysSetVariableInt(sysvar::SysVar_PROXI::DIAG_eLoadAll,0);
testWaitForTimeout (2000);
    sysSetVariableInt(sysvar::SysVar_PROXI::DIAG_eSendProxi,1);
    testWaitForTimeout (200);
    sysSetVariableInt(sysvar::SysVar_PROXI::DIAG_eSendProxi,0);
    testWaitForTimeout (200);
				
}

export testfunction Side_Distance_Warning_Absent ()
{
  testModuleTitle("Side Distance Warning_Absent");
  //write("Side Distance Warning_Absent");
  
    sysSetVariableInt(sysvar::SysVar_PROXI::DIAG_ProxiLesen,1);
    testWaitForTimeout (200);
    sysSetVariableInt(sysvar::SysVar_PROXI::DIAG_ProxiLesen,0);
    testWaitForTimeout (200);
    sysSetVariableInt(sysvar::SysVar_PROXI::pByte86Bit7,Side_Distance_Warning_Absent);		
    sysSetVariableInt(sysvar::SysVar_PROXI::DIAG_eLoadAll,1);
    testWaitForTimeout (200);
    sysSetVariableInt(sysvar::SysVar_PROXI::DIAG_eLoadAll,0);
testWaitForTimeout (2000);
    sysSetVariableInt(sysvar::SysVar_PROXI::DIAG_eSendProxi,1);
    testWaitForTimeout (200);
    sysSetVariableInt(sysvar::SysVar_PROXI::DIAG_eSendProxi,0);
    testWaitForTimeout (200);
				
}

	
	export testfunction Sound_Horn_Remote_Start_Menu_Present ()
{
  testModuleTitle("Sound_Horn_Remote_Start_Menu_Present");
  //write("Sound_Horn_Remote_Start_Menu_Present");
  
    sysSetVariableInt(sysvar::SysVar_PROXI::DIAG_ProxiLesen,1);
    testWaitForTimeout (200);
    sysSetVariableInt(sysvar::SysVar_PROXI::DIAG_ProxiLesen,0);
    testWaitForTimeout (200);
    sysSetVariableInt(sysvar::SysVar_PROXI::pByte132Bit2,Sound_Horn_Remote_Start_Menu_Present);		
    sysSetVariableInt(sysvar::SysVar_PROXI::DIAG_eLoadAll,1);
    testWaitForTimeout (200);
    sysSetVariableInt(sysvar::SysVar_PROXI::DIAG_eLoadAll,0);
testWaitForTimeout (2000);
    sysSetVariableInt(sysvar::SysVar_PROXI::DIAG_eSendProxi,1);
    testWaitForTimeout (200);
    sysSetVariableInt(sysvar::SysVar_PROXI::DIAG_eSendProxi,0);
    testWaitForTimeout (200);
				
}

export testfunction Sound_Horn_Remote_Start_Menu_Absent ()
{
  testModuleTitle("Sound_Horn_Remote_Start_Menu_Absent");
  //write("Sound_Horn_Remote_Start_Menu_Absent");
  
    sysSetVariableInt(sysvar::SysVar_PROXI::DIAG_ProxiLesen,1);
    testWaitForTimeout (200);
    sysSetVariableInt(sysvar::SysVar_PROXI::DIAG_ProxiLesen,0);
    testWaitForTimeout (200);
    sysSetVariableInt(sysvar::SysVar_PROXI::pByte132Bit2,Sound_Horn_Remote_Start_Menu_Absent);		
    sysSetVariableInt(sysvar::SysVar_PROXI::DIAG_eLoadAll,1);
    testWaitForTimeout (200);
    sysSetVariableInt(sysvar::SysVar_PROXI::DIAG_eLoadAll,0);
testWaitForTimeout (2000);
    sysSetVariableInt(sysvar::SysVar_PROXI::DIAG_eSendProxi,1);
    testWaitForTimeout (200);
    sysSetVariableInt(sysvar::SysVar_PROXI::DIAG_eSendProxi,0);
    testWaitForTimeout (200);
				
}

	
	export testfunction Speed_Limiter_Present ()
{
  testModuleTitle("Speed_Limiter_Present");
  //write("Speed_Limiter_Present");
  
    sysSetVariableInt(sysvar::SysVar_PROXI::DIAG_ProxiLesen,1);
    testWaitForTimeout (200);
    sysSetVariableInt(sysvar::SysVar_PROXI::DIAG_ProxiLesen,0);
    testWaitForTimeout (200);
    sysSetVariableInt(sysvar::SysVar_PROXI::pByte92Bit2,Speed_Limiter_Present);		
    sysSetVariableInt(sysvar::SysVar_PROXI::DIAG_eLoadAll,1);
    testWaitForTimeout (200);
    sysSetVariableInt(sysvar::SysVar_PROXI::DIAG_eLoadAll,0);
testWaitForTimeout (2000);
    sysSetVariableInt(sysvar::SysVar_PROXI::DIAG_eSendProxi,1);
    testWaitForTimeout (200);
    sysSetVariableInt(sysvar::SysVar_PROXI::DIAG_eSendProxi,0);
    testWaitForTimeout (200);
				
}

export testfunction Speed_Limiter_Absent ()
{
  testModuleTitle("Speed_Limiter_Absent");
  //write("Speed_Limiter_Absent");
  
    sysSetVariableInt(sysvar::SysVar_PROXI::DIAG_ProxiLesen,1);
    testWaitForTimeout (200);
    sysSetVariableInt(sysvar::SysVar_PROXI::DIAG_ProxiLesen,0);
    testWaitForTimeout (200);
    sysSetVariableInt(sysvar::SysVar_PROXI::pByte92Bit2,Speed_Limiter_Absent);		
    sysSetVariableInt(sysvar::SysVar_PROXI::DIAG_eLoadAll,1);
    testWaitForTimeout (200);
    sysSetVariableInt(sysvar::SysVar_PROXI::DIAG_eLoadAll,0);
testWaitForTimeout (2000);
    sysSetVariableInt(sysvar::SysVar_PROXI::DIAG_eSendProxi,1);
    testWaitForTimeout (200);
    sysSetVariableInt(sysvar::SysVar_PROXI::DIAG_eSendProxi,0);
    testWaitForTimeout (200);
				
}

	
	export testfunction Stop_And_Start_Present ()
{
  testModuleTitle("Stop_And_Start_Present");
  //write("Stop_And_Start_Present");
  
    sysSetVariableInt(sysvar::SysVar_PROXI::DIAG_ProxiLesen,1);
    testWaitForTimeout (200);
    sysSetVariableInt(sysvar::SysVar_PROXI::DIAG_ProxiLesen,0);
    testWaitForTimeout (200);
    sysSetVariableInt(sysvar::SysVar_PROXI::pByte58Bit0,Stop_And_Start_Present);		
    sysSetVariableInt(sysvar::SysVar_PROXI::DIAG_eLoadAll,1);
    testWaitForTimeout (200);
    sysSetVariableInt(sysvar::SysVar_PROXI::DIAG_eLoadAll,0);
testWaitForTimeout (2000);
    sysSetVariableInt(sysvar::SysVar_PROXI::DIAG_eSendProxi,1);
    testWaitForTimeout (200);
    sysSetVariableInt(sysvar::SysVar_PROXI::DIAG_eSendProxi,0);
    testWaitForTimeout (200);
				
}

export testfunction Stop_And_Start_Absent ()
{
  testModuleTitle("Stop_And_Start_Absent");
  //write("Stop_And_Start_Absent");
  
    sysSetVariableInt(sysvar::SysVar_PROXI::DIAG_ProxiLesen,1);
    testWaitForTimeout (200);
    sysSetVariableInt(sysvar::SysVar_PROXI::DIAG_ProxiLesen,0);
    testWaitForTimeout (200);
    sysSetVariableInt(sysvar::SysVar_PROXI::pByte58Bit0,Stop_And_Start_Absent);		
    sysSetVariableInt(sysvar::SysVar_PROXI::DIAG_eLoadAll,1);
    testWaitForTimeout (200);
    sysSetVariableInt(sysvar::SysVar_PROXI::DIAG_eLoadAll,0);
testWaitForTimeout (2000);
    sysSetVariableInt(sysvar::SysVar_PROXI::DIAG_eSendProxi,1);
    testWaitForTimeout (200);
    sysSetVariableInt(sysvar::SysVar_PROXI::DIAG_eSendProxi,0);
    testWaitForTimeout (200);
				
}
export testfunction TPMS_Variant_Base ()
{
  testModuleTitle("TPMS_Variant_Base");
  //write("TPMS_Variant_Base");
  
    sysSetVariableInt(sysvar::SysVar_PROXI::DIAG_ProxiLesen,1);
    testWaitForTimeout (200);
    sysSetVariableInt(sysvar::SysVar_PROXI::DIAG_ProxiLesen,0);
    testWaitForTimeout (200);
    sysSetVariableInt(sysvar::SysVar_PROXI::pByte62Bit3,TPMS_Variant_Base);		
    sysSetVariableInt(sysvar::SysVar_PROXI::DIAG_eLoadAll,1);
    testWaitForTimeout (200);
    sysSetVariableInt(sysvar::SysVar_PROXI::DIAG_eLoadAll,0);
testWaitForTimeout (2000);
    sysSetVariableInt(sysvar::SysVar_PROXI::DIAG_eSendProxi,1);
    testWaitForTimeout (200);
    sysSetVariableInt(sysvar::SysVar_PROXI::DIAG_eSendProxi,0);
    testWaitForTimeout (200);
				
}

export testfunction TPMS_Variant_Premium ()
{
  testModuleTitle("TPMS_Variant_Premium");
  //write("TPMS_Variant_Premium");
  
    sysSetVariableInt(sysvar::SysVar_PROXI::DIAG_ProxiLesen,1);
    testWaitForTimeout (200);
    sysSetVariableInt(sysvar::SysVar_PROXI::DIAG_ProxiLesen,0);
    testWaitForTimeout (200);
    sysSetVariableInt(sysvar::SysVar_PROXI::pByte62Bit3,TPMS_Variant_Premium);		
    sysSetVariableInt(sysvar::SysVar_PROXI::DIAG_eLoadAll,1);
    testWaitForTimeout (200);
    sysSetVariableInt(sysvar::SysVar_PROXI::DIAG_eLoadAll,0);
testWaitForTimeout (2000);
    sysSetVariableInt(sysvar::SysVar_PROXI::DIAG_eSendProxi,1);
    testWaitForTimeout (200);
    sysSetVariableInt(sysvar::SysVar_PROXI::DIAG_eSendProxi,0);
    testWaitForTimeout (200);
				
}

	
	export testfunction Tip_Start_Present ()
{
  testModuleTitle("Tip_Start_Present");
  //write("Tip_Start_Present");
  
    sysSetVariableInt(sysvar::SysVar_PROXI::DIAG_ProxiLesen,1);
    testWaitForTimeout (200);
    sysSetVariableInt(sysvar::SysVar_PROXI::DIAG_ProxiLesen,0);
    testWaitForTimeout (200);
    sysSetVariableInt(sysvar::SysVar_PROXI::pByte108Bit1,Tip_Start_Present);		
    sysSetVariableInt(sysvar::SysVar_PROXI::DIAG_eLoadAll,1);
    testWaitForTimeout (200);
    sysSetVariableInt(sysvar::SysVar_PROXI::DIAG_eLoadAll,0);
testWaitForTimeout (2000);
    sysSetVariableInt(sysvar::SysVar_PROXI::DIAG_eSendProxi,1);
    testWaitForTimeout (200);
    sysSetVariableInt(sysvar::SysVar_PROXI::DIAG_eSendProxi,0);
    testWaitForTimeout (200);
				
}

export testfunction Tip_Start_Absent ()
{
  testModuleTitle("Tip_Start_Absent");
  //write("Tip_Start_Absent");
  
    sysSetVariableInt(sysvar::SysVar_PROXI::DIAG_ProxiLesen,1);
    testWaitForTimeout (200);
    sysSetVariableInt(sysvar::SysVar_PROXI::DIAG_ProxiLesen,0);
    testWaitForTimeout (200);
    sysSetVariableInt(sysvar::SysVar_PROXI::pByte108Bit1,Tip_Start_Absent);		
    sysSetVariableInt(sysvar::SysVar_PROXI::DIAG_eLoadAll,1);
    testWaitForTimeout (200);
    sysSetVariableInt(sysvar::SysVar_PROXI::DIAG_eLoadAll,0);
testWaitForTimeout (2000);
    sysSetVariableInt(sysvar::SysVar_PROXI::DIAG_eSendProxi,1);
    testWaitForTimeout (200);
    sysSetVariableInt(sysvar::SysVar_PROXI::DIAG_eSendProxi,0);
    testWaitForTimeout (200);
				
}

	
	export testfunction Trunk_Door_Present ()
{
  testModuleTitle("Trunk_Door_Present");
  //write("Trunk_Door_Present");
  
    sysSetVariableInt(sysvar::SysVar_PROXI::DIAG_ProxiLesen,1);
    testWaitForTimeout (200);
    sysSetVariableInt(sysvar::SysVar_PROXI::DIAG_ProxiLesen,0);
    testWaitForTimeout (200);
    sysSetVariableInt(sysvar::SysVar_PROXI::pByte69Bit2,Trunk_Door_Present);		
    sysSetVariableInt(sysvar::SysVar_PROXI::DIAG_eLoadAll,1);
    testWaitForTimeout (200);
    sysSetVariableInt(sysvar::SysVar_PROXI::DIAG_eLoadAll,0);
testWaitForTimeout (2000);
    sysSetVariableInt(sysvar::SysVar_PROXI::DIAG_eSendProxi,1);
    testWaitForTimeout (200);
    sysSetVariableInt(sysvar::SysVar_PROXI::DIAG_eSendProxi,0);
    testWaitForTimeout (200);
				
}

export testfunction Trunk_Door_Absent ()
{
  testModuleTitle("Trunk_Door_Absent");
  //write("Trunk_Door_Absent");
  
    sysSetVariableInt(sysvar::SysVar_PROXI::DIAG_ProxiLesen,1);
    testWaitForTimeout (200);
    sysSetVariableInt(sysvar::SysVar_PROXI::DIAG_ProxiLesen,0);
    testWaitForTimeout (200);
    sysSetVariableInt(sysvar::SysVar_PROXI::pByte69Bit2,Trunk_Door_Absent);		
    sysSetVariableInt(sysvar::SysVar_PROXI::DIAG_eLoadAll,1);
    testWaitForTimeout (200);
    sysSetVariableInt(sysvar::SysVar_PROXI::DIAG_eLoadAll,0);
testWaitForTimeout (2000);
    sysSetVariableInt(sysvar::SysVar_PROXI::DIAG_eSendProxi,1);
    testWaitForTimeout (200);
    sysSetVariableInt(sysvar::SysVar_PROXI::DIAG_eSendProxi,0);
    testWaitForTimeout (200);
				
}

	
	export testfunction Tyre_Pressure_System_Present ()
{
  testModuleTitle("Tyre_Pressure_System_Present");
  //write("Tyre_Pressure_System_Present");
  
    sysSetVariableInt(sysvar::SysVar_PROXI::DIAG_ProxiLesen,1);
    testWaitForTimeout (200);
    sysSetVariableInt(sysvar::SysVar_PROXI::DIAG_ProxiLesen,0);
    testWaitForTimeout (200);
    sysSetVariableInt(sysvar::SysVar_PROXI::pByte62Bit2,Tyre_Pressure_System_Present);		
    sysSetVariableInt(sysvar::SysVar_PROXI::DIAG_eLoadAll,1);
    testWaitForTimeout (200);
    sysSetVariableInt(sysvar::SysVar_PROXI::DIAG_eLoadAll,0);
testWaitForTimeout (2000);
    sysSetVariableInt(sysvar::SysVar_PROXI::DIAG_eSendProxi,1);
    testWaitForTimeout (200);
    sysSetVariableInt(sysvar::SysVar_PROXI::DIAG_eSendProxi,0);
    testWaitForTimeout (200);
				
}

export testfunction Tyre_Pressure_System_Absent ()
{
  testModuleTitle("Tyre_Pressure_System_Absent");
  //write("Tyre_Pressure_System_Absent");
  
    sysSetVariableInt(sysvar::SysVar_PROXI::DIAG_ProxiLesen,1);
    testWaitForTimeout (200);
    sysSetVariableInt(sysvar::SysVar_PROXI::DIAG_ProxiLesen,0);
    testWaitForTimeout (200);
    sysSetVariableInt(sysvar::SysVar_PROXI::pByte62Bit2,Tyre_Pressure_System_Absent);		
    sysSetVariableInt(sysvar::SysVar_PROXI::DIAG_eLoadAll,1);
    testWaitForTimeout (200);
    sysSetVariableInt(sysvar::SysVar_PROXI::DIAG_eLoadAll,0);
testWaitForTimeout (2000);
    sysSetVariableInt(sysvar::SysVar_PROXI::DIAG_eSendProxi,1);
    testWaitForTimeout (200);
    sysSetVariableInt(sysvar::SysVar_PROXI::DIAG_eSendProxi,0);
    testWaitForTimeout (200);
				
}

	
	export testfunction Type_Pressure_Unit_Menu_Present ()
{
  testModuleTitle("Type_Pressure_Unit_Menu_Present");
  //write("Type_Pressure_Unit_Menu_Present");
  
    sysSetVariableInt(sysvar::SysVar_PROXI::DIAG_ProxiLesen,1);
    testWaitForTimeout (200);
    sysSetVariableInt(sysvar::SysVar_PROXI::DIAG_ProxiLesen,0);
    testWaitForTimeout (200);
    sysSetVariableInt(sysvar::SysVar_PROXI::pByte133Bit0,Type_Pressure_Unit_Menu_Present);		
    sysSetVariableInt(sysvar::SysVar_PROXI::DIAG_eLoadAll,1);
    testWaitForTimeout (200);
    sysSetVariableInt(sysvar::SysVar_PROXI::DIAG_eLoadAll,0);
testWaitForTimeout (2000);
    sysSetVariableInt(sysvar::SysVar_PROXI::DIAG_eSendProxi,1);
    testWaitForTimeout (200);
    sysSetVariableInt(sysvar::SysVar_PROXI::DIAG_eSendProxi,0);
    testWaitForTimeout (200);
				
}

export testfunction Type_Pressure_Unit_Menu_Absent ()
{
  testModuleTitle("Type_Pressure_Unit_Menu_Absent");
  //write("Type_Pressure_Unit_Menu_Absent");
  
    sysSetVariableInt(sysvar::SysVar_PROXI::DIAG_ProxiLesen,1);
    testWaitForTimeout (200);
    sysSetVariableInt(sysvar::SysVar_PROXI::DIAG_ProxiLesen,0);
    testWaitForTimeout (200);
    sysSetVariableInt(sysvar::SysVar_PROXI::pByte133Bit0,Type_Pressure_Unit_Menu_Absent);		
    sysSetVariableInt(sysvar::SysVar_PROXI::DIAG_eLoadAll,1);
    testWaitForTimeout (200);
    sysSetVariableInt(sysvar::SysVar_PROXI::DIAG_eLoadAll,0);
testWaitForTimeout (2000);
    sysSetVariableInt(sysvar::SysVar_PROXI::DIAG_eSendProxi,1);
    testWaitForTimeout (200);
    sysSetVariableInt(sysvar::SysVar_PROXI::DIAG_eSendProxi,0);
    testWaitForTimeout (200);
				
}

	
	export testfunction Twilight_Sensor_Present ()
{
  testModuleTitle("Twilight_Sensor_Present");
  //write("Twilight_Sensor_Present");
  
    sysSetVariableInt(sysvar::SysVar_PROXI::DIAG_ProxiLesen,1);
    testWaitForTimeout (200);
    sysSetVariableInt(sysvar::SysVar_PROXI::DIAG_ProxiLesen,0);
    testWaitForTimeout (200);
    sysSetVariableInt(sysvar::SysVar_PROXI::pByte108Bit2,Twilight_Sensor_Present);		
    sysSetVariableInt(sysvar::SysVar_PROXI::DIAG_eLoadAll,1);
    testWaitForTimeout (200);
    sysSetVariableInt(sysvar::SysVar_PROXI::DIAG_eLoadAll,0);
testWaitForTimeout (2000);
    sysSetVariableInt(sysvar::SysVar_PROXI::DIAG_eSendProxi,1);
    testWaitForTimeout (200);
    sysSetVariableInt(sysvar::SysVar_PROXI::DIAG_eSendProxi,0);
    testWaitForTimeout (200);
				
}

export testfunction Twilight_Sensor_Absent ()
{
  testModuleTitle("Twilight_Sensor_Absent");
  //write("Twilight_Sensor_Absent");
  
    sysSetVariableInt(sysvar::SysVar_PROXI::DIAG_ProxiLesen,1);
    testWaitForTimeout (200);
    sysSetVariableInt(sysvar::SysVar_PROXI::DIAG_ProxiLesen,0);
    testWaitForTimeout (200);
    sysSetVariableInt(sysvar::SysVar_PROXI::pByte108Bit2,Twilight_Sensor_Absent);		
    sysSetVariableInt(sysvar::SysVar_PROXI::DIAG_eLoadAll,1);
    testWaitForTimeout (200);
    sysSetVariableInt(sysvar::SysVar_PROXI::DIAG_eLoadAll,0);
testWaitForTimeout (2000);
    sysSetVariableInt(sysvar::SysVar_PROXI::DIAG_eSendProxi,1);
    testWaitForTimeout (200);
    sysSetVariableInt(sysvar::SysVar_PROXI::DIAG_eSendProxi,0);
    testWaitForTimeout (200);
				
}

	
	export testfunction Ultrasonic_Sensor_Present ()
{
  testModuleTitle("Ultrasonic_Sensor_Present");
  //write("Ultrasonic_Sensor_Present");
  
    sysSetVariableInt(sysvar::SysVar_PROXI::DIAG_ProxiLesen,1);
    testWaitForTimeout (200);
    sysSetVariableInt(sysvar::SysVar_PROXI::DIAG_ProxiLesen,0);
    testWaitForTimeout (200);
    sysSetVariableInt(sysvar::SysVar_PROXI::pByte70Bit4,Ultrasonic_Sensor_Present);		
    sysSetVariableInt(sysvar::SysVar_PROXI::DIAG_eLoadAll,1);
    testWaitForTimeout (200);
    sysSetVariableInt(sysvar::SysVar_PROXI::DIAG_eLoadAll,0);
testWaitForTimeout (2000);
    sysSetVariableInt(sysvar::SysVar_PROXI::DIAG_eSendProxi,1);
    testWaitForTimeout (200);
    sysSetVariableInt(sysvar::SysVar_PROXI::DIAG_eSendProxi,0);
    testWaitForTimeout (200);
				
}

export testfunction Ultrasonic_Sensor_Absent ()
{
  testModuleTitle("Ultrasonic_Sensor_Absent");
  //write("Ultrasonic_Sensor_Absent");
  
    sysSetVariableInt(sysvar::SysVar_PROXI::DIAG_ProxiLesen,1);
    testWaitForTimeout (200);
    sysSetVariableInt(sysvar::SysVar_PROXI::DIAG_ProxiLesen,0);
    testWaitForTimeout (200);
    sysSetVariableInt(sysvar::SysVar_PROXI::pByte70Bit4,Ultrasonic_Sensor_Absent);		
    sysSetVariableInt(sysvar::SysVar_PROXI::DIAG_eLoadAll,1);
    testWaitForTimeout (200);
    sysSetVariableInt(sysvar::SysVar_PROXI::DIAG_eLoadAll,0);
testWaitForTimeout (2000);
    sysSetVariableInt(sysvar::SysVar_PROXI::DIAG_eSendProxi,1);
    testWaitForTimeout (200);
    sysSetVariableInt(sysvar::SysVar_PROXI::DIAG_eSendProxi,0);
    testWaitForTimeout (200);
				
}

	
	export testfunction Welcome_Movement_Present ()
{
  testModuleTitle("Welcome_Movement_Present");
  //write("Welcome_Movement_Present");
  
    sysSetVariableInt(sysvar::SysVar_PROXI::DIAG_ProxiLesen,1);
    testWaitForTimeout (200);
    sysSetVariableInt(sysvar::SysVar_PROXI::DIAG_ProxiLesen,0);
    testWaitForTimeout (200);
    sysSetVariableInt(sysvar::SysVar_PROXI::pByte137Bit0,Welcome_Movement_Present);		
    sysSetVariableInt(sysvar::SysVar_PROXI::DIAG_eLoadAll,1);
    testWaitForTimeout (200);
    sysSetVariableInt(sysvar::SysVar_PROXI::DIAG_eLoadAll,0);
testWaitForTimeout (2000);
    sysSetVariableInt(sysvar::SysVar_PROXI::DIAG_eSendProxi,1);
    testWaitForTimeout (200);
    sysSetVariableInt(sysvar::SysVar_PROXI::DIAG_eSendProxi,0);
    testWaitForTimeout (200);
				
}

export testfunction Welcome_Movement_Absent ()
{
  testModuleTitle("Welcome_Movement_Absent");
  //write("Welcome_Movement_Absent");
  
    sysSetVariableInt(sysvar::SysVar_PROXI::DIAG_ProxiLesen,1);
    testWaitForTimeout (200);
    sysSetVariableInt(sysvar::SysVar_PROXI::DIAG_ProxiLesen,0);
    testWaitForTimeout (200);
    sysSetVariableInt(sysvar::SysVar_PROXI::pByte137Bit0,Welcome_Movement_Absent);		
    sysSetVariableInt(sysvar::SysVar_PROXI::DIAG_eLoadAll,1);
    testWaitForTimeout (200);
    sysSetVariableInt(sysvar::SysVar_PROXI::DIAG_eLoadAll,0);
testWaitForTimeout (2000);
    sysSetVariableInt(sysvar::SysVar_PROXI::DIAG_eSendProxi,1);
    testWaitForTimeout (200);
    sysSetVariableInt(sysvar::SysVar_PROXI::DIAG_eSendProxi,0);
    testWaitForTimeout (200);
				
}

	
	export testfunction Adaptive_Cruise_Control_Absent ()
{
  testModuleTitle("Adaptive_Cruise_Control_Absent");
  //write("Adaptive_Cruise_Control_Absent");
  
    sysSetVariableInt(sysvar::SysVar_PROXI::DIAG_ProxiLesen,1);
    testWaitForTimeout (200);
    sysSetVariableInt(sysvar::SysVar_PROXI::DIAG_ProxiLesen,0);
    testWaitForTimeout (200);
    sysSetVariableInt(sysvar::SysVar_PROXI::pByte86Bit12,Adaptive_Cruise_Control_Absent);		
    sysSetVariableInt(sysvar::SysVar_PROXI::DIAG_eLoadAll,1);
    testWaitForTimeout (200);
    sysSetVariableInt(sysvar::SysVar_PROXI::DIAG_eLoadAll,0);
testWaitForTimeout (2000);
    sysSetVariableInt(sysvar::SysVar_PROXI::DIAG_eSendProxi,1);
    testWaitForTimeout (200);
    sysSetVariableInt(sysvar::SysVar_PROXI::DIAG_eSendProxi,0);
    testWaitForTimeout (200);
				
}

	
	export testfunction Adaptive_Cruise_Control_ACC ()
{
  testModuleTitle("Adaptive_Cruise_Control_ACC");
  //write("Adaptive_Cruise_Control_ACC");
  
    sysSetVariableInt(sysvar::SysVar_PROXI::DIAG_ProxiLesen,1);
    testWaitForTimeout (200);
    sysSetVariableInt(sysvar::SysVar_PROXI::DIAG_ProxiLesen,0);
    testWaitForTimeout (200);
    sysSetVariableInt(sysvar::SysVar_PROXI::pByte86Bit12,Adaptive_Cruise_Control_ACC);		
    sysSetVariableInt(sysvar::SysVar_PROXI::DIAG_eLoadAll,1);
    testWaitForTimeout (200);
    sysSetVariableInt(sysvar::SysVar_PROXI::DIAG_eLoadAll,0);
testWaitForTimeout (2000);
    sysSetVariableInt(sysvar::SysVar_PROXI::DIAG_eSendProxi,1);
    testWaitForTimeout (200);
    sysSetVariableInt(sysvar::SysVar_PROXI::DIAG_eSendProxi,0);
    testWaitForTimeout (200);
				
}

	
	export testfunction Adaptive_Cruise_Control_ACC_Plus ()
{
  testModuleTitle("Adaptive_Cruise_Control_ACC_Plus");
  //write("Adaptive_Cruise_Control_ACC_Plus");
  
    sysSetVariableInt(sysvar::SysVar_PROXI::DIAG_ProxiLesen,1);
    testWaitForTimeout (200);
    sysSetVariableInt(sysvar::SysVar_PROXI::DIAG_ProxiLesen,0);
    testWaitForTimeout (200);
    sysSetVariableInt(sysvar::SysVar_PROXI::pByte86Bit12,Adaptive_Cruise_Control_ACC_Plus);		
    sysSetVariableInt(sysvar::SysVar_PROXI::DIAG_eLoadAll,1);
    testWaitForTimeout (200);
    sysSetVariableInt(sysvar::SysVar_PROXI::DIAG_eLoadAll,0);
testWaitForTimeout (2000);
    sysSetVariableInt(sysvar::SysVar_PROXI::DIAG_eSendProxi,1);
    testWaitForTimeout (200);
    sysSetVariableInt(sysvar::SysVar_PROXI::DIAG_eSendProxi,0);
    testWaitForTimeout (200);
				
}

	
	export testfunction Additional_Languages_Default ()
{
  testModuleTitle("Additional_Languages_Default");
  //write("Additional_Languages_Default");
  
    sysSetVariableInt(sysvar::SysVar_PROXI::DIAG_ProxiLesen,1);
    testWaitForTimeout (200);
    sysSetVariableInt(sysvar::SysVar_PROXI::DIAG_ProxiLesen,0);
    testWaitForTimeout (200);
    sysSetVariableInt(sysvar::SysVar_PROXI::pByte120,Additional_Languages_Default);		
    sysSetVariableInt(sysvar::SysVar_PROXI::DIAG_eLoadAll,1);
    testWaitForTimeout (200);
    sysSetVariableInt(sysvar::SysVar_PROXI::DIAG_eLoadAll,0);
testWaitForTimeout (2000);
    sysSetVariableInt(sysvar::SysVar_PROXI::DIAG_eSendProxi,1);
    testWaitForTimeout (200);
    sysSetVariableInt(sysvar::SysVar_PROXI::DIAG_eSendProxi,0);
    testWaitForTimeout (200);
				
}

	
	export testfunction Additional_Languages_Default_Russian ()
{
  testModuleTitle("Additional_Languages_Default_Russian");
  //write("Additional_Languages_Default_Russian");
  
    sysSetVariableInt(sysvar::SysVar_PROXI::DIAG_ProxiLesen,1);
    testWaitForTimeout (200);
    sysSetVariableInt(sysvar::SysVar_PROXI::DIAG_ProxiLesen,0);
    testWaitForTimeout (200);
    sysSetVariableInt(sysvar::SysVar_PROXI::pByte120,Additional_Languages_Default_Russian);		
    sysSetVariableInt(sysvar::SysVar_PROXI::DIAG_eLoadAll,1);
    testWaitForTimeout (200);
    sysSetVariableInt(sysvar::SysVar_PROXI::DIAG_eLoadAll,0);
testWaitForTimeout (2000);
    sysSetVariableInt(sysvar::SysVar_PROXI::DIAG_eSendProxi,1);
    testWaitForTimeout (200);
    sysSetVariableInt(sysvar::SysVar_PROXI::DIAG_eSendProxi,0);
    testWaitForTimeout (200);
				
}

	
	export testfunction Additional_Languages_Default_Brazilian ()
{
  testModuleTitle("Additional_Languages_Default_Brazilian");
  //write("Additional_Languages_Default_Brazilian");
  
    sysSetVariableInt(sysvar::SysVar_PROXI::DIAG_ProxiLesen,1);
    testWaitForTimeout (200);
    sysSetVariableInt(sysvar::SysVar_PROXI::DIAG_ProxiLesen,0);
    testWaitForTimeout (200);
    sysSetVariableInt(sysvar::SysVar_PROXI::pByte120,Additional_Languages_Default_Brazilian);		
    sysSetVariableInt(sysvar::SysVar_PROXI::DIAG_eLoadAll,1);
    testWaitForTimeout (200);
    sysSetVariableInt(sysvar::SysVar_PROXI::DIAG_eLoadAll,0);
testWaitForTimeout (2000);
    sysSetVariableInt(sysvar::SysVar_PROXI::DIAG_eSendProxi,1);
    testWaitForTimeout (200);
    sysSetVariableInt(sysvar::SysVar_PROXI::DIAG_eSendProxi,0);
    testWaitForTimeout (200);
				
}

	
	export testfunction Additional_Languages_Default_Russian_Brazilian ()
{
  testModuleTitle("Additional_Languages_Default_Russian_Brazilian");
  //write("Additional_Languages_Default_Russian_Brazilian");
  
    sysSetVariableInt(sysvar::SysVar_PROXI::DIAG_ProxiLesen,1);
    testWaitForTimeout (200);
    sysSetVariableInt(sysvar::SysVar_PROXI::DIAG_ProxiLesen,0);
    testWaitForTimeout (200);
    sysSetVariableInt(sysvar::SysVar_PROXI::pByte120,Additional_Languages_Default_Russian_Brazilian);		
    sysSetVariableInt(sysvar::SysVar_PROXI::DIAG_eLoadAll,1);
    testWaitForTimeout (200);
    sysSetVariableInt(sysvar::SysVar_PROXI::DIAG_eLoadAll,0);
testWaitForTimeout (2000);
    sysSetVariableInt(sysvar::SysVar_PROXI::DIAG_eSendProxi,1);
    testWaitForTimeout (200);
    sysSetVariableInt(sysvar::SysVar_PROXI::DIAG_eSendProxi,0);
    testWaitForTimeout (200);
				
}

	export testfunction Cluster_Display_Type_No_Display_Available ()
{
  testModuleTitle("Cluster_Display_Type_No_Display_Available");
  //write("Cluster_Display_Type_No_Display_Available");
  
    sysSetVariableInt(sysvar::SysVar_PROXI::DIAG_ProxiLesen,1);
    testWaitForTimeout (200);
    sysSetVariableInt(sysvar::SysVar_PROXI::DIAG_ProxiLesen,0);
    testWaitForTimeout (200);
    sysSetVariableInt(sysvar::SysVar_PROXI::pByte111Bit456,Cluster_Display_Type_No_Display_Available);		
    sysSetVariableInt(sysvar::SysVar_PROXI::DIAG_eLoadAll,1);
    testWaitForTimeout (200);
    sysSetVariableInt(sysvar::SysVar_PROXI::DIAG_eLoadAll,0);
testWaitForTimeout (2000);
    sysSetVariableInt(sysvar::SysVar_PROXI::DIAG_eSendProxi,1);
    testWaitForTimeout (200);
    sysSetVariableInt(sysvar::SysVar_PROXI::DIAG_eSendProxi,0);
    testWaitForTimeout (200);
				
}
	
	export testfunction Cluster_Display_Type_Base_Display ()
{
  testModuleTitle("Cluster_Display_Type_Base_Display");
  //write("Cluster_Display_Type_Base_Display");
  
    sysSetVariableInt(sysvar::SysVar_PROXI::DIAG_ProxiLesen,1);
    testWaitForTimeout (200);
    sysSetVariableInt(sysvar::SysVar_PROXI::DIAG_ProxiLesen,0);
    testWaitForTimeout (200);
    sysSetVariableInt(sysvar::SysVar_PROXI::pByte111Bit456,Cluster_Display_Type_Base_Display);		
    sysSetVariableInt(sysvar::SysVar_PROXI::DIAG_eLoadAll,1);
    testWaitForTimeout (200);
    sysSetVariableInt(sysvar::SysVar_PROXI::DIAG_eLoadAll,0);
testWaitForTimeout (2000);
    sysSetVariableInt(sysvar::SysVar_PROXI::DIAG_eSendProxi,1);
    testWaitForTimeout (200);
    sysSetVariableInt(sysvar::SysVar_PROXI::DIAG_eSendProxi,0);
    testWaitForTimeout (200);
				
}

	
	export testfunction Cluster_Display_Type_Medium_Display ()
{
  testModuleTitle("Cluster_Display_Type_Medium_Display");
  //write("Cluster_Display_Type_Medium_Display");
  
    sysSetVariableInt(sysvar::SysVar_PROXI::DIAG_ProxiLesen,1);
    testWaitForTimeout (200);
    sysSetVariableInt(sysvar::SysVar_PROXI::DIAG_ProxiLesen,0);
    testWaitForTimeout (200);
    sysSetVariableInt(sysvar::SysVar_PROXI::pByte111Bit456,Cluster_Display_Type_Medium_Display
);		
    sysSetVariableInt(sysvar::SysVar_PROXI::DIAG_eLoadAll,1);
    testWaitForTimeout (200);
    sysSetVariableInt(sysvar::SysVar_PROXI::DIAG_eLoadAll,0);
testWaitForTimeout (2000);
    sysSetVariableInt(sysvar::SysVar_PROXI::DIAG_eSendProxi,1);
    testWaitForTimeout (200);
    sysSetVariableInt(sysvar::SysVar_PROXI::DIAG_eSendProxi,0);
    testWaitForTimeout (200);
				
}

	
	export testfunction Cluster_Display_Type_High_Display()
{
  testModuleTitle("Cluster_Display_Type_High_Display");
  //write("Cluster_Display_Type_High_Display");
  
    sysSetVariableInt(sysvar::SysVar_PROXI::DIAG_ProxiLesen,1);
    testWaitForTimeout (200);
    sysSetVariableInt(sysvar::SysVar_PROXI::DIAG_ProxiLesen,0);
    testWaitForTimeout (200);
    sysSetVariableInt(sysvar::SysVar_PROXI::pByte111Bit456,Cluster_Display_Type_High_Display
);		
    sysSetVariableInt(sysvar::SysVar_PROXI::DIAG_eLoadAll,1);
    testWaitForTimeout (200);
    sysSetVariableInt(sysvar::SysVar_PROXI::DIAG_eLoadAll,0);
testWaitForTimeout (2000);
    sysSetVariableInt(sysvar::SysVar_PROXI::DIAG_eSendProxi,1);
    testWaitForTimeout (200);
    sysSetVariableInt(sysvar::SysVar_PROXI::DIAG_eSendProxi,0);
    testWaitForTimeout (200);
				
}

	
	export testfunction Cluster_Display_Type_TFT_BW_Display()
{
  testModuleTitle("Cluster_Display_Type_TFT_BW_Display");
  //write("Cluster_Display_Type_TFT_BW_Display");
  
    sysSetVariableInt(sysvar::SysVar_PROXI::DIAG_ProxiLesen,1);
    testWaitForTimeout (200);
    sysSetVariableInt(sysvar::SysVar_PROXI::DIAG_ProxiLesen,0);
    testWaitForTimeout (200);
    sysSetVariableInt(sysvar::SysVar_PROXI::pByte111Bit456,Cluster_Display_Type_TFT_BW_Display
);		
    sysSetVariableInt(sysvar::SysVar_PROXI::DIAG_eLoadAll,1);
    testWaitForTimeout (200);
    sysSetVariableInt(sysvar::SysVar_PROXI::DIAG_eLoadAll,0);
testWaitForTimeout (2000);
    sysSetVariableInt(sysvar::SysVar_PROXI::DIAG_eSendProxi,1);
    testWaitForTimeout (200);
    sysSetVariableInt(sysvar::SysVar_PROXI::DIAG_eSendProxi,0);
    testWaitForTimeout (200);
				
}

	
	export testfunction Cluster_Display_Type_TFT_Color_display()
{
  testModuleTitle("Cluster_Display_Type_TFT_Color_display");
  //write("Cluster_Display_Type_TFT_Color_display");
  
    sysSetVariableInt(sysvar::SysVar_PROXI::DIAG_ProxiLesen,1);
    testWaitForTimeout (200);
    sysSetVariableInt(sysvar::SysVar_PROXI::DIAG_ProxiLesen,0);
    testWaitForTimeout (200);
    sysSetVariableInt(sysvar::SysVar_PROXI::pByte111Bit456,Cluster_Display_Type_TFT_Color_display
);		
    sysSetVariableInt(sysvar::SysVar_PROXI::DIAG_eLoadAll,1);
    testWaitForTimeout (200);
    sysSetVariableInt(sysvar::SysVar_PROXI::DIAG_eLoadAll,0);
testWaitForTimeout (2000);
    sysSetVariableInt(sysvar::SysVar_PROXI::DIAG_eSendProxi,1);
    testWaitForTimeout (200);
    sysSetVariableInt(sysvar::SysVar_PROXI::DIAG_eSendProxi,0);
    testWaitForTimeout (200);
				
}

	
	export testfunction Compass_Display_Absent ()
{
  testModuleTitle("Compass_Display_Absent");
  //write("Compass_Display_Absent");
  
    sysSetVariableInt(sysvar::SysVar_PROXI::DIAG_ProxiLesen,1);
    testWaitForTimeout (200);
    sysSetVariableInt(sysvar::SysVar_PROXI::DIAG_ProxiLesen,0);
    testWaitForTimeout (200);
    sysSetVariableInt(sysvar::SysVar_PROXI::pByte121Bit01,Compass_Display_Absent);		
    sysSetVariableInt(sysvar::SysVar_PROXI::DIAG_eLoadAll,1);
    testWaitForTimeout (200);
    sysSetVariableInt(sysvar::SysVar_PROXI::DIAG_eLoadAll,0);
testWaitForTimeout (2000);
    sysSetVariableInt(sysvar::SysVar_PROXI::DIAG_eSendProxi,1);
    testWaitForTimeout (200);
    sysSetVariableInt(sysvar::SysVar_PROXI::DIAG_eSendProxi,0);
    testWaitForTimeout (200);
				
}

	
	export testfunction Compass_Display_Present_on_VP ()
{
  testModuleTitle("Compass_Display_Present_on_VP");
  //write("Compass_Display_Present_on_VP");
  
    sysSetVariableInt(sysvar::SysVar_PROXI::DIAG_ProxiLesen,1);
    testWaitForTimeout (200);
    sysSetVariableInt(sysvar::SysVar_PROXI::DIAG_ProxiLesen,0);
    testWaitForTimeout (200);
    sysSetVariableInt(sysvar::SysVar_PROXI::pByte121Bit01,Compass_Display_Present_on_VP);		
    sysSetVariableInt(sysvar::SysVar_PROXI::DIAG_eLoadAll,1);
    testWaitForTimeout (200);
    sysSetVariableInt(sysvar::SysVar_PROXI::DIAG_eLoadAll,0);
testWaitForTimeout (2000);
    sysSetVariableInt(sysvar::SysVar_PROXI::DIAG_eSendProxi,1);
    testWaitForTimeout (200);
    sysSetVariableInt(sysvar::SysVar_PROXI::DIAG_eSendProxi,0);
    testWaitForTimeout (200);
				
}

	
	export testfunction Compass_Display_Present_on_IPC ()
{
  testModuleTitle("Compass_Display_Present_on_IPC");
  //write("Compass_Display_Present_on_IPC");
  
    sysSetVariableInt(sysvar::SysVar_PROXI::DIAG_ProxiLesen,1);
    testWaitForTimeout (200);
    sysSetVariableInt(sysvar::SysVar_PROXI::DIAG_ProxiLesen,0);
    testWaitForTimeout (200);
    sysSetVariableInt(sysvar::SysVar_PROXI::pByte121Bit01,Compass_Display_Present_on_IPC);		
    sysSetVariableInt(sysvar::SysVar_PROXI::DIAG_eLoadAll,1);
    testWaitForTimeout (200);
    sysSetVariableInt(sysvar::SysVar_PROXI::DIAG_eLoadAll,0);
testWaitForTimeout (2000);
    sysSetVariableInt(sysvar::SysVar_PROXI::DIAG_eSendProxi,1);
    testWaitForTimeout (200);
    sysSetVariableInt(sysvar::SysVar_PROXI::DIAG_eSendProxi,0);
    testWaitForTimeout (200);
				
}

	
	export testfunction Compass_Display_Present_on_IPC_and_VP ()
{
  testModuleTitle("Compass_Display_Present_on_IPC_and_VP");
  //write("Compass_Display_Present_on_IPC_and_VP");
  
    sysSetVariableInt(sysvar::SysVar_PROXI::DIAG_ProxiLesen,1);
    testWaitForTimeout (200);
    sysSetVariableInt(sysvar::SysVar_PROXI::DIAG_ProxiLesen,0);
    testWaitForTimeout (200);
    sysSetVariableInt(sysvar::SysVar_PROXI::pByte121Bit01,Compass_Display_Present_on_IPC_and_VP);		
    sysSetVariableInt(sysvar::SysVar_PROXI::DIAG_eLoadAll,1);
    testWaitForTimeout (200);
    sysSetVariableInt(sysvar::SysVar_PROXI::DIAG_eLoadAll,0);
testWaitForTimeout (2000);
    sysSetVariableInt(sysvar::SysVar_PROXI::DIAG_eSendProxi,1);
    testWaitForTimeout (200);
    sysSetVariableInt(sysvar::SysVar_PROXI::DIAG_eSendProxi,0);
    testWaitForTimeout (200);
				
}

	
	export testfunction Country_Code_World ()
{
  testModuleTitle("Country_Code_World");
  //write("Country_Code_World");
  
    sysSetVariableInt(sysvar::SysVar_PROXI::DIAG_ProxiLesen,1);
    testWaitForTimeout (200);
    sysSetVariableInt(sysvar::SysVar_PROXI::DIAG_ProxiLesen,0);
    testWaitForTimeout (200);
    sysSetVariableInt(sysvar::SysVar_PROXI::pByte107,Country_Code_World);		
    sysSetVariableInt(sysvar::SysVar_PROXI::DIAG_eLoadAll,1);
    testWaitForTimeout (200);
    sysSetVariableInt(sysvar::SysVar_PROXI::DIAG_eLoadAll,0);
testWaitForTimeout (2000);
    sysSetVariableInt(sysvar::SysVar_PROXI::DIAG_eSendProxi,1);
    testWaitForTimeout (200);
    sysSetVariableInt(sysvar::SysVar_PROXI::DIAG_eSendProxi,0);
    testWaitForTimeout (200);
				
}

	export testfunction Country_Code_United_States_of_America ()
{
  testModuleTitle("Country_Code_United_States_of_America");
  //write("Country_Code_United_States_of_America");
  
    sysSetVariableInt(sysvar::SysVar_PROXI::DIAG_ProxiLesen,1);
    testWaitForTimeout (200);
    sysSetVariableInt(sysvar::SysVar_PROXI::DIAG_ProxiLesen,0);
    testWaitForTimeout (200);
    sysSetVariableInt(sysvar::SysVar_PROXI::pByte107,Country_Code_United_States_of_America);		
    sysSetVariableInt(sysvar::SysVar_PROXI::DIAG_eLoadAll,1);
    testWaitForTimeout (200);
    sysSetVariableInt(sysvar::SysVar_PROXI::DIAG_eLoadAll,0);
testWaitForTimeout (2000);
    sysSetVariableInt(sysvar::SysVar_PROXI::DIAG_eSendProxi,1);
    testWaitForTimeout (200);
    sysSetVariableInt(sysvar::SysVar_PROXI::DIAG_eSendProxi,0);
    testWaitForTimeout (200);
				
}

	
	export testfunction Country_Code_Canada ()
{
  testModuleTitle("Country_Code_Canada");
  //write("Country_Code_Canada");
  
    sysSetVariableInt(sysvar::SysVar_PROXI::DIAG_ProxiLesen,1);
    testWaitForTimeout (200);
    sysSetVariableInt(sysvar::SysVar_PROXI::DIAG_ProxiLesen,0);
    testWaitForTimeout (200);
    sysSetVariableInt(sysvar::SysVar_PROXI::pByte107,Country_Code_Canada);		
    sysSetVariableInt(sysvar::SysVar_PROXI::DIAG_eLoadAll,1);
    testWaitForTimeout (200);
    sysSetVariableInt(sysvar::SysVar_PROXI::DIAG_eLoadAll,0);
testWaitForTimeout (2000);
    sysSetVariableInt(sysvar::SysVar_PROXI::DIAG_eSendProxi,1);
    testWaitForTimeout (200);
    sysSetVariableInt(sysvar::SysVar_PROXI::DIAG_eSendProxi,0);
    testWaitForTimeout (200);
				
}

	
	export testfunction Country_Code_United_Kingdom ()
{
  testModuleTitle("Country_Code_United_Kingdom");
  //write("Country_Code_United_Kingdom");
  
    sysSetVariableInt(sysvar::SysVar_PROXI::DIAG_ProxiLesen,1);
    testWaitForTimeout (200);
    sysSetVariableInt(sysvar::SysVar_PROXI::DIAG_ProxiLesen,0);
    testWaitForTimeout (200);
    sysSetVariableInt(sysvar::SysVar_PROXI::pByte107,Country_Code_United_Kingdom);		
    sysSetVariableInt(sysvar::SysVar_PROXI::DIAG_eLoadAll,1);
    testWaitForTimeout (200);
    sysSetVariableInt(sysvar::SysVar_PROXI::DIAG_eLoadAll,0);
testWaitForTimeout (2000);
    sysSetVariableInt(sysvar::SysVar_PROXI::DIAG_eSendProxi,1);
    testWaitForTimeout (200);
    sysSetVariableInt(sysvar::SysVar_PROXI::DIAG_eSendProxi,0);
    testWaitForTimeout (200);
				
}
	
	export testfunction Country_Code_Japan ()
{
  testModuleTitle("Country_Code_Japan");
  //write("Country_Code_Japan");
  
    sysSetVariableInt(sysvar::SysVar_PROXI::DIAG_ProxiLesen,1);
    testWaitForTimeout (200);
    sysSetVariableInt(sysvar::SysVar_PROXI::DIAG_ProxiLesen,0);
    testWaitForTimeout (200);
    sysSetVariableInt(sysvar::SysVar_PROXI::pByte107,Country_Code_Japan);		
    sysSetVariableInt(sysvar::SysVar_PROXI::DIAG_eLoadAll,1);
    testWaitForTimeout (200);
    sysSetVariableInt(sysvar::SysVar_PROXI::DIAG_eLoadAll,0);
testWaitForTimeout (2000);
    sysSetVariableInt(sysvar::SysVar_PROXI::DIAG_eSendProxi,1);
    testWaitForTimeout (200);
    sysSetVariableInt(sysvar::SysVar_PROXI::DIAG_eSendProxi,0);
    testWaitForTimeout (200);
				
}

	
	export testfunction Country_Code_Mexico ()
{
  testModuleTitle("Country_Code_Mexico");
  //write("Country_Code_Mexico");
  
    sysSetVariableInt(sysvar::SysVar_PROXI::DIAG_ProxiLesen,1);
    testWaitForTimeout (200);
    sysSetVariableInt(sysvar::SysVar_PROXI::DIAG_ProxiLesen,0);
    testWaitForTimeout (200);
    sysSetVariableInt(sysvar::SysVar_PROXI::pByte107,Country_Code_Mexico);		
    sysSetVariableInt(sysvar::SysVar_PROXI::DIAG_eLoadAll,1);
    testWaitForTimeout (200);
    sysSetVariableInt(sysvar::SysVar_PROXI::DIAG_eLoadAll,0);
testWaitForTimeout (2000);
    sysSetVariableInt(sysvar::SysVar_PROXI::DIAG_eSendProxi,1);
    testWaitForTimeout (200);
    sysSetVariableInt(sysvar::SysVar_PROXI::DIAG_eSendProxi,0);
    testWaitForTimeout (200);
				
}

	
		
	export testfunction Country_Code_Brazil ()
{
  testModuleTitle("Country_Code_Brazil");
  //write("Country_Code_Brazil");
  
    sysSetVariableInt(sysvar::SysVar_PROXI::DIAG_ProxiLesen,1);
    testWaitForTimeout (200);
    sysSetVariableInt(sysvar::SysVar_PROXI::DIAG_ProxiLesen,0);
    testWaitForTimeout (200);
    sysSetVariableInt(sysvar::SysVar_PROXI::pByte107,Country_Code_Brazil);		
    sysSetVariableInt(sysvar::SysVar_PROXI::DIAG_eLoadAll,1);
    testWaitForTimeout (200);
    sysSetVariableInt(sysvar::SysVar_PROXI::DIAG_eLoadAll,0);
testWaitForTimeout (2000);
    sysSetVariableInt(sysvar::SysVar_PROXI::DIAG_eSendProxi,1);
    testWaitForTimeout (200);
    sysSetVariableInt(sysvar::SysVar_PROXI::DIAG_eSendProxi,0);
    testWaitForTimeout (200);
				
}

	
	export testfunction Country_Code_Chile ()
{
  testModuleTitle("Country_Code_Chile");
  //write("Country_Code_Chile");
  
    sysSetVariableInt(sysvar::SysVar_PROXI::DIAG_ProxiLesen,1);
    testWaitForTimeout (200);
    sysSetVariableInt(sysvar::SysVar_PROXI::DIAG_ProxiLesen,0);
    testWaitForTimeout (200);
    sysSetVariableInt(sysvar::SysVar_PROXI::pByte107,Country_Code_Chile);		
    sysSetVariableInt(sysvar::SysVar_PROXI::DIAG_eLoadAll,1);
    testWaitForTimeout (200);
    sysSetVariableInt(sysvar::SysVar_PROXI::DIAG_eLoadAll,0);
testWaitForTimeout (2000);
    sysSetVariableInt(sysvar::SysVar_PROXI::DIAG_eSendProxi,1);
    testWaitForTimeout (200);
    sysSetVariableInt(sysvar::SysVar_PROXI::DIAG_eSendProxi,0);
    testWaitForTimeout (200);
				
}

	
	export testfunction Country_Code_Colombia ()
{
  testModuleTitle("Country_Code_Colombia");
  //write("Country_Code_Colombia");
  
    sysSetVariableInt(sysvar::SysVar_PROXI::DIAG_ProxiLesen,1);
    testWaitForTimeout (200);
    sysSetVariableInt(sysvar::SysVar_PROXI::DIAG_ProxiLesen,0);
    testWaitForTimeout (200);
    sysSetVariableInt(sysvar::SysVar_PROXI::pByte107,Country_Code_Colombia);		
    sysSetVariableInt(sysvar::SysVar_PROXI::DIAG_eLoadAll,1);
    testWaitForTimeout (200);
    sysSetVariableInt(sysvar::SysVar_PROXI::DIAG_eLoadAll,0);
testWaitForTimeout (2000);
    sysSetVariableInt(sysvar::SysVar_PROXI::DIAG_eSendProxi,1);
    testWaitForTimeout (200);
    sysSetVariableInt(sysvar::SysVar_PROXI::DIAG_eSendProxi,0);
    testWaitForTimeout (200);
				
}

	
	export testfunction Country_Code_France ()
{
  testModuleTitle("Country_Code_France");
  //write("Country_Code_France");
  
    sysSetVariableInt(sysvar::SysVar_PROXI::DIAG_ProxiLesen,1);
    testWaitForTimeout (200);
    sysSetVariableInt(sysvar::SysVar_PROXI::DIAG_ProxiLesen,0);
    testWaitForTimeout (200);
    sysSetVariableInt(sysvar::SysVar_PROXI::pByte107,Country_Code_France);		
    sysSetVariableInt(sysvar::SysVar_PROXI::DIAG_eLoadAll,1);
    testWaitForTimeout (200);
    sysSetVariableInt(sysvar::SysVar_PROXI::DIAG_eLoadAll,0);
testWaitForTimeout (2000);
    sysSetVariableInt(sysvar::SysVar_PROXI::DIAG_eSendProxi,1);
    testWaitForTimeout (200);
    sysSetVariableInt(sysvar::SysVar_PROXI::DIAG_eSendProxi,0);
    testWaitForTimeout (200);
				
}

	
	export testfunction Country_Code_India ()
{
  testModuleTitle("Country_Code_India");
  //write("Country_Code_India");
  
    sysSetVariableInt(sysvar::SysVar_PROXI::DIAG_ProxiLesen,1);
    testWaitForTimeout (200);
    sysSetVariableInt(sysvar::SysVar_PROXI::DIAG_ProxiLesen,0);
    testWaitForTimeout (200);
    sysSetVariableInt(sysvar::SysVar_PROXI::pByte107,Country_Code_India);		
    sysSetVariableInt(sysvar::SysVar_PROXI::DIAG_eLoadAll,1);
    testWaitForTimeout (200);
    sysSetVariableInt(sysvar::SysVar_PROXI::DIAG_eLoadAll,0);
testWaitForTimeout (2000);
    sysSetVariableInt(sysvar::SysVar_PROXI::DIAG_eSendProxi,1);
    testWaitForTimeout (200);
    sysSetVariableInt(sysvar::SysVar_PROXI::DIAG_eSendProxi,0);
    testWaitForTimeout (200);
				
}

	
	export testfunction Country_Code_Italy ()
{
  testModuleTitle("Country_Code_Italy");
  //write("Country_Code_Italy");
  
    sysSetVariableInt(sysvar::SysVar_PROXI::DIAG_ProxiLesen,1);
    testWaitForTimeout (200);
    sysSetVariableInt(sysvar::SysVar_PROXI::DIAG_ProxiLesen,0);
    testWaitForTimeout (200);
    sysSetVariableInt(sysvar::SysVar_PROXI::pByte107,Country_Code_Italy);		
    sysSetVariableInt(sysvar::SysVar_PROXI::DIAG_eLoadAll,1);
    testWaitForTimeout (200);
    sysSetVariableInt(sysvar::SysVar_PROXI::DIAG_eLoadAll,0);
testWaitForTimeout (2000);
    sysSetVariableInt(sysvar::SysVar_PROXI::DIAG_eSendProxi,1);
    testWaitForTimeout (200);
    sysSetVariableInt(sysvar::SysVar_PROXI::DIAG_eSendProxi,0);
    testWaitForTimeout (200);
				
}
	
	export testfunction Country_Code_Paraguay ()
{
  testModuleTitle("Country_Code_Paraguay");
  //write("Country_Code_Paraguay");
  
    sysSetVariableInt(sysvar::SysVar_PROXI::DIAG_ProxiLesen,1);
    testWaitForTimeout (200);
    sysSetVariableInt(sysvar::SysVar_PROXI::DIAG_ProxiLesen,0);
    testWaitForTimeout (200);
    sysSetVariableInt(sysvar::SysVar_PROXI::pByte107,Country_Code_Paraguay);		
    sysSetVariableInt(sysvar::SysVar_PROXI::DIAG_eLoadAll,1);
    testWaitForTimeout (200);
    sysSetVariableInt(sysvar::SysVar_PROXI::DIAG_eLoadAll,0);
testWaitForTimeout (2000);
    sysSetVariableInt(sysvar::SysVar_PROXI::DIAG_eSendProxi,1);
    testWaitForTimeout (200);
    sysSetVariableInt(sysvar::SysVar_PROXI::DIAG_eSendProxi,0);
    testWaitForTimeout (200);
				
}
	
	export testfunction Country_Code_Peru ()
{
  testModuleTitle("Country_Code_Peru");
  //write("Country_Code_Peru");
  
    sysSetVariableInt(sysvar::SysVar_PROXI::DIAG_ProxiLesen,1);
    testWaitForTimeout (200);
    sysSetVariableInt(sysvar::SysVar_PROXI::DIAG_ProxiLesen,0);
    testWaitForTimeout (200);
    sysSetVariableInt(sysvar::SysVar_PROXI::pByte107,Country_Code_Peru);		
    sysSetVariableInt(sysvar::SysVar_PROXI::DIAG_eLoadAll,1);
    testWaitForTimeout (200);
    sysSetVariableInt(sysvar::SysVar_PROXI::DIAG_eLoadAll,0);
testWaitForTimeout (2000);
    sysSetVariableInt(sysvar::SysVar_PROXI::DIAG_eSendProxi,1);
    testWaitForTimeout (200);
    sysSetVariableInt(sysvar::SysVar_PROXI::DIAG_eSendProxi,0);
    testWaitForTimeout (200);
				
}

	
	export testfunction Country_Code_South_Africa ()
{
  testModuleTitle("Country_Code_South_Africa");
  //write("Country_Code_South_Africa");
  
    sysSetVariableInt(sysvar::SysVar_PROXI::DIAG_ProxiLesen,1);
    testWaitForTimeout (200);
    sysSetVariableInt(sysvar::SysVar_PROXI::DIAG_ProxiLesen,0);
    testWaitForTimeout (200);
    sysSetVariableInt(sysvar::SysVar_PROXI::pByte107,Country_Code_South_Africa);		
    sysSetVariableInt(sysvar::SysVar_PROXI::DIAG_eLoadAll,1);
    testWaitForTimeout (200);
    sysSetVariableInt(sysvar::SysVar_PROXI::DIAG_eLoadAll,0);
testWaitForTimeout (2000);
    sysSetVariableInt(sysvar::SysVar_PROXI::DIAG_eSendProxi,1);
    testWaitForTimeout (200);
    sysSetVariableInt(sysvar::SysVar_PROXI::DIAG_eSendProxi,0);
    testWaitForTimeout (200);
				
}

	
	export testfunction Country_Code_Turkey ()
{
  testModuleTitle("Country_Code_Turkey");
  //write("Country_Code_Turkey");
  
    sysSetVariableInt(sysvar::SysVar_PROXI::DIAG_ProxiLesen,1);
    testWaitForTimeout (200);
    sysSetVariableInt(sysvar::SysVar_PROXI::DIAG_ProxiLesen,0);
    testWaitForTimeout (200);
    sysSetVariableInt(sysvar::SysVar_PROXI::pByte107,Country_Code_Turkey);		
    sysSetVariableInt(sysvar::SysVar_PROXI::DIAG_eLoadAll,1);
    testWaitForTimeout (200);
    sysSetVariableInt(sysvar::SysVar_PROXI::DIAG_eLoadAll,0);
testWaitForTimeout (2000);
    sysSetVariableInt(sysvar::SysVar_PROXI::DIAG_eSendProxi,1);
    testWaitForTimeout (200);
    sysSetVariableInt(sysvar::SysVar_PROXI::DIAG_eSendProxi,0);
    testWaitForTimeout (200);
				
}

	
	export testfunction Country_Code_Argentina ()
{
  testModuleTitle("Country_Code_Argentina");
  //write("Country_Code_Argentina");
  
    sysSetVariableInt(sysvar::SysVar_PROXI::DIAG_ProxiLesen,1);
    testWaitForTimeout (200);
    sysSetVariableInt(sysvar::SysVar_PROXI::DIAG_ProxiLesen,0);
    testWaitForTimeout (200);
    sysSetVariableInt(sysvar::SysVar_PROXI::pByte107,Country_Code_Argentina);		
    sysSetVariableInt(sysvar::SysVar_PROXI::DIAG_eLoadAll,1);
    testWaitForTimeout (200);
    sysSetVariableInt(sysvar::SysVar_PROXI::DIAG_eLoadAll,0);
testWaitForTimeout (2000);
    sysSetVariableInt(sysvar::SysVar_PROXI::DIAG_eSendProxi,1);
    testWaitForTimeout (200);
    sysSetVariableInt(sysvar::SysVar_PROXI::DIAG_eSendProxi,0);
    testWaitForTimeout (200);
				
}
	
	export testfunction Country_Code_China_Mainland ()
{
  testModuleTitle("Country_Code_China_Mainland");
  //write("Country_Code_China_Mainland");
  
    sysSetVariableInt(sysvar::SysVar_PROXI::DIAG_ProxiLesen,1);
    testWaitForTimeout (200);
    sysSetVariableInt(sysvar::SysVar_PROXI::DIAG_ProxiLesen,0);
    testWaitForTimeout (200);
    sysSetVariableInt(sysvar::SysVar_PROXI::pByte107,Country_Code_China_Mainland);		
    sysSetVariableInt(sysvar::SysVar_PROXI::DIAG_eLoadAll,1);
    testWaitForTimeout (200);
    sysSetVariableInt(sysvar::SysVar_PROXI::DIAG_eLoadAll,0);
testWaitForTimeout (2000);
    sysSetVariableInt(sysvar::SysVar_PROXI::DIAG_eSendProxi,1);
    testWaitForTimeout (200);
    sysSetVariableInt(sysvar::SysVar_PROXI::DIAG_eSendProxi,0);
    testWaitForTimeout (200);
				
}

	export testfunction Country_Code_Belgium ()
{
  testModuleTitle("Country_Code_Belgium");
  //write("Country_Code_Belgium");
  
    sysSetVariableInt(sysvar::SysVar_PROXI::DIAG_ProxiLesen,1);
    testWaitForTimeout (200);
    sysSetVariableInt(sysvar::SysVar_PROXI::DIAG_ProxiLesen,0);
    testWaitForTimeout (200);
    sysSetVariableInt(sysvar::SysVar_PROXI::pByte107,Country_Code_Belgium);		
    sysSetVariableInt(sysvar::SysVar_PROXI::DIAG_eLoadAll,1);
    testWaitForTimeout (200);
    sysSetVariableInt(sysvar::SysVar_PROXI::DIAG_eLoadAll,0);
testWaitForTimeout (2000);
    sysSetVariableInt(sysvar::SysVar_PROXI::DIAG_eSendProxi,1);
    testWaitForTimeout (200);
    sysSetVariableInt(sysvar::SysVar_PROXI::DIAG_eSendProxi,0);
    testWaitForTimeout (200);
				
}

	export testfunction Country_Code_Netherlands ()
{
  testModuleTitle("Country_Code_Netherlands");
  //write("Country_Code_Netherlands");
  
    sysSetVariableInt(sysvar::SysVar_PROXI::DIAG_ProxiLesen,1);
    testWaitForTimeout (200);
    sysSetVariableInt(sysvar::SysVar_PROXI::DIAG_ProxiLesen,0);
    testWaitForTimeout (200);
    sysSetVariableInt(sysvar::SysVar_PROXI::pByte107,Country_Code_Netherlands);		
    sysSetVariableInt(sysvar::SysVar_PROXI::DIAG_eLoadAll,1);
    testWaitForTimeout (200);
    sysSetVariableInt(sysvar::SysVar_PROXI::DIAG_eLoadAll,0);
testWaitForTimeout (2000);
    sysSetVariableInt(sysvar::SysVar_PROXI::DIAG_eSendProxi,1);
    testWaitForTimeout (200);
    sysSetVariableInt(sysvar::SysVar_PROXI::DIAG_eSendProxi,0);
    testWaitForTimeout (200);
				
}
	
	export testfunction Country_Code_Uruguai ()
{
  testModuleTitle("Country_Code_Uruguai");
  //write("Country_Code_Uruguai");
  
    sysSetVariableInt(sysvar::SysVar_PROXI::DIAG_ProxiLesen,1);
    testWaitForTimeout (200);
    sysSetVariableInt(sysvar::SysVar_PROXI::DIAG_ProxiLesen,0);
    testWaitForTimeout (200);
    sysSetVariableInt(sysvar::SysVar_PROXI::pByte107,Country_Code_Uruguai);		
    sysSetVariableInt(sysvar::SysVar_PROXI::DIAG_eLoadAll,1);
    testWaitForTimeout (200);
    sysSetVariableInt(sysvar::SysVar_PROXI::DIAG_eLoadAll,0);
testWaitForTimeout (2000);
    sysSetVariableInt(sysvar::SysVar_PROXI::DIAG_eSendProxi,1);
    testWaitForTimeout (200);
    sysSetVariableInt(sysvar::SysVar_PROXI::DIAG_eSendProxi,0);
    testWaitForTimeout (200);
				
}
	
	export testfunction Dimming_Level_Selector_Type_Absent ()
{
  testModuleTitle("Dimming_Level_Selector_Type_Absent");
  //write("Dimming_Level_Selector_Type_Absent");
  
    sysSetVariableInt(sysvar::SysVar_PROXI::DIAG_ProxiLesen,1);
    testWaitForTimeout (200);
    sysSetVariableInt(sysvar::SysVar_PROXI::DIAG_ProxiLesen,0);
    testWaitForTimeout (200);
    sysSetVariableInt(sysvar::SysVar_PROXI::pByte141Bit567,Dimming_Level_Selector_Type_Absent);		
    sysSetVariableInt(sysvar::SysVar_PROXI::DIAG_eLoadAll,1);
    testWaitForTimeout (200);
    sysSetVariableInt(sysvar::SysVar_PROXI::DIAG_eLoadAll,0);
testWaitForTimeout (2000);
    sysSetVariableInt(sysvar::SysVar_PROXI::DIAG_eSendProxi,1);
    testWaitForTimeout (200);
    sysSetVariableInt(sysvar::SysVar_PROXI::DIAG_eSendProxi,0);
    testWaitForTimeout (200);
				
}

	
	export testfunction Dimming_Level_Selector_Type_Eight_Levels ()
{
  testModuleTitle("Dimming_Level_Selector_Type_Eight_Levels");
  //write("Dimming_Level_Selector_Type_Eight_Levels");
  
    sysSetVariableInt(sysvar::SysVar_PROXI::DIAG_ProxiLesen,1);
    testWaitForTimeout (200);
    sysSetVariableInt(sysvar::SysVar_PROXI::DIAG_ProxiLesen,0);
    testWaitForTimeout (200);
    sysSetVariableInt(sysvar::SysVar_PROXI::pByte141Bit567,Dimming_Level_Selector_Type_Eight_Levels);		
    sysSetVariableInt(sysvar::SysVar_PROXI::DIAG_eLoadAll,1);
    testWaitForTimeout (200);
    sysSetVariableInt(sysvar::SysVar_PROXI::DIAG_eLoadAll,0);
testWaitForTimeout (2000);
    sysSetVariableInt(sysvar::SysVar_PROXI::DIAG_eSendProxi,1);
    testWaitForTimeout (200);
    sysSetVariableInt(sysvar::SysVar_PROXI::DIAG_eSendProxi,0);
    testWaitForTimeout (200);
				
}

	
	export testfunction Dimming_Level_Selector_Type_Nine_Levels ()
{
  testModuleTitle("Dimming_Level_Selector_Type_Nine_Levels");
  //write("Dimming_Level_Selector_Type_Nine_Levels");
  
    sysSetVariableInt(sysvar::SysVar_PROXI::DIAG_ProxiLesen,1);
    testWaitForTimeout (200);
    sysSetVariableInt(sysvar::SysVar_PROXI::DIAG_ProxiLesen,0);
    testWaitForTimeout (200);
    sysSetVariableInt(sysvar::SysVar_PROXI::pByte141Bit567,Dimming_Level_Selector_Type_Nine_Levels);		
    sysSetVariableInt(sysvar::SysVar_PROXI::DIAG_eLoadAll,1);
    testWaitForTimeout (200);
    sysSetVariableInt(sysvar::SysVar_PROXI::DIAG_eLoadAll,0);
testWaitForTimeout (2000);
    sysSetVariableInt(sysvar::SysVar_PROXI::DIAG_eSendProxi,1);
    testWaitForTimeout (200);
    sysSetVariableInt(sysvar::SysVar_PROXI::DIAG_eSendProxi,0);
    testWaitForTimeout (200);
				
}

export testfunction Drive_Style_Selector_Absent ()
{
  testModuleTitle("Drive_Style_Selector_Absent");
  //write("Drive_Style_Selector_Absent");
  
    sysSetVariableInt(sysvar::SysVar_PROXI::DIAG_ProxiLesen,1);
    testWaitForTimeout (200);
    sysSetVariableInt(sysvar::SysVar_PROXI::DIAG_ProxiLesen,0);
    testWaitForTimeout (200);
    sysSetVariableInt(sysvar::SysVar_PROXI::pByte88Bit56,Drive_Style_Selector_Absent);		
    sysSetVariableInt(sysvar::SysVar_PROXI::DIAG_eLoadAll,1);
    testWaitForTimeout (200);
    sysSetVariableInt(sysvar::SysVar_PROXI::DIAG_eLoadAll,0);
testWaitForTimeout (2000);
    sysSetVariableInt(sysvar::SysVar_PROXI::DIAG_eSendProxi,1);
    testWaitForTimeout (200);
    sysSetVariableInt(sysvar::SysVar_PROXI::DIAG_eSendProxi,0);
    testWaitForTimeout (200);
				
}
	
	export testfunction Drive_Style_Selector_Drive_Selector()
{
  testModuleTitle("Drive_Style_Selector_Drive_Selector");
  //write("Drive_Style_Selector_Drive_Selector");
  
    sysSetVariableInt(sysvar::SysVar_PROXI::DIAG_ProxiLesen,1);
    testWaitForTimeout (200);
    sysSetVariableInt(sysvar::SysVar_PROXI::DIAG_ProxiLesen,0);
    testWaitForTimeout (200);
    sysSetVariableInt(sysvar::SysVar_PROXI::pByte88Bit56,Drive_Style_Selector_Drive_Selector);		
    sysSetVariableInt(sysvar::SysVar_PROXI::DIAG_eLoadAll,1);
    testWaitForTimeout (200);
    sysSetVariableInt(sysvar::SysVar_PROXI::DIAG_eLoadAll,0);
testWaitForTimeout (2000);
    sysSetVariableInt(sysvar::SysVar_PROXI::DIAG_eSendProxi,1);
    testWaitForTimeout (200);
    sysSetVariableInt(sysvar::SysVar_PROXI::DIAG_eSendProxi,0);
    testWaitForTimeout (200);
				
}

	
	export testfunction Drive_Style_Selector_Terrain_Selector()
{
  testModuleTitle("Drive_Style_Selector_Terrain_Selector");
  //write("Drive_Style_Selector_Terrain_Selector");
  
    sysSetVariableInt(sysvar::SysVar_PROXI::DIAG_ProxiLesen,1);
    testWaitForTimeout (200);
    sysSetVariableInt(sysvar::SysVar_PROXI::DIAG_ProxiLesen,0);
    testWaitForTimeout (200);
    sysSetVariableInt(sysvar::SysVar_PROXI::pByte88Bit56,Drive_Style_Selector_Terrain_Selector);		
    sysSetVariableInt(sysvar::SysVar_PROXI::DIAG_eLoadAll,1);
    testWaitForTimeout (200);
    sysSetVariableInt(sysvar::SysVar_PROXI::DIAG_eLoadAll,0);
testWaitForTimeout (2000);
    sysSetVariableInt(sysvar::SysVar_PROXI::DIAG_eSendProxi,1);
    testWaitForTimeout (200);
    sysSetVariableInt(sysvar::SysVar_PROXI::DIAG_eSendProxi,0);
    testWaitForTimeout (200);
				
}

export testfunction Advanced_Driver_Program_Kind_Button_Sport()
{
  testModuleTitle("Advanced_Driver_Program_Kind_Button_Sport");
  //write("Advanced_Driver_Program_Kind_Button_Sport");
  
    sysSetVariableInt(sysvar::SysVar_PROXI::DIAG_ProxiLesen,1);
    testWaitForTimeout (200);
    sysSetVariableInt(sysvar::SysVar_PROXI::DIAG_ProxiLesen,0);
    testWaitForTimeout (200);
    sysSetVariableInt(sysvar::SysVar_PROXI::pByte63Bit4,Advanced_Driver_Program_Kind_Button_Sport);		
    sysSetVariableInt(sysvar::SysVar_PROXI::DIAG_eLoadAll,1);
    testWaitForTimeout (200);
    sysSetVariableInt(sysvar::SysVar_PROXI::DIAG_eLoadAll,0);
testWaitForTimeout (2000);
    sysSetVariableInt(sysvar::SysVar_PROXI::DIAG_eSendProxi,1);
    testWaitForTimeout (200);
    sysSetVariableInt(sysvar::SysVar_PROXI::DIAG_eSendProxi,0);
    testWaitForTimeout (200);
				
}

export testfunction Drive_Type_Variant_FWD ()
{
  testModuleTitle("Drive_Type_Variant_FWD");
  //write("Drive_Type_Variant_FWD");
  
    sysSetVariableInt(sysvar::SysVar_PROXI::DIAG_ProxiLesen,1);
    testWaitForTimeout (200);
    sysSetVariableInt(sysvar::SysVar_PROXI::DIAG_ProxiLesen,0);
    testWaitForTimeout (200);
    sysSetVariableInt(sysvar::SysVar_PROXI::pByte91Bit567,Drive_Type_Variant_FWD);		
    sysSetVariableInt(sysvar::SysVar_PROXI::DIAG_eLoadAll,1);
    testWaitForTimeout (200);
    sysSetVariableInt(sysvar::SysVar_PROXI::DIAG_eLoadAll,0);
testWaitForTimeout (2000);
    sysSetVariableInt(sysvar::SysVar_PROXI::DIAG_eSendProxi,1);
    testWaitForTimeout (200);
    sysSetVariableInt(sysvar::SysVar_PROXI::DIAG_eSendProxi,0);
    testWaitForTimeout (200);
				
}
	
	export testfunction Drive_Type_Variant_RWD()
{
  testModuleTitle("Drive_Type_Variant_RWD");
  //write("Drive_Type_Variant_RWD");
  
    sysSetVariableInt(sysvar::SysVar_PROXI::DIAG_ProxiLesen,1);
    testWaitForTimeout (200);
    sysSetVariableInt(sysvar::SysVar_PROXI::DIAG_ProxiLesen,0);
    testWaitForTimeout (200);
    sysSetVariableInt(sysvar::SysVar_PROXI::pByte91Bit567,Drive_Type_Variant_RWD);		
    sysSetVariableInt(sysvar::SysVar_PROXI::DIAG_eLoadAll,1);
    testWaitForTimeout (200);
    sysSetVariableInt(sysvar::SysVar_PROXI::DIAG_eLoadAll,0);
testWaitForTimeout (2000);
    sysSetVariableInt(sysvar::SysVar_PROXI::DIAG_eSendProxi,1);
    testWaitForTimeout (200);
    sysSetVariableInt(sysvar::SysVar_PROXI::DIAG_eSendProxi,0);
    testWaitForTimeout (200);
				
}

export testfunction Drive_Type_Variant_Single_Speed_AWD ()
{
  testModuleTitle("Drive_Type_Variant_Single_Speed_AWD");
  //write("Drive_Type_Variant_Single_Speed_AWD");
  
    sysSetVariableInt(sysvar::SysVar_PROXI::DIAG_ProxiLesen,1);
    testWaitForTimeout (200);
    sysSetVariableInt(sysvar::SysVar_PROXI::DIAG_ProxiLesen,0);
    testWaitForTimeout (200);
    sysSetVariableInt(sysvar::SysVar_PROXI::pByte91Bit567,Drive_Type_Variant_Single_Speed_AWD);		
    sysSetVariableInt(sysvar::SysVar_PROXI::DIAG_eLoadAll,1);
    testWaitForTimeout (200);
    sysSetVariableInt(sysvar::SysVar_PROXI::DIAG_eLoadAll,0);
testWaitForTimeout (2000);
    sysSetVariableInt(sysvar::SysVar_PROXI::DIAG_eSendProxi,1);
    testWaitForTimeout (200);
    sysSetVariableInt(sysvar::SysVar_PROXI::DIAG_eSendProxi,0);
    testWaitForTimeout (200);
				
}
	
	export testfunction Drive_Type_Variant_2_Speed_4WD()
{
  testModuleTitle("Drive_Type_Variant_2_Speed_4WD");
  //write("Drive_Type_Variant_2_Speed_4WD");
  
    sysSetVariableInt(sysvar::SysVar_PROXI::DIAG_ProxiLesen,1);
    testWaitForTimeout (200);
    sysSetVariableInt(sysvar::SysVar_PROXI::DIAG_ProxiLesen,0);
    testWaitForTimeout (200);
    sysSetVariableInt(sysvar::SysVar_PROXI::pByte91Bit567,Drive_Type_Variant_2_Speed_4WD);		
    sysSetVariableInt(sysvar::SysVar_PROXI::DIAG_eLoadAll,1);
    testWaitForTimeout (200);
    sysSetVariableInt(sysvar::SysVar_PROXI::DIAG_eLoadAll,0);
testWaitForTimeout (2000);
    sysSetVariableInt(sysvar::SysVar_PROXI::DIAG_eSendProxi,1);
    testWaitForTimeout (200);
    sysSetVariableInt(sysvar::SysVar_PROXI::DIAG_eSendProxi,0);
    testWaitForTimeout (200);
				
}

export testfunction Drive_Type_Variant_2_Speed_4WD_with_Elocker ()
{
  testModuleTitle("Drive_Type_Variant_2_Speed_4WD_with_Elocker");
  //write("Drive_Type_Variant_2_Speed_4WD_with_Elocker");
  
    sysSetVariableInt(sysvar::SysVar_PROXI::DIAG_ProxiLesen,1);
    testWaitForTimeout (200);
    sysSetVariableInt(sysvar::SysVar_PROXI::DIAG_ProxiLesen,0);
    testWaitForTimeout (200);
    sysSetVariableInt(sysvar::SysVar_PROXI::pByte91Bit567,Drive_Type_Variant_2_Speed_4WD_with_Elocker);		
    sysSetVariableInt(sysvar::SysVar_PROXI::DIAG_eLoadAll,1);
    testWaitForTimeout (200);
    sysSetVariableInt(sysvar::SysVar_PROXI::DIAG_eLoadAll,0);
testWaitForTimeout (2000);
    sysSetVariableInt(sysvar::SysVar_PROXI::DIAG_eSendProxi,1);
    testWaitForTimeout (200);
    sysSetVariableInt(sysvar::SysVar_PROXI::DIAG_eSendProxi,0);
    testWaitForTimeout (200);
				
}

export testfunction Electronic_Brake_System_Absent ()
{
  testModuleTitle("Electronic_Brake_System_Absent");
  //write("Electronic_Brake_System_Absent");
  
    sysSetVariableInt(sysvar::SysVar_PROXI::DIAG_ProxiLesen,1);
    testWaitForTimeout (200);
    sysSetVariableInt(sysvar::SysVar_PROXI::DIAG_ProxiLesen,0);
    testWaitForTimeout (200);
    sysSetVariableInt(sysvar::SysVar_PROXI::pByte87Bit012,Electronic_Brake_System_Absent);		
    sysSetVariableInt(sysvar::SysVar_PROXI::DIAG_eLoadAll,1);
    testWaitForTimeout (200);
    sysSetVariableInt(sysvar::SysVar_PROXI::DIAG_eLoadAll,0);
testWaitForTimeout (2000);
    sysSetVariableInt(sysvar::SysVar_PROXI::DIAG_eSendProxi,1);
    testWaitForTimeout (200);
    sysSetVariableInt(sysvar::SysVar_PROXI::DIAG_eSendProxi,0);
    testWaitForTimeout (200);
				
}
	
	export testfunction Electronic_Brake_System_ABS()
{
  testModuleTitle("Electronic_Brake_System_ABS");
  //write("Electronic_Brake_System_ABS");
  
    sysSetVariableInt(sysvar::SysVar_PROXI::DIAG_ProxiLesen,1);
    testWaitForTimeout (200);
    sysSetVariableInt(sysvar::SysVar_PROXI::DIAG_ProxiLesen,0);
    testWaitForTimeout (200);
    sysSetVariableInt(sysvar::SysVar_PROXI::pByte87Bit012,Electronic_Brake_System_ABS);		
    sysSetVariableInt(sysvar::SysVar_PROXI::DIAG_eLoadAll,1);
    testWaitForTimeout (200);
    sysSetVariableInt(sysvar::SysVar_PROXI::DIAG_eLoadAll,0);
testWaitForTimeout (2000);
    sysSetVariableInt(sysvar::SysVar_PROXI::DIAG_eSendProxi,1);
    testWaitForTimeout (200);
    sysSetVariableInt(sysvar::SysVar_PROXI::DIAG_eSendProxi,0);
    testWaitForTimeout (200);
				
}

export testfunction Electronic_Brake_System_Not_Used()
{
  testModuleTitle("Electronic_Brake_System_Not_Used");
  //write("Electronic_Brake_System_Not_Used");
  
    sysSetVariableInt(sysvar::SysVar_PROXI::DIAG_ProxiLesen,1);
    testWaitForTimeout (200);
    sysSetVariableInt(sysvar::SysVar_PROXI::DIAG_ProxiLesen,0);
    testWaitForTimeout (200);
    sysSetVariableInt(sysvar::SysVar_PROXI::pByte87Bit012,Electronic_Brake_System_Not_Used);		
    sysSetVariableInt(sysvar::SysVar_PROXI::DIAG_eLoadAll,1);
    testWaitForTimeout (200);
    sysSetVariableInt(sysvar::SysVar_PROXI::DIAG_eLoadAll,0);
testWaitForTimeout (2000);
    sysSetVariableInt(sysvar::SysVar_PROXI::DIAG_eSendProxi,1);
    testWaitForTimeout (200);
    sysSetVariableInt(sysvar::SysVar_PROXI::DIAG_eSendProxi,0);
    testWaitForTimeout (200);
				
}

export testfunction Electronic_Brake_System_VDC_Hill_Holder_ASR()
{
  testModuleTitle("Electronic_Brake_System_VDC_Hill_Holder_ASR");
  //write("Electronic_Brake_System_VDC_Hill_Holder_ASR");
  
    sysSetVariableInt(sysvar::SysVar_PROXI::DIAG_ProxiLesen,1);
    testWaitForTimeout (200);
    sysSetVariableInt(sysvar::SysVar_PROXI::DIAG_ProxiLesen,0);
    testWaitForTimeout (200);
    sysSetVariableInt(sysvar::SysVar_PROXI::pByte87Bit012,Electronic_Brake_System_VDC_Hill_Holder_ASR);		
    sysSetVariableInt(sysvar::SysVar_PROXI::DIAG_eLoadAll,1);
    testWaitForTimeout (200);
    sysSetVariableInt(sysvar::SysVar_PROXI::DIAG_eLoadAll,0);
testWaitForTimeout (2000);
    sysSetVariableInt(sysvar::SysVar_PROXI::DIAG_eSendProxi,1);
    testWaitForTimeout (200);
    sysSetVariableInt(sysvar::SysVar_PROXI::DIAG_eSendProxi,0);
    testWaitForTimeout (200);
				
}

export testfunction Engine_Type_1_3_bz ()
{
  testModuleTitle("Engine_Type_1_3_bz");
  //write("Engine_Type_1_3_bz");
  
    sysSetVariableInt(sysvar::SysVar_PROXI::DIAG_ProxiLesen,1);
    testWaitForTimeout (200);
    sysSetVariableInt(sysvar::SysVar_PROXI::DIAG_ProxiLesen,0);
    testWaitForTimeout (200);
    sysSetVariableInt(sysvar::SysVar_PROXI::pByte66Bit4567,Engine_Type_1_3_bz);		
    sysSetVariableInt(sysvar::SysVar_PROXI::DIAG_eLoadAll,1);
    testWaitForTimeout (200);
    sysSetVariableInt(sysvar::SysVar_PROXI::DIAG_eLoadAll,0);
testWaitForTimeout (2000);
    sysSetVariableInt(sysvar::SysVar_PROXI::DIAG_eSendProxi,1);
    testWaitForTimeout (200);
    sysSetVariableInt(sysvar::SysVar_PROXI::DIAG_eSendProxi,0);
    testWaitForTimeout (200);
				
}
	
	
	export testfunction Engine_Type_1_3_FLEX ()
{
  testModuleTitle("Engine_Type_1_3_FLEX");
  //write("Engine_Type_1_3_FLEX");
  
    sysSetVariableInt(sysvar::SysVar_PROXI::DIAG_ProxiLesen,1);
    testWaitForTimeout (200);
    sysSetVariableInt(sysvar::SysVar_PROXI::DIAG_ProxiLesen,0);
    testWaitForTimeout (200);
    sysSetVariableInt(sysvar::SysVar_PROXI::pByte66Bit4567,Engine_Type_1_3_FLEX);		
    sysSetVariableInt(sysvar::SysVar_PROXI::DIAG_eLoadAll,1);
    testWaitForTimeout (200);
    sysSetVariableInt(sysvar::SysVar_PROXI::DIAG_eLoadAll,0);
testWaitForTimeout (2000);
    sysSetVariableInt(sysvar::SysVar_PROXI::DIAG_eSendProxi,1);
    testWaitForTimeout (200);
    sysSetVariableInt(sysvar::SysVar_PROXI::DIAG_eSendProxi,0);
    testWaitForTimeout (200);
				
}
	
export testfunction Engine_Type_1_3_GSE_180hp ()
{
  testModuleTitle("Engine_Type_1_3_GSE_180hp");
  //write("Engine_Type_1_3_GSE_180hp");
  
    sysSetVariableInt(sysvar::SysVar_PROXI::DIAG_ProxiLesen,1);
    testWaitForTimeout (200);
    sysSetVariableInt(sysvar::SysVar_PROXI::DIAG_ProxiLesen,0);
    testWaitForTimeout (200);
    sysSetVariableInt(sysvar::SysVar_PROXI::pByte66Bit4567,Engine_Type_1_3_GSE_180hp);		
    sysSetVariableInt(sysvar::SysVar_PROXI::DIAG_eLoadAll,1);
    testWaitForTimeout (200);
    sysSetVariableInt(sysvar::SysVar_PROXI::DIAG_eLoadAll,0);
testWaitForTimeout (2000);
    sysSetVariableInt(sysvar::SysVar_PROXI::DIAG_eSendProxi,1);
    testWaitForTimeout (200);
    sysSetVariableInt(sysvar::SysVar_PROXI::DIAG_eSendProxi,0);
    testWaitForTimeout (200);
				
}	
	
export testfunction Engine_Type_2_0L_Tiger_Shark_170hp ()
{
  testModuleTitle("Engine_Type_2_0L_Tiger_Shark_170hp");
  //write("Engine_Type_2_0L_Tiger_Shark_170hp");
  
    sysSetVariableInt(sysvar::SysVar_PROXI::DIAG_ProxiLesen,1);
    testWaitForTimeout (200);
    sysSetVariableInt(sysvar::SysVar_PROXI::DIAG_ProxiLesen,0);
    testWaitForTimeout (200);
    sysSetVariableInt(sysvar::SysVar_PROXI::pByte66Bit4567,Engine_Type_2_0L_Tiger_Shark_170hp);		
    sysSetVariableInt(sysvar::SysVar_PROXI::DIAG_eLoadAll,1);
    testWaitForTimeout (200);
    sysSetVariableInt(sysvar::SysVar_PROXI::DIAG_eLoadAll,0);
testWaitForTimeout (2000);
    sysSetVariableInt(sysvar::SysVar_PROXI::DIAG_eSendProxi,1);
    testWaitForTimeout (200);
    sysSetVariableInt(sysvar::SysVar_PROXI::DIAG_eSendProxi,0);
    testWaitForTimeout (200);
				
}
	
export testfunction Engine_Type_1_8_ETorq_140hp ()
{
  testModuleTitle("Engine_Type_1_8_ETorq_140hp");
  //write("Engine_Type_1_8_ETorq_140hp");
  
    sysSetVariableInt(sysvar::SysVar_PROXI::DIAG_ProxiLesen,1);
    testWaitForTimeout (200);
    sysSetVariableInt(sysvar::SysVar_PROXI::DIAG_ProxiLesen,0);
    testWaitForTimeout (200);
    sysSetVariableInt(sysvar::SysVar_PROXI::pByte66Bit4567,Engine_Type_1_8_ETorq_140hp);		
    sysSetVariableInt(sysvar::SysVar_PROXI::DIAG_eLoadAll,1);
    testWaitForTimeout (200);
    sysSetVariableInt(sysvar::SysVar_PROXI::DIAG_eLoadAll,0);
testWaitForTimeout (2000);
    sysSetVariableInt(sysvar::SysVar_PROXI::DIAG_eSendProxi,1);
    testWaitForTimeout (200);
    sysSetVariableInt(sysvar::SysVar_PROXI::DIAG_eSendProxi,0);
    testWaitForTimeout (200);
				
}
	
export testfunction Engine_Type_2_4L_Tiger_Shark_185hp ()
{
  testModuleTitle("Engine_Type_2_4L_Tiger_Shark_185hp");
  //write("Engine_Type_2_4L_Tiger_Shark_185hp");
  
    sysSetVariableInt(sysvar::SysVar_PROXI::DIAG_ProxiLesen,1);
    testWaitForTimeout (200);
    sysSetVariableInt(sysvar::SysVar_PROXI::DIAG_ProxiLesen,0);
    testWaitForTimeout (200);
    sysSetVariableInt(sysvar::SysVar_PROXI::pByte66Bit4567,Engine_Type_2_4L_Tiger_Shark_185hp);		
    sysSetVariableInt(sysvar::SysVar_PROXI::DIAG_eLoadAll,1);
    testWaitForTimeout (200);
    sysSetVariableInt(sysvar::SysVar_PROXI::DIAG_eLoadAll,0);
testWaitForTimeout (2000);
    sysSetVariableInt(sysvar::SysVar_PROXI::DIAG_eSendProxi,1);
    testWaitForTimeout (200);
    sysSetVariableInt(sysvar::SysVar_PROXI::DIAG_eSendProxi,0);
    testWaitForTimeout (200);
				
}

export testfunction Engine_Type_Invalid ()
{
  testModuleTitle("Engine_Type_Invalid");
  //write("Engine_Type_Invalid");
  
    sysSetVariableInt(sysvar::SysVar_PROXI::DIAG_ProxiLesen,1);
    testWaitForTimeout (200);
    sysSetVariableInt(sysvar::SysVar_PROXI::DIAG_ProxiLesen,0);
    testWaitForTimeout (200);
    sysSetVariableInt(sysvar::SysVar_PROXI::pByte66Bit4567,Engine_Type_Invalid);		
    sysSetVariableInt(sysvar::SysVar_PROXI::DIAG_eLoadAll,1);
    testWaitForTimeout (200);
    sysSetVariableInt(sysvar::SysVar_PROXI::DIAG_eLoadAll,0);
testWaitForTimeout (2000);
    sysSetVariableInt(sysvar::SysVar_PROXI::DIAG_eSendProxi,1);
    testWaitForTimeout (200);
    sysSetVariableInt(sysvar::SysVar_PROXI::DIAG_eSendProxi,0);
    testWaitForTimeout (200);
				
}
	
	export testfunction Engine_Type_System_2_0L_Mjet_170hp()
{
  testModuleTitle("Engine_Type_System_2_0L_Mjet_170hp");
  //write("Engine_Type_System_2_0L_Mjet_170hp");
  
    sysSetVariableInt(sysvar::SysVar_PROXI::DIAG_ProxiLesen,1);
    testWaitForTimeout (200);
    sysSetVariableInt(sysvar::SysVar_PROXI::DIAG_ProxiLesen,0);
    testWaitForTimeout (200);
    sysSetVariableInt(sysvar::SysVar_PROXI::pByte66Bit4567,Engine_Type_2_0L_Mjet_170hp);		
    sysSetVariableInt(sysvar::SysVar_PROXI::DIAG_eLoadAll,1);
    testWaitForTimeout (200);
    sysSetVariableInt(sysvar::SysVar_PROXI::DIAG_eLoadAll,0);
testWaitForTimeout (2000);
    sysSetVariableInt(sysvar::SysVar_PROXI::DIAG_eSendProxi,1);
    testWaitForTimeout (200);
    sysSetVariableInt(sysvar::SysVar_PROXI::DIAG_eSendProxi,0);
    testWaitForTimeout (200);
				
}

export testfunction Forward_Collision_Mitigation_Absent ()
{
  testModuleTitle("Forward_Collision_Mitigation_Absent");
  //write("Forward_Collision_Mitigation_Absent");
  
    sysSetVariableInt(sysvar::SysVar_PROXI::DIAG_ProxiLesen,1);
    testWaitForTimeout (200);
    sysSetVariableInt(sysvar::SysVar_PROXI::DIAG_ProxiLesen,0);
    testWaitForTimeout (200);
    sysSetVariableInt(sysvar::SysVar_PROXI::pByte86Bit34,Forward_Collision_Mitigation_Absent);		
    sysSetVariableInt(sysvar::SysVar_PROXI::DIAG_eLoadAll,1);
    testWaitForTimeout (200);
    sysSetVariableInt(sysvar::SysVar_PROXI::DIAG_eLoadAll,0);
testWaitForTimeout (2000);
    sysSetVariableInt(sysvar::SysVar_PROXI::DIAG_eSendProxi,1);
    testWaitForTimeout (200);
    sysSetVariableInt(sysvar::SysVar_PROXI::DIAG_eSendProxi,0);
    testWaitForTimeout (200);
				
}

export testfunction Full_Speed_FCW_with_Cyclist_and_PEB ()
{
  testModuleTitle("Full_Speed_FCW_with_Cyclist_and_PEB");
  //write("Full_Speed_FCW_with_Cyclist_and_PEB");
  
    sysSetVariableInt(sysvar::SysVar_PROXI::DIAG_ProxiLesen,1);
    testWaitForTimeout (200);
    sysSetVariableInt(sysvar::SysVar_PROXI::DIAG_ProxiLesen,0);
    testWaitForTimeout (200);
    sysSetVariableInt(sysvar::SysVar_PROXI::pByte86Bit34,Full_Speed_FCW_with_Cyclist_and_PEB);		
    sysSetVariableInt(sysvar::SysVar_PROXI::DIAG_eLoadAll,1);
    testWaitForTimeout (200);
    sysSetVariableInt(sysvar::SysVar_PROXI::DIAG_eLoadAll,0);
testWaitForTimeout (2000);
    sysSetVariableInt(sysvar::SysVar_PROXI::DIAG_eSendProxi,1);
    testWaitForTimeout (200);
    sysSetVariableInt(sysvar::SysVar_PROXI::DIAG_eSendProxi,0);
    testWaitForTimeout (200);
				
}

export testfunction Full_Speed_FCW_with_Pedestrian_Emergency_Braking ()
{
  testModuleTitle("Full_Speed_FCW_with_Pedestrian_Emergency_Braking");
  //write("Full_Speed_FCW_with_Pedestrian_Emergency_Braking");
  
    sysSetVariableInt(sysvar::SysVar_PROXI::DIAG_ProxiLesen,1);
    testWaitForTimeout (200);
    sysSetVariableInt(sysvar::SysVar_PROXI::DIAG_ProxiLesen,0);
    testWaitForTimeout (200);
    sysSetVariableInt(sysvar::SysVar_PROXI::pByte86Bit34,Full_Speed_FCW_with_Pedestrian_Emergency_Braking);		
    sysSetVariableInt(sysvar::SysVar_PROXI::DIAG_eLoadAll,1);
    testWaitForTimeout (200);
    sysSetVariableInt(sysvar::SysVar_PROXI::DIAG_eLoadAll,0);
testWaitForTimeout (2000);
    sysSetVariableInt(sysvar::SysVar_PROXI::DIAG_eSendProxi,1);
    testWaitForTimeout (200);
    sysSetVariableInt(sysvar::SysVar_PROXI::DIAG_eSendProxi,0);
    testWaitForTimeout (200);
				
}

export testfunction Forward_Collision_Mitigation_Full_Speed_FCW_with_Mitigation()
{
  testModuleTitle("Forward_Collision_Mitigation_Full_Speed_FCW_with_Mitigation");
  //write("Forward_Collision_Mitigation_Full_Speed_FCW_with_Mitigation");
  
    sysSetVariableInt(sysvar::SysVar_PROXI::DIAG_ProxiLesen,1);
    testWaitForTimeout (200);
    sysSetVariableInt(sysvar::SysVar_PROXI::DIAG_ProxiLesen,0);
    testWaitForTimeout (200);
    sysSetVariableInt(sysvar::SysVar_PROXI::pByte86Bit34,Forward_Collision_Mitigation_Full_Speed_FCW_with_Mitigation);		
    sysSetVariableInt(sysvar::SysVar_PROXI::DIAG_eLoadAll,1);
    testWaitForTimeout (200);
    sysSetVariableInt(sysvar::SysVar_PROXI::DIAG_eLoadAll,0);
testWaitForTimeout (2000);
    sysSetVariableInt(sysvar::SysVar_PROXI::DIAG_eSendProxi,1);
    testWaitForTimeout (200);
    sysSetVariableInt(sysvar::SysVar_PROXI::DIAG_eSendProxi,0);
    testWaitForTimeout (200);
				
}

export testfunction Front_Passenger_Bag_Absent ()
{
  testModuleTitle("Front_Passenger_Bag_Absent");
  //write("Front_Passenger_Bag_Absent");
  
    sysSetVariableInt(sysvar::SysVar_PROXI::DIAG_ProxiLesen,1);
    testWaitForTimeout (200);
    sysSetVariableInt(sysvar::SysVar_PROXI::DIAG_ProxiLesen,0);
    testWaitForTimeout (200);
    sysSetVariableInt(sysvar::SysVar_PROXI::pByte79Bit23,Front_Passenger_Bag_Absent);		
    sysSetVariableInt(sysvar::SysVar_PROXI::DIAG_eLoadAll,1);
    testWaitForTimeout (200);
    sysSetVariableInt(sysvar::SysVar_PROXI::DIAG_eLoadAll,0);
testWaitForTimeout (2000);
    sysSetVariableInt(sysvar::SysVar_PROXI::DIAG_eSendProxi,1);
    testWaitForTimeout (200);
    sysSetVariableInt(sysvar::SysVar_PROXI::DIAG_eSendProxi,0);
    testWaitForTimeout (200);
				
}
	
	export testfunction Front_Passenger_Bag_Present_Monostage
()
{
  testModuleTitle("Front_Passenger_Bag_Present_Monostage");
  //write("Front_Passenger_Bag_Present_Monostage");
  
    sysSetVariableInt(sysvar::SysVar_PROXI::DIAG_ProxiLesen,1);
    testWaitForTimeout (200);
    sysSetVariableInt(sysvar::SysVar_PROXI::DIAG_ProxiLesen,0);
    testWaitForTimeout (200);
    sysSetVariableInt(sysvar::SysVar_PROXI::pByte79Bit23,Front_Passenger_Bag_Present_Monostage);		
    sysSetVariableInt(sysvar::SysVar_PROXI::DIAG_eLoadAll,1);
    testWaitForTimeout (200);
    sysSetVariableInt(sysvar::SysVar_PROXI::DIAG_eLoadAll,0);
testWaitForTimeout (2000);
    sysSetVariableInt(sysvar::SysVar_PROXI::DIAG_eSendProxi,1);
    testWaitForTimeout (200);
    sysSetVariableInt(sysvar::SysVar_PROXI::DIAG_eSendProxi,0);
    testWaitForTimeout (200);
				
}

export testfunction Front_Passenger_Bag_Present_Dual_Stage()
{
  testModuleTitle("Front_Passenger_Bag_Present_Dual_Stage");
  //write("Front_Passenger_Bag_Present_Dual_Stage");
  
    sysSetVariableInt(sysvar::SysVar_PROXI::DIAG_ProxiLesen,1);
    testWaitForTimeout (200);
    sysSetVariableInt(sysvar::SysVar_PROXI::DIAG_ProxiLesen,0);
    testWaitForTimeout (200);
    sysSetVariableInt(sysvar::SysVar_PROXI::pByte79Bit23,Front_Passenger_Bag_Present_Dual_Stage);		
    sysSetVariableInt(sysvar::SysVar_PROXI::DIAG_eLoadAll,1);
    testWaitForTimeout (200);
    sysSetVariableInt(sysvar::SysVar_PROXI::DIAG_eLoadAll,0);
testWaitForTimeout (2000);
    sysSetVariableInt(sysvar::SysVar_PROXI::DIAG_eSendProxi,1);
    testWaitForTimeout (200);
    sysSetVariableInt(sysvar::SysVar_PROXI::DIAG_eSendProxi,0);
    testWaitForTimeout (200);
				
}

export testfunction Front_Passenger_Bag_Present_Tri_Stage()
{
  testModuleTitle("Front_Passenger_Bag_Present_Tri_Stage");
  //write("Front_Passenger_Bag_Present_Tri_Stage");
  
    sysSetVariableInt(sysvar::SysVar_PROXI::DIAG_ProxiLesen,1);
    testWaitForTimeout (200);
    sysSetVariableInt(sysvar::SysVar_PROXI::DIAG_ProxiLesen,0);
    testWaitForTimeout (200);
    sysSetVariableInt(sysvar::SysVar_PROXI::pByte79Bit23,Front_Passenger_Bag_Present_Tri_Stage);		
    sysSetVariableInt(sysvar::SysVar_PROXI::DIAG_eLoadAll,1);
    testWaitForTimeout (200);
    sysSetVariableInt(sysvar::SysVar_PROXI::DIAG_eLoadAll,0);
testWaitForTimeout (2000);
    sysSetVariableInt(sysvar::SysVar_PROXI::DIAG_eSendProxi,1);
    testWaitForTimeout (200);
    sysSetVariableInt(sysvar::SysVar_PROXI::DIAG_eSendProxi,0);
    testWaitForTimeout (200);
				
}

	export testfunction Fuel_Type_Invalid ()
{
  testModuleTitle("Fuel_Type_Invalid");
  //write("Fuel_Type_Invalid");
  
    sysSetVariableInt(sysvar::SysVar_PROXI::DIAG_ProxiLesen,1);
    testWaitForTimeout (200);
    sysSetVariableInt(sysvar::SysVar_PROXI::DIAG_ProxiLesen,0);
    testWaitForTimeout (200);
    sysSetVariableInt(sysvar::SysVar_PROXI::pByte61Bit012,Fuel_Type_Invalid);		
    sysSetVariableInt(sysvar::SysVar_PROXI::DIAG_eLoadAll,1);
    testWaitForTimeout (200);
    sysSetVariableInt(sysvar::SysVar_PROXI::DIAG_eLoadAll,0);
testWaitForTimeout (2000);
    sysSetVariableInt(sysvar::SysVar_PROXI::DIAG_eSendProxi,1);
    testWaitForTimeout (200);
    sysSetVariableInt(sysvar::SysVar_PROXI::DIAG_eSendProxi,0);
    testWaitForTimeout (200);
				
}
	
	export testfunction Fuel_Type_Gasoline ()
{
  testModuleTitle("Fuel_Type_Gasoline ");
  //write("Fuel_Type_Gasoline ");
  
    sysSetVariableInt(sysvar::SysVar_PROXI::DIAG_ProxiLesen,1);
    testWaitForTimeout (200);
    sysSetVariableInt(sysvar::SysVar_PROXI::DIAG_ProxiLesen,0);
    testWaitForTimeout (200);
    sysSetVariableInt(sysvar::SysVar_PROXI::pByte61Bit012,Fuel_Type_Gasoline );		
    sysSetVariableInt(sysvar::SysVar_PROXI::DIAG_eLoadAll,1);
    testWaitForTimeout (200);
    sysSetVariableInt(sysvar::SysVar_PROXI::DIAG_eLoadAll,0);
testWaitForTimeout (2000);
    sysSetVariableInt(sysvar::SysVar_PROXI::DIAG_eSendProxi,1);
    testWaitForTimeout (200);
    sysSetVariableInt(sysvar::SysVar_PROXI::DIAG_eSendProxi,0);
    testWaitForTimeout (200);
				
}

export testfunction Fuel_Type_Diesel()
{
  testModuleTitle("Fuel_Type_Diesel");
  //write("Fuel_Type_Diesel");
  
    sysSetVariableInt(sysvar::SysVar_PROXI::DIAG_ProxiLesen,1);
    testWaitForTimeout (200);
    sysSetVariableInt(sysvar::SysVar_PROXI::DIAG_ProxiLesen,0);
    testWaitForTimeout (200);
    sysSetVariableInt(sysvar::SysVar_PROXI::pByte61Bit012,Fuel_Type_Diesel);		
    sysSetVariableInt(sysvar::SysVar_PROXI::DIAG_eLoadAll,1);
    testWaitForTimeout (200);
    sysSetVariableInt(sysvar::SysVar_PROXI::DIAG_eLoadAll,0);
testWaitForTimeout (2000);
    sysSetVariableInt(sysvar::SysVar_PROXI::DIAG_eSendProxi,1);
    testWaitForTimeout (200);
    sysSetVariableInt(sysvar::SysVar_PROXI::DIAG_eSendProxi,0);
    testWaitForTimeout (200);
				
}

export testfunction Fuel_Type_CNG()
{
  testModuleTitle("Fuel_Type_CNG");
  //write("Fuel_Type_CNG");
  
    sysSetVariableInt(sysvar::SysVar_PROXI::DIAG_ProxiLesen,1);
    testWaitForTimeout (200);
    sysSetVariableInt(sysvar::SysVar_PROXI::DIAG_ProxiLesen,0);
    testWaitForTimeout (200);
    sysSetVariableInt(sysvar::SysVar_PROXI::pByte61Bit012,Fuel_Type_CNG);		
    sysSetVariableInt(sysvar::SysVar_PROXI::DIAG_eLoadAll,1);
    testWaitForTimeout (200);
    sysSetVariableInt(sysvar::SysVar_PROXI::DIAG_eLoadAll,0);
testWaitForTimeout (2000);
    sysSetVariableInt(sysvar::SysVar_PROXI::DIAG_eSendProxi,1);
    testWaitForTimeout (200);
    sysSetVariableInt(sysvar::SysVar_PROXI::DIAG_eSendProxi,0);
    testWaitForTimeout (200);
				
}

	export testfunction Fuel_Type_GPL ()
{
  testModuleTitle("Fuel_Type_GPL");
  //write("Fuel_Type_GPL");
  
    sysSetVariableInt(sysvar::SysVar_PROXI::DIAG_ProxiLesen,1);
    testWaitForTimeout (200);
    sysSetVariableInt(sysvar::SysVar_PROXI::DIAG_ProxiLesen,0);
    testWaitForTimeout (200);
    sysSetVariableInt(sysvar::SysVar_PROXI::pByte61Bit012,Fuel_Type_GPL);		
    sysSetVariableInt(sysvar::SysVar_PROXI::DIAG_eLoadAll,1);
    testWaitForTimeout (200);
    sysSetVariableInt(sysvar::SysVar_PROXI::DIAG_eLoadAll,0);
testWaitForTimeout (2000);
    sysSetVariableInt(sysvar::SysVar_PROXI::DIAG_eSendProxi,1);
    testWaitForTimeout (200);
    sysSetVariableInt(sysvar::SysVar_PROXI::DIAG_eSendProxi,0);
    testWaitForTimeout (200);
				
}

	export testfunction Fuel_Type_Electric ()
{
  testModuleTitle("Fuel_Type_Electric");
  //write("Fuel_Type_Electric");
  
    sysSetVariableInt(sysvar::SysVar_PROXI::DIAG_ProxiLesen,1);
    testWaitForTimeout (200);
    sysSetVariableInt(sysvar::SysVar_PROXI::DIAG_ProxiLesen,0);
    testWaitForTimeout (200);
    sysSetVariableInt(sysvar::SysVar_PROXI::pByte61Bit012,Fuel_Type_Electric);		
    sysSetVariableInt(sysvar::SysVar_PROXI::DIAG_eLoadAll,1);
    testWaitForTimeout (200);
    sysSetVariableInt(sysvar::SysVar_PROXI::DIAG_eLoadAll,0);
testWaitForTimeout (2000);
    sysSetVariableInt(sysvar::SysVar_PROXI::DIAG_eSendProxi,1);
    testWaitForTimeout (200);
    sysSetVariableInt(sysvar::SysVar_PROXI::DIAG_eSendProxi,0);
    testWaitForTimeout (200);
				
}

	export testfunction Fuel_Type_Hybrid ()
{
  testModuleTitle("Fuel_Type_Hybrid");
  //write("Fuel_Type_Hybrid");
  
    sysSetVariableInt(sysvar::SysVar_PROXI::DIAG_ProxiLesen,1);
    testWaitForTimeout (200);
    sysSetVariableInt(sysvar::SysVar_PROXI::DIAG_ProxiLesen,0);
    testWaitForTimeout (200);
    sysSetVariableInt(sysvar::SysVar_PROXI::pByte61Bit012,Fuel_Type_Hybrid);		
    sysSetVariableInt(sysvar::SysVar_PROXI::DIAG_eLoadAll,1);
    testWaitForTimeout (200);
    sysSetVariableInt(sysvar::SysVar_PROXI::DIAG_eLoadAll,0);
testWaitForTimeout (2000);
    sysSetVariableInt(sysvar::SysVar_PROXI::DIAG_eSendProxi,1);
    testWaitForTimeout (200);
    sysSetVariableInt(sysvar::SysVar_PROXI::DIAG_eSendProxi,0);
    testWaitForTimeout (200);
				
}

	export testfunction Fuel_Type_Flex ()
{
  testModuleTitle("Fuel_Type_Flex");
  //write("Fuel_Type_Flex");
  
    sysSetVariableInt(sysvar::SysVar_PROXI::DIAG_ProxiLesen,1);
    testWaitForTimeout (200);
    sysSetVariableInt(sysvar::SysVar_PROXI::DIAG_ProxiLesen,0);
    testWaitForTimeout (200);
    sysSetVariableInt(sysvar::SysVar_PROXI::pByte61Bit012,Fuel_Type_Flex);		
    sysSetVariableInt(sysvar::SysVar_PROXI::DIAG_eLoadAll,1);
    testWaitForTimeout (200);
    sysSetVariableInt(sysvar::SysVar_PROXI::DIAG_eLoadAll,0);
testWaitForTimeout (2000);
    sysSetVariableInt(sysvar::SysVar_PROXI::DIAG_eSendProxi,1);
    testWaitForTimeout (200);
    sysSetVariableInt(sysvar::SysVar_PROXI::DIAG_eSendProxi,0);
    testWaitForTimeout (200);
				
}

	export testfunction Gear_Box_Type_Not_Valid ()
{
  testModuleTitle("Gear_Box_Type_Not_Valid");
  //write("Gear_Box_Type_Not_Valid");
  
    sysSetVariableInt(sysvar::SysVar_PROXI::DIAG_ProxiLesen,1);
    testWaitForTimeout (200);
    sysSetVariableInt(sysvar::SysVar_PROXI::DIAG_ProxiLesen,0);
    testWaitForTimeout (200);
    sysSetVariableInt(sysvar::SysVar_PROXI::pByte101Bit012,Gear_Box_Type_Not_Valid);		
    sysSetVariableInt(sysvar::SysVar_PROXI::DIAG_eLoadAll,1);
    testWaitForTimeout (200);
    sysSetVariableInt(sysvar::SysVar_PROXI::DIAG_eLoadAll,0);
testWaitForTimeout (2000);
    sysSetVariableInt(sysvar::SysVar_PROXI::DIAG_eSendProxi,1);
    testWaitForTimeout (200);
    sysSetVariableInt(sysvar::SysVar_PROXI::DIAG_eSendProxi,0);
    testWaitForTimeout (200);
				
}

	export testfunction Gear_Box_Type_MTX ()
{
  testModuleTitle("Gear_Box_Type_MTX");
  //write("Gear_Box_Type_MTX");
  
    sysSetVariableInt(sysvar::SysVar_PROXI::DIAG_ProxiLesen,1);
    testWaitForTimeout (200);
    sysSetVariableInt(sysvar::SysVar_PROXI::DIAG_ProxiLesen,0);
    testWaitForTimeout (200);
    sysSetVariableInt(sysvar::SysVar_PROXI::pByte101Bit012,Gear_Box_Type_MTX);		
    sysSetVariableInt(sysvar::SysVar_PROXI::DIAG_eLoadAll,1);
    testWaitForTimeout (200);
    sysSetVariableInt(sysvar::SysVar_PROXI::DIAG_eLoadAll,0);
testWaitForTimeout (2000);
    sysSetVariableInt(sysvar::SysVar_PROXI::DIAG_eSendProxi,1);
    testWaitForTimeout (200);
    sysSetVariableInt(sysvar::SysVar_PROXI::DIAG_eSendProxi,0);
    testWaitForTimeout (200);
				
}

	export testfunction Gear_Box_Type_MTA ()
{
  testModuleTitle("Gear_Box_Type_MTA");
  //write("Gear_Box_Type_MTA");
  
    sysSetVariableInt(sysvar::SysVar_PROXI::DIAG_ProxiLesen,1);
    testWaitForTimeout (200);
    sysSetVariableInt(sysvar::SysVar_PROXI::DIAG_ProxiLesen,0);
    testWaitForTimeout (200);
    sysSetVariableInt(sysvar::SysVar_PROXI::pByte101Bit012,Gear_Box_Type_MTA);		
    sysSetVariableInt(sysvar::SysVar_PROXI::DIAG_eLoadAll,1);
    testWaitForTimeout (200);
    sysSetVariableInt(sysvar::SysVar_PROXI::DIAG_eLoadAll,0);
testWaitForTimeout (2000);
    sysSetVariableInt(sysvar::SysVar_PROXI::DIAG_eSendProxi,1);
    testWaitForTimeout (200);
    sysSetVariableInt(sysvar::SysVar_PROXI::DIAG_eSendProxi,0);
    testWaitForTimeout (200);
				
}

	export testfunction Gear_Box_Type_DDCT ()
{
  testModuleTitle("Gear_Box_Type_DDCT");
  //write("Gear_Box_Type_DDCT");
  
    sysSetVariableInt(sysvar::SysVar_PROXI::DIAG_ProxiLesen,1);
    testWaitForTimeout (200);
    sysSetVariableInt(sysvar::SysVar_PROXI::DIAG_ProxiLesen,0);
    testWaitForTimeout (200);
    sysSetVariableInt(sysvar::SysVar_PROXI::pByte101Bit012,Gear_Box_Type_DDCT);		
    sysSetVariableInt(sysvar::SysVar_PROXI::DIAG_eLoadAll,1);
    testWaitForTimeout (200);
    sysSetVariableInt(sysvar::SysVar_PROXI::DIAG_eLoadAll,0);
testWaitForTimeout (2000);
    sysSetVariableInt(sysvar::SysVar_PROXI::DIAG_eSendProxi,1);
    testWaitForTimeout (200);
    sysSetVariableInt(sysvar::SysVar_PROXI::DIAG_eSendProxi,0);
    testWaitForTimeout (200);
				
}

	export testfunction Gear_Box_Type_ATX ()
{
  testModuleTitle("Gear_Box_Type_ATX");
  //write("Gear_Box_Type_ATX");
  
    sysSetVariableInt(sysvar::SysVar_PROXI::DIAG_ProxiLesen,1);
    testWaitForTimeout (200);
    sysSetVariableInt(sysvar::SysVar_PROXI::DIAG_ProxiLesen,0);
    testWaitForTimeout (200);
    sysSetVariableInt(sysvar::SysVar_PROXI::pByte101Bit012,Gear_Box_Type_ATX);		
    sysSetVariableInt(sysvar::SysVar_PROXI::DIAG_eLoadAll,1);
    testWaitForTimeout (200);
    sysSetVariableInt(sysvar::SysVar_PROXI::DIAG_eLoadAll,0);
testWaitForTimeout (2000);
    sysSetVariableInt(sysvar::SysVar_PROXI::DIAG_eSendProxi,1);
    testWaitForTimeout (200);
    sysSetVariableInt(sysvar::SysVar_PROXI::DIAG_eSendProxi,0);
    testWaitForTimeout (200);
				
}

	export testfunction Gear_Box_Type_Not_Used ()
{
  testModuleTitle("Gear_Box_Type_Not_Used");
  //write("Gear_Box_Type_Not_Used");
  
    sysSetVariableInt(sysvar::SysVar_PROXI::DIAG_ProxiLesen,1);
    testWaitForTimeout (200);
    sysSetVariableInt(sysvar::SysVar_PROXI::DIAG_ProxiLesen,0);
    testWaitForTimeout (200);
    sysSetVariableInt(sysvar::SysVar_PROXI::pByte101Bit012,Gear_Box_Type_Not_Used);		
    sysSetVariableInt(sysvar::SysVar_PROXI::DIAG_eLoadAll,1);
    testWaitForTimeout (200);
    sysSetVariableInt(sysvar::SysVar_PROXI::DIAG_eLoadAll,0);
testWaitForTimeout (2000);
    sysSetVariableInt(sysvar::SysVar_PROXI::DIAG_eSendProxi,1);
    testWaitForTimeout (200);
    sysSetVariableInt(sysvar::SysVar_PROXI::DIAG_eSendProxi,0);
    testWaitForTimeout (200);
				
}

	export testfunction Gear_Box_Type_Variant_Invalid ()
{
  testModuleTitle("Gear_Box_Type_Variant_Invalid");
  //write("Gear_Box_Type_Variant_Invalid");
  
    sysSetVariableInt(sysvar::SysVar_PROXI::DIAG_ProxiLesen,1);
    testWaitForTimeout (200);
    sysSetVariableInt(sysvar::SysVar_PROXI::DIAG_ProxiLesen,0);
    testWaitForTimeout (200);
    sysSetVariableInt(sysvar::SysVar_PROXI::pByte100Bit34567,Gear_Box_Type_Variant_Invalid);		
    sysSetVariableInt(sysvar::SysVar_PROXI::DIAG_eLoadAll,1);
    testWaitForTimeout (200);
    sysSetVariableInt(sysvar::SysVar_PROXI::DIAG_eLoadAll,0);
testWaitForTimeout (2000);
    sysSetVariableInt(sysvar::SysVar_PROXI::DIAG_eSendProxi,1);
    testWaitForTimeout (200);
    sysSetVariableInt(sysvar::SysVar_PROXI::DIAG_eSendProxi,0);
    testWaitForTimeout (200);
				
}

		export testfunction Gear_Box_Type_Variant_C510_MTX ()
{
  testModuleTitle("Gear_Box_Type_Variant_C510_MTX");
  //write("Gear_Box_Type_Variant_C510_MTX");
  
    sysSetVariableInt(sysvar::SysVar_PROXI::DIAG_ProxiLesen,1);
    testWaitForTimeout (200);
    sysSetVariableInt(sysvar::SysVar_PROXI::DIAG_ProxiLesen,0);
    testWaitForTimeout (200);
    sysSetVariableInt(sysvar::SysVar_PROXI::pByte100Bit34567,Gear_Box_Type_Variant_C510_MTX);		
    sysSetVariableInt(sysvar::SysVar_PROXI::DIAG_eLoadAll,1);
    testWaitForTimeout (200);
    sysSetVariableInt(sysvar::SysVar_PROXI::DIAG_eLoadAll,0);
testWaitForTimeout (2000);
    sysSetVariableInt(sysvar::SysVar_PROXI::DIAG_eSendProxi,1);
    testWaitForTimeout (200);
    sysSetVariableInt(sysvar::SysVar_PROXI::DIAG_eSendProxi,0);
    testWaitForTimeout (200);
				
}

	export testfunction Gear_Box_Type_Variant_C635_MTX ()
{
  testModuleTitle("Gear_Box_Type_Variant_C635_MTX");
  //write("Gear_Box_Type_Variant_C635_MTX");
  
    sysSetVariableInt(sysvar::SysVar_PROXI::DIAG_ProxiLesen,1);
    testWaitForTimeout (200);
    sysSetVariableInt(sysvar::SysVar_PROXI::DIAG_ProxiLesen,0);
    testWaitForTimeout (200);
    sysSetVariableInt(sysvar::SysVar_PROXI::pByte100Bit34567,Gear_Box_Type_Variant_C635_MTX);		
    sysSetVariableInt(sysvar::SysVar_PROXI::DIAG_eLoadAll,1);
    testWaitForTimeout (200);
    sysSetVariableInt(sysvar::SysVar_PROXI::DIAG_eLoadAll,0);
testWaitForTimeout (2000);
    sysSetVariableInt(sysvar::SysVar_PROXI::DIAG_eSendProxi,1);
    testWaitForTimeout (200);
    sysSetVariableInt(sysvar::SysVar_PROXI::DIAG_eSendProxi,0);
    testWaitForTimeout (200);
				
}

	export testfunction Gear_Box_Type_Variant_C635_DCT ()
{
  testModuleTitle("Gear_Box_Type_Variant_C635_DCT");
  //write("Gear_Box_Type_Variant_C635_DCT");
  
    sysSetVariableInt(sysvar::SysVar_PROXI::DIAG_ProxiLesen,1);
    testWaitForTimeout (200);
    sysSetVariableInt(sysvar::SysVar_PROXI::DIAG_ProxiLesen,0);
    testWaitForTimeout (200);
    sysSetVariableInt(sysvar::SysVar_PROXI::pByte100Bit34567,Gear_Box_Type_Variant_C635_DCT);		
    sysSetVariableInt(sysvar::SysVar_PROXI::DIAG_eLoadAll,1);
    testWaitForTimeout (200);
    sysSetVariableInt(sysvar::SysVar_PROXI::DIAG_eLoadAll,0);
testWaitForTimeout (2000);
    sysSetVariableInt(sysvar::SysVar_PROXI::DIAG_eSendProxi,1);
    testWaitForTimeout (200);
    sysSetVariableInt(sysvar::SysVar_PROXI::DIAG_eSendProxi,0);
    testWaitForTimeout (200);
				
}

	export testfunction Gear_Box_Type_Variant_F21_250_Gen_III_AT6 ()
{
  testModuleTitle("Gear_Box_Type_Variant_F21_250_Gen_III_AT6");
  //write("Gear_Box_Type_Variant_F21_250_Gen_III_AT6");
  
    sysSetVariableInt(sysvar::SysVar_PROXI::DIAG_ProxiLesen,1);
    testWaitForTimeout (200);
    sysSetVariableInt(sysvar::SysVar_PROXI::DIAG_ProxiLesen,0);
    testWaitForTimeout (200);
    sysSetVariableInt(sysvar::SysVar_PROXI::pByte100Bit34567,Gear_Box_Type_Variant_F21_250_Gen_III_AT6);		
    sysSetVariableInt(sysvar::SysVar_PROXI::DIAG_eLoadAll,1);
    testWaitForTimeout (200);
    sysSetVariableInt(sysvar::SysVar_PROXI::DIAG_eLoadAll,0);
testWaitForTimeout (2000);
    sysSetVariableInt(sysvar::SysVar_PROXI::DIAG_eSendProxi,1);
    testWaitForTimeout (200);
    sysSetVariableInt(sysvar::SysVar_PROXI::DIAG_eSendProxi,0);
    testWaitForTimeout (200);
				
}

	export testfunction GSI_Type_ ()
{
  testModuleTitle("GSI_Type_Not_present");
  //write("GSI_Type_Not_present");
  
    sysSetVariableInt(sysvar::SysVar_PROXI::DIAG_ProxiLesen,1);
    testWaitForTimeout (200);
    sysSetVariableInt(sysvar::SysVar_PROXI::DIAG_ProxiLesen,0);
    testWaitForTimeout (200);
    sysSetVariableInt(sysvar::SysVar_PROXI::pByte133Bit56,GSI_Type_Not_Present);		
    sysSetVariableInt(sysvar::SysVar_PROXI::DIAG_eLoadAll,1);
    testWaitForTimeout (200);
    sysSetVariableInt(sysvar::SysVar_PROXI::DIAG_eLoadAll,0);
testWaitForTimeout (2000);
    sysSetVariableInt(sysvar::SysVar_PROXI::DIAG_eSendProxi,1);
    testWaitForTimeout (200);
    sysSetVariableInt(sysvar::SysVar_PROXI::DIAG_eSendProxi,0);
    testWaitForTimeout (200);
				
}

	export testfunction GSI_Type_GSI ()
{
  testModuleTitle("GSI_Type_GSI");
  //write("GSI_Type_GSI");
  
    sysSetVariableInt(sysvar::SysVar_PROXI::DIAG_ProxiLesen,1);
    testWaitForTimeout (200);
    sysSetVariableInt(sysvar::SysVar_PROXI::DIAG_ProxiLesen,0);
    testWaitForTimeout (200);
    sysSetVariableInt(sysvar::SysVar_PROXI::pByte133Bit56,GSI_Type_GSI);		
    sysSetVariableInt(sysvar::SysVar_PROXI::DIAG_eLoadAll,1);
    testWaitForTimeout (200);
    sysSetVariableInt(sysvar::SysVar_PROXI::DIAG_eLoadAll,0);
testWaitForTimeout (2000);
    sysSetVariableInt(sysvar::SysVar_PROXI::DIAG_eSendProxi,1);
    testWaitForTimeout (200);
    sysSetVariableInt(sysvar::SysVar_PROXI::DIAG_eSendProxi,0);
    testWaitForTimeout (200);
				
}

	export testfunction GSI_Type_GSI_II ()
{
  testModuleTitle("GSI_Type_GSI_II");
  //write("GSI_Type_GSI_II");
  
    sysSetVariableInt(sysvar::SysVar_PROXI::DIAG_ProxiLesen,1);
    testWaitForTimeout (200);
    sysSetVariableInt(sysvar::SysVar_PROXI::DIAG_ProxiLesen,0);
    testWaitForTimeout (200);
    sysSetVariableInt(sysvar::SysVar_PROXI::pByte133Bit56,GSI_Type_GSI_II);		
    sysSetVariableInt(sysvar::SysVar_PROXI::DIAG_eLoadAll,1);
    testWaitForTimeout (200);
    sysSetVariableInt(sysvar::SysVar_PROXI::DIAG_eLoadAll,0);
testWaitForTimeout (2000);
    sysSetVariableInt(sysvar::SysVar_PROXI::DIAG_eSendProxi,1);
    testWaitForTimeout (200);
    sysSetVariableInt(sysvar::SysVar_PROXI::DIAG_eSendProxi,0);
    testWaitForTimeout (200);
				
}

	export testfunction GSI_Type_Enhanced_GSI ()
{
  testModuleTitle("GSI_Type_Enhanced_GSI");
  //write("GSI_Type_Enhanced_GSI");
  
    sysSetVariableInt(sysvar::SysVar_PROXI::DIAG_ProxiLesen,1);
    testWaitForTimeout (200);
    sysSetVariableInt(sysvar::SysVar_PROXI::DIAG_ProxiLesen,0);
    testWaitForTimeout (200);
    sysSetVariableInt(sysvar::SysVar_PROXI::pByte133Bit56,GSI_Type_Enhanced_GSI);		
    sysSetVariableInt(sysvar::SysVar_PROXI::DIAG_eLoadAll,1);
    testWaitForTimeout (200);
    sysSetVariableInt(sysvar::SysVar_PROXI::DIAG_eLoadAll,0);
testWaitForTimeout (2000);
    sysSetVariableInt(sysvar::SysVar_PROXI::DIAG_eSendProxi,1);
    testWaitForTimeout (200);
    sysSetVariableInt(sysvar::SysVar_PROXI::DIAG_eSendProxi,0);
    testWaitForTimeout (200);
				
}

	export testfunction Half_HMI_Setting_Level_1_absent ()
{
  testModuleTitle("Half_HMI_Setting_Level_1_absent");
  //write("Half_HMI_Setting_Level_1_absent");
  
    sysSetVariableInt(sysvar::SysVar_PROXI::DIAG_ProxiLesen,1);
    testWaitForTimeout (200);
    sysSetVariableInt(sysvar::SysVar_PROXI::DIAG_ProxiLesen,0);
    testWaitForTimeout (200);
    sysSetVariableInt(sysvar::SysVar_PROXI::pByte126Bit12,Half_HMI_Setting_Level_1_absent);		
    sysSetVariableInt(sysvar::SysVar_PROXI::DIAG_eLoadAll,1);
    testWaitForTimeout (200);
    sysSetVariableInt(sysvar::SysVar_PROXI::DIAG_eLoadAll,0);
testWaitForTimeout (2000);
    sysSetVariableInt(sysvar::SysVar_PROXI::DIAG_eSendProxi,1);
    testWaitForTimeout (200);
    sysSetVariableInt(sysvar::SysVar_PROXI::DIAG_eSendProxi,0);
    testWaitForTimeout (200);
				
}

	export testfunction Half_HMI_Setting_Level_2_full ()
{
  testModuleTitle("Half_HMI_Setting_Level_2_full");
  //write("Half_HMI_Setting_Level_2_full");
  
    sysSetVariableInt(sysvar::SysVar_PROXI::DIAG_ProxiLesen,1);
    testWaitForTimeout (200);
    sysSetVariableInt(sysvar::SysVar_PROXI::DIAG_ProxiLesen,0);
    testWaitForTimeout (200);
    sysSetVariableInt(sysvar::SysVar_PROXI::pByte126Bit12,Half_HMI_Setting_Level_2_full);		
    sysSetVariableInt(sysvar::SysVar_PROXI::DIAG_eLoadAll,1);
    testWaitForTimeout (200);
    sysSetVariableInt(sysvar::SysVar_PROXI::DIAG_eLoadAll,0);
testWaitForTimeout (2000);
    sysSetVariableInt(sysvar::SysVar_PROXI::DIAG_eSendProxi,1);
    testWaitForTimeout (200);
    sysSetVariableInt(sysvar::SysVar_PROXI::DIAG_eSendProxi,0);
    testWaitForTimeout (200);
				
}

	export testfunction Half_HMI_Setting_Level_3_base ()
{
  testModuleTitle("Half_HMI_Setting_Level_3_base");
  //write("Half_HMI_Setting_Level_3_base");
  
    sysSetVariableInt(sysvar::SysVar_PROXI::DIAG_ProxiLesen,1);
    testWaitForTimeout (200);
    sysSetVariableInt(sysvar::SysVar_PROXI::DIAG_ProxiLesen,0);
    testWaitForTimeout (200);
    sysSetVariableInt(sysvar::SysVar_PROXI::pByte126Bit12,Half_HMI_Setting_Level_3_base);		
    sysSetVariableInt(sysvar::SysVar_PROXI::DIAG_eLoadAll,1);
    testWaitForTimeout (200);
    sysSetVariableInt(sysvar::SysVar_PROXI::DIAG_eLoadAll,0);
testWaitForTimeout (2000);
    sysSetVariableInt(sysvar::SysVar_PROXI::DIAG_eSendProxi,1);
    testWaitForTimeout (200);
    sysSetVariableInt(sysvar::SysVar_PROXI::DIAG_eSendProxi,0);
    testWaitForTimeout (200);
				
}

	export testfunction Half_HMI_Setting_Level_4_other ()
{
  testModuleTitle("Half_HMI_Setting_Level_4_other");
  //write("Half_HMI_Setting_Level_4_other");
  
    sysSetVariableInt(sysvar::SysVar_PROXI::DIAG_ProxiLesen,1);
    testWaitForTimeout (200);
    sysSetVariableInt(sysvar::SysVar_PROXI::DIAG_ProxiLesen,0);
    testWaitForTimeout (200);
    sysSetVariableInt(sysvar::SysVar_PROXI::pByte126Bit12,Half_HMI_Setting_Level_4_other);		
    sysSetVariableInt(sysvar::SysVar_PROXI::DIAG_eLoadAll,1);
    testWaitForTimeout (200);
    sysSetVariableInt(sysvar::SysVar_PROXI::DIAG_eLoadAll,0);
testWaitForTimeout (2000);
    sysSetVariableInt(sysvar::SysVar_PROXI::DIAG_eSendProxi,1);
    testWaitForTimeout (200);
    sysSetVariableInt(sysvar::SysVar_PROXI::DIAG_eSendProxi,0);
    testWaitForTimeout (200);
				
}

	export testfunction Half_Torque_Sensibility_Level_1_absent ()
{
  testModuleTitle("Half_Torque_Sensibility_Level_1_absent");
  //write("Half_Torque_Sensibility_Level_1_absent");
  
    sysSetVariableInt(sysvar::SysVar_PROXI::DIAG_ProxiLesen,1);
    testWaitForTimeout (200);
    sysSetVariableInt(sysvar::SysVar_PROXI::DIAG_ProxiLesen,0);
    testWaitForTimeout (200);
    sysSetVariableInt(sysvar::SysVar_PROXI::pByte126Bit34,Half_Torque_Sensibility_Level_1_absent);		
    sysSetVariableInt(sysvar::SysVar_PROXI::DIAG_eLoadAll,1);
    testWaitForTimeout (200);
    sysSetVariableInt(sysvar::SysVar_PROXI::DIAG_eLoadAll,0);
testWaitForTimeout (2000);
    sysSetVariableInt(sysvar::SysVar_PROXI::DIAG_eSendProxi,1);
    testWaitForTimeout (200);
    sysSetVariableInt(sysvar::SysVar_PROXI::DIAG_eSendProxi,0);
    testWaitForTimeout (200);
				
}

	export testfunction Half_Torque_Sensibility_Level_2_full ()
{
  testModuleTitle("Half_Torque_Sensibility_Level_2_full");
  //write("Half_Torque_Sensibility_Level_2_full");
  
    sysSetVariableInt(sysvar::SysVar_PROXI::DIAG_ProxiLesen,1);
    testWaitForTimeout (200);
    sysSetVariableInt(sysvar::SysVar_PROXI::DIAG_ProxiLesen,0);
    testWaitForTimeout (200);
    sysSetVariableInt(sysvar::SysVar_PROXI::pByte126Bit34,Half_Torque_Sensibility_Level_2_full);		
    sysSetVariableInt(sysvar::SysVar_PROXI::DIAG_eLoadAll,1);
    testWaitForTimeout (200);
    sysSetVariableInt(sysvar::SysVar_PROXI::DIAG_eLoadAll,0);
testWaitForTimeout (2000);
    sysSetVariableInt(sysvar::SysVar_PROXI::DIAG_eSendProxi,1);
    testWaitForTimeout (200);
    sysSetVariableInt(sysvar::SysVar_PROXI::DIAG_eSendProxi,0);
    testWaitForTimeout (200);
				
}

	export testfunction Half_Torque_Sensibility_Level_3_base ()
{
  testModuleTitle("Half_Torque_Sensibility_Level_3_base");
  //write("Half_Torque_Sensibility_Level_3_base");
  
    sysSetVariableInt(sysvar::SysVar_PROXI::DIAG_ProxiLesen,1);
    testWaitForTimeout (200);
    sysSetVariableInt(sysvar::SysVar_PROXI::DIAG_ProxiLesen,0);
    testWaitForTimeout (200);
    sysSetVariableInt(sysvar::SysVar_PROXI::pByte126Bit34,Half_Torque_Sensibility_Level_3_base);		
    sysSetVariableInt(sysvar::SysVar_PROXI::DIAG_eLoadAll,1);
    testWaitForTimeout (200);
    sysSetVariableInt(sysvar::SysVar_PROXI::DIAG_eLoadAll,0);
testWaitForTimeout (2000);
    sysSetVariableInt(sysvar::SysVar_PROXI::DIAG_eSendProxi,1);
    testWaitForTimeout (200);
    sysSetVariableInt(sysvar::SysVar_PROXI::DIAG_eSendProxi,0);
    testWaitForTimeout (200);
				
}

	export testfunction Half_Torque_Sensibility_Level_4_other ()
{
  testModuleTitle("Half_Torque_Sensibility_Level_4_other");
  //write("Half_Torque_Sensibility_Level_4_other");
  
    sysSetVariableInt(sysvar::SysVar_PROXI::DIAG_ProxiLesen,1);
    testWaitForTimeout (200);
    sysSetVariableInt(sysvar::SysVar_PROXI::DIAG_ProxiLesen,0);
    testWaitForTimeout (200);
    sysSetVariableInt(sysvar::SysVar_PROXI::pByte126Bit34,Half_Torque_Sensibility_Level_4_other);		
    sysSetVariableInt(sysvar::SysVar_PROXI::DIAG_eLoadAll,1);
    testWaitForTimeout (200);
    sysSetVariableInt(sysvar::SysVar_PROXI::DIAG_eLoadAll,0);
testWaitForTimeout (2000);
    sysSetVariableInt(sysvar::SysVar_PROXI::DIAG_eSendProxi,1);
    testWaitForTimeout (200);
    sysSetVariableInt(sysvar::SysVar_PROXI::DIAG_eSendProxi,0);
    testWaitForTimeout (200);
				
}

	export testfunction Heated_Cold_Start_System_Absent ()
{
  testModuleTitle("Heated_Cold_Start_System_Absent");
  //write("Heated_Cold_Start_System_Absent");
  
    sysSetVariableInt(sysvar::SysVar_PROXI::DIAG_ProxiLesen,1);
    testWaitForTimeout (200);
    sysSetVariableInt(sysvar::SysVar_PROXI::DIAG_ProxiLesen,0);
    testWaitForTimeout (200);
    sysSetVariableInt(sysvar::SysVar_PROXI::pByte145Bit67,Heated_Cold_Start_System_Absent);		
    sysSetVariableInt(sysvar::SysVar_PROXI::DIAG_eLoadAll,1);
    testWaitForTimeout (200);
    sysSetVariableInt(sysvar::SysVar_PROXI::DIAG_eLoadAll,0);
testWaitForTimeout (2000);
    sysSetVariableInt(sysvar::SysVar_PROXI::DIAG_eSendProxi,1);
    testWaitForTimeout (200);
    sysSetVariableInt(sysvar::SysVar_PROXI::DIAG_eSendProxi,0);
    testWaitForTimeout (200);
				
}

	export testfunction Heated_Cold_Start_System_Glow_Plug ()
{
  testModuleTitle("Heated_Cold_Start_System_Glow_Plug");
  //write("Heated_Cold_Start_System_Glow_Plug");
  
    sysSetVariableInt(sysvar::SysVar_PROXI::DIAG_ProxiLesen,1);
    testWaitForTimeout (200);
    sysSetVariableInt(sysvar::SysVar_PROXI::DIAG_ProxiLesen,0);
    testWaitForTimeout (200);
    sysSetVariableInt(sysvar::SysVar_PROXI::pByte145Bit67,Heated_Cold_Start_System_Glow_Plug);		
    sysSetVariableInt(sysvar::SysVar_PROXI::DIAG_eLoadAll,1);
    testWaitForTimeout (200);
    sysSetVariableInt(sysvar::SysVar_PROXI::DIAG_eLoadAll,0);
testWaitForTimeout (2000);
    sysSetVariableInt(sysvar::SysVar_PROXI::DIAG_eSendProxi,1);
    testWaitForTimeout (200);
    sysSetVariableInt(sysvar::SysVar_PROXI::DIAG_eSendProxi,0);
    testWaitForTimeout (200);
				
}

	export testfunction Heated_Cold_Start_System_HCSS  ()
{
  testModuleTitle("Heated_Cold_Start_System_HCSS ");
  //write("Heated_Cold_Start_System_HCSS ");
  
    sysSetVariableInt(sysvar::SysVar_PROXI::DIAG_ProxiLesen,1);
    testWaitForTimeout (200);
    sysSetVariableInt(sysvar::SysVar_PROXI::DIAG_ProxiLesen,0);
    testWaitForTimeout (200);
    sysSetVariableInt(sysvar::SysVar_PROXI::pByte145Bit67,Heated_Cold_Start_System_HCSS );		
    sysSetVariableInt(sysvar::SysVar_PROXI::DIAG_eLoadAll,1);
    testWaitForTimeout (200);
    sysSetVariableInt(sysvar::SysVar_PROXI::DIAG_eLoadAll,0);
testWaitForTimeout (2000);
    sysSetVariableInt(sysvar::SysVar_PROXI::DIAG_eSendProxi,1);
    testWaitForTimeout (200);
    sysSetVariableInt(sysvar::SysVar_PROXI::DIAG_eSendProxi,0);
    testWaitForTimeout (200);
				
}

	export testfunction Heated_Cold_Start_System_Auxiliary_Fuel_Tank  ()
{
  testModuleTitle("Heated_Cold_Start_System_Auxiliary_Fuel_Tank ");
  //write("Heated_Cold_Start_System_Auxiliary_Fuel_Tank ");
  
    sysSetVariableInt(sysvar::SysVar_PROXI::DIAG_ProxiLesen,1);
    testWaitForTimeout (200);
    sysSetVariableInt(sysvar::SysVar_PROXI::DIAG_ProxiLesen,0);
    testWaitForTimeout (200);
    sysSetVariableInt(sysvar::SysVar_PROXI::pByte145Bit67,Heated_Cold_Start_System_Auxiliary_Fuel_Tank );		
    sysSetVariableInt(sysvar::SysVar_PROXI::DIAG_eLoadAll,1);
    testWaitForTimeout (200);
    sysSetVariableInt(sysvar::SysVar_PROXI::DIAG_eLoadAll,0);
testWaitForTimeout (2000);
    sysSetVariableInt(sysvar::SysVar_PROXI::DIAG_eSendProxi,1);
    testWaitForTimeout (200);
    sysSetVariableInt(sysvar::SysVar_PROXI::DIAG_eSendProxi,0);
    testWaitForTimeout (200);
				
}

//IPC_Theme_Selector pByte159Bit01234

	export testfunction Mirrors_System_Absent  ()
{
  testModuleTitle("Mirrors_System_Absent ");
  //write("Mirrors_System_Absent ");
  
    sysSetVariableInt(sysvar::SysVar_PROXI::DIAG_ProxiLesen,1);
    testWaitForTimeout (200);
    sysSetVariableInt(sysvar::SysVar_PROXI::DIAG_ProxiLesen,0);
    testWaitForTimeout (200);
    sysSetVariableInt(sysvar::SysVar_PROXI::pByte78Bit34,Mirrors_System_Absent );		
    sysSetVariableInt(sysvar::SysVar_PROXI::DIAG_eLoadAll,1);
    testWaitForTimeout (200);
    sysSetVariableInt(sysvar::SysVar_PROXI::DIAG_eLoadAll,0);
testWaitForTimeout (2000);
    sysSetVariableInt(sysvar::SysVar_PROXI::DIAG_eSendProxi,1);
    testWaitForTimeout (200);
    sysSetVariableInt(sysvar::SysVar_PROXI::DIAG_eSendProxi,0);
    testWaitForTimeout (200);
				
}

	export testfunction Mirrors_System_Standard ()
{
  testModuleTitle("Mirrors_System_Standard ");
  //write("Mirrors_System_Standard ");
  
    sysSetVariableInt(sysvar::SysVar_PROXI::DIAG_ProxiLesen,1);
    testWaitForTimeout (200);
    sysSetVariableInt(sysvar::SysVar_PROXI::DIAG_ProxiLesen,0);
    testWaitForTimeout (200);
    sysSetVariableInt(sysvar::SysVar_PROXI::pByte78Bit34,Mirrors_System_Standard );		
    sysSetVariableInt(sysvar::SysVar_PROXI::DIAG_eLoadAll,1);
    testWaitForTimeout (200);
    sysSetVariableInt(sysvar::SysVar_PROXI::DIAG_eLoadAll,0);
testWaitForTimeout (2000);
    sysSetVariableInt(sysvar::SysVar_PROXI::DIAG_eSendProxi,1);
    testWaitForTimeout (200);
    sysSetVariableInt(sysvar::SysVar_PROXI::DIAG_eSendProxi,0);
    testWaitForTimeout (200);
				
}

	export testfunction Mirrors_System_Passenger_Tilt ()
{
  testModuleTitle("Mirrors_System_Passenger_Tilt ");
  //write("Mirrors_System_Passenger_Tilt ");
  
    sysSetVariableInt(sysvar::SysVar_PROXI::DIAG_ProxiLesen,1);
    testWaitForTimeout (200);
    sysSetVariableInt(sysvar::SysVar_PROXI::DIAG_ProxiLesen,0);
    testWaitForTimeout (200);
    sysSetVariableInt(sysvar::SysVar_PROXI::pByte78Bit34,Mirrors_System_Passenger_Tilt );		
    sysSetVariableInt(sysvar::SysVar_PROXI::DIAG_eLoadAll,1);
    testWaitForTimeout (200);
    sysSetVariableInt(sysvar::SysVar_PROXI::DIAG_eLoadAll,0);
testWaitForTimeout (2000);
    sysSetVariableInt(sysvar::SysVar_PROXI::DIAG_eSendProxi,1);
    testWaitForTimeout (200);
    sysSetVariableInt(sysvar::SysVar_PROXI::DIAG_eSendProxi,0);
    testWaitForTimeout (200);
				
}

	export testfunction Mirrors_System_Memory ()
{
  testModuleTitle("Mirrors_System_Memory ");
  //write("Mirrors_System_Memory ");
  
    sysSetVariableInt(sysvar::SysVar_PROXI::DIAG_ProxiLesen,1);
    testWaitForTimeout (200);
    sysSetVariableInt(sysvar::SysVar_PROXI::DIAG_ProxiLesen,0);
    testWaitForTimeout (200);
    sysSetVariableInt(sysvar::SysVar_PROXI::pByte78Bit34,Mirrors_System_Memory );		
    sysSetVariableInt(sysvar::SysVar_PROXI::DIAG_eLoadAll,1);
    testWaitForTimeout (200);
    sysSetVariableInt(sysvar::SysVar_PROXI::DIAG_eLoadAll,0);
testWaitForTimeout (2000);
    sysSetVariableInt(sysvar::SysVar_PROXI::DIAG_eSendProxi,1);
    testWaitForTimeout (200);
    sysSetVariableInt(sysvar::SysVar_PROXI::DIAG_eSendProxi,0);
    testWaitForTimeout (200);
				
}

	export testfunction Number_Of_Doors_No_doors_Special_Version ()
{
  testModuleTitle("Number_Of_Doors_No_doors_Special_Version ");
  //write("Number_Of_Doors_No_doors_Special_Version ");
  
    sysSetVariableInt(sysvar::SysVar_PROXI::DIAG_ProxiLesen,1);
    testWaitForTimeout (200);
    sysSetVariableInt(sysvar::SysVar_PROXI::DIAG_ProxiLesen,0);
    testWaitForTimeout (200);
    sysSetVariableInt(sysvar::SysVar_PROXI::pByte69Bit01,Number_Of_Doors_No_doors_Special_Version );		
    sysSetVariableInt(sysvar::SysVar_PROXI::DIAG_eLoadAll,1);
    testWaitForTimeout (200);
    sysSetVariableInt(sysvar::SysVar_PROXI::DIAG_eLoadAll,0);
testWaitForTimeout (2000);
    sysSetVariableInt(sysvar::SysVar_PROXI::DIAG_eSendProxi,1);
    testWaitForTimeout (200);
    sysSetVariableInt(sysvar::SysVar_PROXI::DIAG_eSendProxi,0);
    testWaitForTimeout (200);
				
}

	export testfunction Number_Of_Doors_2_Doors ()
{
  testModuleTitle("Number_Of_Doors_2_Doors ");
  //write("Number_Of_Doors_2_Doors ");
  
    sysSetVariableInt(sysvar::SysVar_PROXI::DIAG_ProxiLesen,1);
    testWaitForTimeout (200);
    sysSetVariableInt(sysvar::SysVar_PROXI::DIAG_ProxiLesen,0);
    testWaitForTimeout (200);
    sysSetVariableInt(sysvar::SysVar_PROXI::pByte69Bit01,Number_Of_Doors_2_Doors );		
    sysSetVariableInt(sysvar::SysVar_PROXI::DIAG_eLoadAll,1);
    testWaitForTimeout (200);
    sysSetVariableInt(sysvar::SysVar_PROXI::DIAG_eLoadAll,0);
testWaitForTimeout (2000);
    sysSetVariableInt(sysvar::SysVar_PROXI::DIAG_eSendProxi,1);
    testWaitForTimeout (200);
    sysSetVariableInt(sysvar::SysVar_PROXI::DIAG_eSendProxi,0);
    testWaitForTimeout (200);
				
}

	export testfunction Number_Of_Doors_3_Doors ()
{
  testModuleTitle("Number_Of_Doors_3_Doors ");
  //write("Number_Of_Doors_3_Doors ");
  
    sysSetVariableInt(sysvar::SysVar_PROXI::DIAG_ProxiLesen,1);
    testWaitForTimeout (200);
    sysSetVariableInt(sysvar::SysVar_PROXI::DIAG_ProxiLesen,0);
    testWaitForTimeout (200);
    sysSetVariableInt(sysvar::SysVar_PROXI::pByte69Bit01,Number_Of_Doors_3_Doors );		
    sysSetVariableInt(sysvar::SysVar_PROXI::DIAG_eLoadAll,1);
    testWaitForTimeout (200);
    sysSetVariableInt(sysvar::SysVar_PROXI::DIAG_eLoadAll,0);
testWaitForTimeout (2000);
    sysSetVariableInt(sysvar::SysVar_PROXI::DIAG_eSendProxi,1);
    testWaitForTimeout (200);
    sysSetVariableInt(sysvar::SysVar_PROXI::DIAG_eSendProxi,0);
    testWaitForTimeout (200);
				
}

	export testfunction Number_Of_Doors_4_Doors ()
{
  testModuleTitle("Number_Of_Doors_4_Doors ");
  //write("Number_Of_Doors_4_Doors ");
  
    sysSetVariableInt(sysvar::SysVar_PROXI::DIAG_ProxiLesen,1);
    testWaitForTimeout (200);
    sysSetVariableInt(sysvar::SysVar_PROXI::DIAG_ProxiLesen,0);
    testWaitForTimeout (200);
    sysSetVariableInt(sysvar::SysVar_PROXI::pByte69Bit01,Number_Of_Doors_4_Doors );		
    sysSetVariableInt(sysvar::SysVar_PROXI::DIAG_eLoadAll,1);
    testWaitForTimeout (200);
    sysSetVariableInt(sysvar::SysVar_PROXI::DIAG_eLoadAll,0);
testWaitForTimeout (2000);
    sysSetVariableInt(sysvar::SysVar_PROXI::DIAG_eSendProxi,1);
    testWaitForTimeout (200);
    sysSetVariableInt(sysvar::SysVar_PROXI::DIAG_eSendProxi,0);
    testWaitForTimeout (200);
				
}

	export testfunction RRM_VP_LEVEL_Absent_RRU ()
{
  testModuleTitle("RRM_VP_LEVEL_Absent_RRU ");
  //write("RRM_VP_LEVEL_Absent_RRU ");
  
    sysSetVariableInt(sysvar::SysVar_PROXI::DIAG_ProxiLesen,1);
    testWaitForTimeout (200);
    sysSetVariableInt(sysvar::SysVar_PROXI::DIAG_ProxiLesen,0);
    testWaitForTimeout (200);
    sysSetVariableInt(sysvar::SysVar_PROXI::pByte111Bit0123,RRM_VP_LEVEL_Absent_RRU );		
    sysSetVariableInt(sysvar::SysVar_PROXI::DIAG_eLoadAll,1);
    testWaitForTimeout (200);
    sysSetVariableInt(sysvar::SysVar_PROXI::DIAG_eLoadAll,0);
testWaitForTimeout (2000);
    sysSetVariableInt(sysvar::SysVar_PROXI::DIAG_eSendProxi,1);
    testWaitForTimeout (200);
    sysSetVariableInt(sysvar::SysVar_PROXI::DIAG_eSendProxi,0);
    testWaitForTimeout (200);
				
}

	export testfunction RRM_VP_LEVEL_Level_1_VP1_B7 ()
{
  testModuleTitle("RRM_VP_LEVEL_Level_1_VP1_B7 ");
  //write("RRM_VP_LEVEL_Level_1_VP1_B7 ");
  
    sysSetVariableInt(sysvar::SysVar_PROXI::DIAG_ProxiLesen,1);
    testWaitForTimeout (200);
    sysSetVariableInt(sysvar::SysVar_PROXI::DIAG_ProxiLesen,0);
    testWaitForTimeout (200);
    sysSetVariableInt(sysvar::SysVar_PROXI::pByte111Bit0123,RRM_VP_LEVEL_Level_1_VP1_B7 );		
    sysSetVariableInt(sysvar::SysVar_PROXI::DIAG_eLoadAll,1);
    testWaitForTimeout (200);
    sysSetVariableInt(sysvar::SysVar_PROXI::DIAG_eLoadAll,0);
testWaitForTimeout (2000);
    sysSetVariableInt(sysvar::SysVar_PROXI::DIAG_eSendProxi,1);
    testWaitForTimeout (200);
    sysSetVariableInt(sysvar::SysVar_PROXI::DIAG_eSendProxi,0);
    testWaitForTimeout (200);
				
}

	export testfunction RRM_VP_LEVEL_Level_2_VP2 ()
{
  testModuleTitle("RRM_VP_LEVEL_Level_2_VP2 ");
  //write("RRM_VP_LEVEL_Level_2_VP2 ");
  
    sysSetVariableInt(sysvar::SysVar_PROXI::DIAG_ProxiLesen,1);
    testWaitForTimeout (200);
    sysSetVariableInt(sysvar::SysVar_PROXI::DIAG_ProxiLesen,0);
    testWaitForTimeout (200);
    sysSetVariableInt(sysvar::SysVar_PROXI::pByte111Bit0123,RRM_VP_LEVEL_Level_2_VP2 );		
    sysSetVariableInt(sysvar::SysVar_PROXI::DIAG_eLoadAll,1);
    testWaitForTimeout (200);
    sysSetVariableInt(sysvar::SysVar_PROXI::DIAG_eLoadAll,0);
testWaitForTimeout (2000);
    sysSetVariableInt(sysvar::SysVar_PROXI::DIAG_eSendProxi,1);
    testWaitForTimeout (200);
    sysSetVariableInt(sysvar::SysVar_PROXI::DIAG_eSendProxi,0);
    testWaitForTimeout (200);
				
}

	export testfunction RRM_VP_LEVEL_Level_3_VP3 ()
{
  testModuleTitle("RRM_VP_LEVEL_Level_3_VP3 ");
  //write("RRM_VP_LEVEL_Level_3_VP3 ");
  
    sysSetVariableInt(sysvar::SysVar_PROXI::DIAG_ProxiLesen,1);
    testWaitForTimeout (200);
    sysSetVariableInt(sysvar::SysVar_PROXI::DIAG_ProxiLesen,0);
    testWaitForTimeout (200);
    sysSetVariableInt(sysvar::SysVar_PROXI::pByte111Bit0123,RRM_VP_LEVEL_Level_3_VP3 );		
    sysSetVariableInt(sysvar::SysVar_PROXI::DIAG_eLoadAll,1);
    testWaitForTimeout (200);
    sysSetVariableInt(sysvar::SysVar_PROXI::DIAG_eLoadAll,0);
testWaitForTimeout (2000);
    sysSetVariableInt(sysvar::SysVar_PROXI::DIAG_eSendProxi,1);
    testWaitForTimeout (200);
    sysSetVariableInt(sysvar::SysVar_PROXI::DIAG_eSendProxi,0);
    testWaitForTimeout (200);
				
}

	export testfunction RRM_VP_LEVEL_Level_4_VP4 ()
{
  testModuleTitle("RRM_VP_LEVEL_Level_4_VP4 ");
  //write("RRM_VP_LEVEL_Level_4_VP4 ");
  
    sysSetVariableInt(sysvar::SysVar_PROXI::DIAG_ProxiLesen,1);
    testWaitForTimeout (200);
    sysSetVariableInt(sysvar::SysVar_PROXI::DIAG_ProxiLesen,0);
    testWaitForTimeout (200);
    sysSetVariableInt(sysvar::SysVar_PROXI::pByte111Bit0123,RRM_VP_LEVEL_Level_4_VP4 );		
    sysSetVariableInt(sysvar::SysVar_PROXI::DIAG_eLoadAll,1);
    testWaitForTimeout (200);
    sysSetVariableInt(sysvar::SysVar_PROXI::DIAG_eLoadAll,0);
testWaitForTimeout (2000);
    sysSetVariableInt(sysvar::SysVar_PROXI::DIAG_eSendProxi,1);
    testWaitForTimeout (200);
    sysSetVariableInt(sysvar::SysVar_PROXI::DIAG_eSendProxi,0);
    testWaitForTimeout (200);
				
}

	export testfunction RRM_VP_LEVEL_Radio_High_Level ()
{
  testModuleTitle("RRM_VP_LEVEL_Radio_High_Level ");
  //write("RRM_VP_LEVEL_Radio_High_Level ");
  
    sysSetVariableInt(sysvar::SysVar_PROXI::DIAG_ProxiLesen,1);
    testWaitForTimeout (200);
    sysSetVariableInt(sysvar::SysVar_PROXI::DIAG_ProxiLesen,0);
    testWaitForTimeout (200);
    sysSetVariableInt(sysvar::SysVar_PROXI::pByte111Bit0123,RRM_VP_LEVEL_Radio_High_Level);		
    sysSetVariableInt(sysvar::SysVar_PROXI::DIAG_eLoadAll,1);
    testWaitForTimeout (200);
    sysSetVariableInt(sysvar::SysVar_PROXI::DIAG_eLoadAll,0);
testWaitForTimeout (2000);
    sysSetVariableInt(sysvar::SysVar_PROXI::DIAG_eSendProxi,1);
    testWaitForTimeout (200);
    sysSetVariableInt(sysvar::SysVar_PROXI::DIAG_eSendProxi,0);
    testWaitForTimeout (200);
				
}

	export testfunction RRM_VPx_Steering_Wheel_Absent ()
{
  testModuleTitle("RRM_VPx_Steering_Wheel_Absent ");
  //write("RRM_VPx_Steering_Wheel_Absent ");
  
    sysSetVariableInt(sysvar::SysVar_PROXI::DIAG_ProxiLesen,1);
    testWaitForTimeout (200);
    sysSetVariableInt(sysvar::SysVar_PROXI::DIAG_ProxiLesen,0);
    testWaitForTimeout (200);
    sysSetVariableInt(sysvar::SysVar_PROXI::pByte117Bit456,RRM_VPx_Steering_Wheel_Absent);		
    sysSetVariableInt(sysvar::SysVar_PROXI::DIAG_eLoadAll,1);
    testWaitForTimeout (200);
    sysSetVariableInt(sysvar::SysVar_PROXI::DIAG_eLoadAll,0);
testWaitForTimeout (2000);
    sysSetVariableInt(sysvar::SysVar_PROXI::DIAG_eSendProxi,1);
    testWaitForTimeout (200);
    sysSetVariableInt(sysvar::SysVar_PROXI::DIAG_eSendProxi,0);
    testWaitForTimeout (200);
				
}

	export testfunction RRM_VPx_Steering_Wheel_08_LIN_Front_Button ()
{
  testModuleTitle("RRM_VPx_Steering_Wheel_08_LIN_Front_Button ");
  //write("RRM_VPx_Steering_Wheel_08_LIN_Front_Button ");
  
    sysSetVariableInt(sysvar::SysVar_PROXI::DIAG_ProxiLesen,1);
    testWaitForTimeout (200);
    sysSetVariableInt(sysvar::SysVar_PROXI::DIAG_ProxiLesen,0);
    testWaitForTimeout (200);
    sysSetVariableInt(sysvar::SysVar_PROXI::pByte117Bit456,RRM_VPx_Steering_Wheel_08_LIN_Front_Button);		
    sysSetVariableInt(sysvar::SysVar_PROXI::DIAG_eLoadAll,1);
    testWaitForTimeout (200);
    sysSetVariableInt(sysvar::SysVar_PROXI::DIAG_eLoadAll,0);
testWaitForTimeout (2000);
    sysSetVariableInt(sysvar::SysVar_PROXI::DIAG_eSendProxi,1);
    testWaitForTimeout (200);
    sysSetVariableInt(sysvar::SysVar_PROXI::DIAG_eSendProxi,0);
    testWaitForTimeout (200);
				
}

	export testfunction RRM_VPx_Steering_Wheel_14_LIN_button_EMEA ()
{
  testModuleTitle("RRM_VPx_Steering_Wheel_14_LIN_button_EMEA ");
  //write("RRM_VPx_Steering_Wheel_14_LIN_button_EMEA ");
  
    sysSetVariableInt(sysvar::SysVar_PROXI::DIAG_ProxiLesen,1);
    testWaitForTimeout (200);
    sysSetVariableInt(sysvar::SysVar_PROXI::DIAG_ProxiLesen,0);
    testWaitForTimeout (200);
    sysSetVariableInt(sysvar::SysVar_PROXI::pByte117Bit456,RRM_VPx_Steering_Wheel_14_LIN_button_EMEA);		
    sysSetVariableInt(sysvar::SysVar_PROXI::DIAG_eLoadAll,1);
    testWaitForTimeout (200);
    sysSetVariableInt(sysvar::SysVar_PROXI::DIAG_eLoadAll,0);
testWaitForTimeout (2000);
    sysSetVariableInt(sysvar::SysVar_PROXI::DIAG_eSendProxi,1);
    testWaitForTimeout (200);
    sysSetVariableInt(sysvar::SysVar_PROXI::DIAG_eSendProxi,0);
    testWaitForTimeout (200);
				
}

	export testfunction RRM_VPx_Steering_Wheel_14_LIN_button_NAFTA ()
{
  testModuleTitle("RRM_VPx_Steering_Wheel_14_LIN_button_NAFTA ");
  //write("RRM_VPx_Steering_Wheel_14_LIN_button_NAFTA ");
  
    sysSetVariableInt(sysvar::SysVar_PROXI::DIAG_ProxiLesen,1);
    testWaitForTimeout (200);
    sysSetVariableInt(sysvar::SysVar_PROXI::DIAG_ProxiLesen,0);
    testWaitForTimeout (200);
    sysSetVariableInt(sysvar::SysVar_PROXI::pByte117Bit456,RRM_VPx_Steering_Wheel_14_LIN_button_NAFTA);		
    sysSetVariableInt(sysvar::SysVar_PROXI::DIAG_eLoadAll,1);
    testWaitForTimeout (200);
    sysSetVariableInt(sysvar::SysVar_PROXI::DIAG_eLoadAll,0);
testWaitForTimeout (2000);
    sysSetVariableInt(sysvar::SysVar_PROXI::DIAG_eSendProxi,1);
    testWaitForTimeout (200);
    sysSetVariableInt(sysvar::SysVar_PROXI::DIAG_eSendProxi,0);
    testWaitForTimeout (200);
				
}

	export testfunction Siren_Absent ()
{
  testModuleTitle("Siren_Absent ");
  //write("Siren_Absent ");
  
    sysSetVariableInt(sysvar::SysVar_PROXI::DIAG_ProxiLesen,1);
    testWaitForTimeout (200);
    sysSetVariableInt(sysvar::SysVar_PROXI::DIAG_ProxiLesen,0);
    testWaitForTimeout (200);
    sysSetVariableInt(sysvar::SysVar_PROXI::pByte117Bit456,Siren_Absent);		
    sysSetVariableInt(sysvar::SysVar_PROXI::DIAG_eLoadAll,1);
    testWaitForTimeout (200);
    sysSetVariableInt(sysvar::SysVar_PROXI::DIAG_eLoadAll,0);
testWaitForTimeout (2000);
    sysSetVariableInt(sysvar::SysVar_PROXI::DIAG_eSendProxi,1);
    testWaitForTimeout (200);
    sysSetVariableInt(sysvar::SysVar_PROXI::DIAG_eSendProxi,0);
    testWaitForTimeout (200);
				
}

	export testfunction Siren_Horn ()
{
  testModuleTitle("Siren_Horn ");
  //write("Siren_Horn ");
  
    sysSetVariableInt(sysvar::SysVar_PROXI::DIAG_ProxiLesen,1);
    testWaitForTimeout (200);
    sysSetVariableInt(sysvar::SysVar_PROXI::DIAG_ProxiLesen,0);
    testWaitForTimeout (200);
    sysSetVariableInt(sysvar::SysVar_PROXI::pByte117Bit456,Siren_Horn);		
    sysSetVariableInt(sysvar::SysVar_PROXI::DIAG_eLoadAll,1);
    testWaitForTimeout (200);
    sysSetVariableInt(sysvar::SysVar_PROXI::DIAG_eLoadAll,0);
testWaitForTimeout (2000);
    sysSetVariableInt(sysvar::SysVar_PROXI::DIAG_eSendProxi,1);
    testWaitForTimeout (200);
    sysSetVariableInt(sysvar::SysVar_PROXI::DIAG_eSendProxi,0);
    testWaitForTimeout (200);
				
}

export testfunction Siren_Siren ()
{
  testModuleTitle("Siren_Siren ");
  //write("Siren_Siren ");
  
    sysSetVariableInt(sysvar::SysVar_PROXI::DIAG_ProxiLesen,1);
    testWaitForTimeout (200);
    sysSetVariableInt(sysvar::SysVar_PROXI::DIAG_ProxiLesen,0);
    testWaitForTimeout (200);
    sysSetVariableInt(sysvar::SysVar_PROXI::pByte117Bit456,Siren_Siren);		
    sysSetVariableInt(sysvar::SysVar_PROXI::DIAG_eLoadAll,1);
    testWaitForTimeout (200);
    sysSetVariableInt(sysvar::SysVar_PROXI::DIAG_eLoadAll,0);
testWaitForTimeout (2000);
    sysSetVariableInt(sysvar::SysVar_PROXI::DIAG_eSendProxi,1);
    testWaitForTimeout (200);
    sysSetVariableInt(sysvar::SysVar_PROXI::DIAG_eSendProxi,0);
    testWaitForTimeout (200);
				
}

	export testfunction Siren_Not_Used ()
{
  testModuleTitle("Siren_Not_Used ");
  //write("Siren_Not_Used ");
  
    sysSetVariableInt(sysvar::SysVar_PROXI::DIAG_ProxiLesen,1);
    testWaitForTimeout (200);
    sysSetVariableInt(sysvar::SysVar_PROXI::DIAG_ProxiLesen,0);
    testWaitForTimeout (200);
    sysSetVariableInt(sysvar::SysVar_PROXI::pByte117Bit456,Siren_Not_Used);		
    sysSetVariableInt(sysvar::SysVar_PROXI::DIAG_eLoadAll,1);
    testWaitForTimeout (200);
    sysSetVariableInt(sysvar::SysVar_PROXI::DIAG_eLoadAll,0);
testWaitForTimeout (2000);
    sysSetVariableInt(sysvar::SysVar_PROXI::DIAG_eSendProxi,1);
    testWaitForTimeout (200);
    sysSetVariableInt(sysvar::SysVar_PROXI::DIAG_eSendProxi,0);
    testWaitForTimeout (200);
				
}

//Special_Package_VP

	export testfunction Special_Package_VP_None ()
{
  testModuleTitle("Special_Package_VP_None ");
  //write("Special_Package_VP_None ");
  
    sysSetVariableInt(sysvar::SysVar_PROXI::DIAG_ProxiLesen,1);
    testWaitForTimeout (200);
    sysSetVariableInt(sysvar::SysVar_PROXI::DIAG_ProxiLesen,0);
    testWaitForTimeout (200);
    sysSetVariableInt(sysvar::SysVar_PROXI::pByte137,Special_Package_VP_None);		
    sysSetVariableInt(sysvar::SysVar_PROXI::DIAG_eLoadAll,1);
    testWaitForTimeout (200);
    sysSetVariableInt(sysvar::SysVar_PROXI::DIAG_eLoadAll,0);
testWaitForTimeout (2000);
    sysSetVariableInt(sysvar::SysVar_PROXI::DIAG_eSendProxi,1);
    testWaitForTimeout (200);
    sysSetVariableInt(sysvar::SysVar_PROXI::DIAG_eSendProxi,0);
    testWaitForTimeout (200);
				
}

	export testfunction Special_Package_VP_Theme_1 ()
{
  testModuleTitle("Special_Package_VP_Theme_1 ");
  //write("Special_Package_VP_Theme_1 ");
  
    sysSetVariableInt(sysvar::SysVar_PROXI::DIAG_ProxiLesen,1);
    testWaitForTimeout (200);
    sysSetVariableInt(sysvar::SysVar_PROXI::DIAG_ProxiLesen,0);
    testWaitForTimeout (200);
    sysSetVariableInt(sysvar::SysVar_PROXI::pByte137,Special_Package_VP_Theme_1);		
    sysSetVariableInt(sysvar::SysVar_PROXI::DIAG_eLoadAll,1);
    testWaitForTimeout (200);
    sysSetVariableInt(sysvar::SysVar_PROXI::DIAG_eLoadAll,0);
testWaitForTimeout (2000);
    sysSetVariableInt(sysvar::SysVar_PROXI::DIAG_eSendProxi,1);
    testWaitForTimeout (200);
    sysSetVariableInt(sysvar::SysVar_PROXI::DIAG_eSendProxi,0);
    testWaitForTimeout (200);
				
}

	export testfunction Special_Package_VP_Theme_2 ()
{
  testModuleTitle("Special_Package_VP_Theme_2 ");
  //write("Special_Package_VP_Theme_2 ");
  
    sysSetVariableInt(sysvar::SysVar_PROXI::DIAG_ProxiLesen,1);
    testWaitForTimeout (200);
    sysSetVariableInt(sysvar::SysVar_PROXI::DIAG_ProxiLesen,0);
    testWaitForTimeout (200);
    sysSetVariableInt(sysvar::SysVar_PROXI::pByte137,Special_Package_VP_Theme_2);		
    sysSetVariableInt(sysvar::SysVar_PROXI::DIAG_eLoadAll,1);
    testWaitForTimeout (200);
    sysSetVariableInt(sysvar::SysVar_PROXI::DIAG_eLoadAll,0);
testWaitForTimeout (2000);
    sysSetVariableInt(sysvar::SysVar_PROXI::DIAG_eSendProxi,1);
    testWaitForTimeout (200);
    sysSetVariableInt(sysvar::SysVar_PROXI::DIAG_eSendProxi,0);
    testWaitForTimeout (200);
				
}

	export testfunction Steering_Ratio_Rack_Pinion_Type_15_7 ()
{
  testModuleTitle("Steering_Ratio_Rack_Pinion_Type_15_7 ");
  //write("Steering_Ratio_Rack_Pinion_Type_15_7 ");
  
    sysSetVariableInt(sysvar::SysVar_PROXI::DIAG_ProxiLesen,1);
    testWaitForTimeout (200);
    sysSetVariableInt(sysvar::SysVar_PROXI::DIAG_ProxiLesen,0);
    testWaitForTimeout (200);
    sysSetVariableInt(sysvar::SysVar_PROXI::pByte88Bit01,Steering_Ratio_Rack_Pinion_Type_15_7);		
    sysSetVariableInt(sysvar::SysVar_PROXI::DIAG_eLoadAll,1);
    testWaitForTimeout (200);
    sysSetVariableInt(sysvar::SysVar_PROXI::DIAG_eLoadAll,0);
testWaitForTimeout (2000);
    sysSetVariableInt(sysvar::SysVar_PROXI::DIAG_eSendProxi,1);
    testWaitForTimeout (200);
    sysSetVariableInt(sysvar::SysVar_PROXI::DIAG_eSendProxi,0);
    testWaitForTimeout (200);
				
}

	export testfunction Stop_And_Start_Type_FGA_Type ()
{
  testModuleTitle("Stop_And_Start_Type_FGA_Type ");
  //write("Stop_And_Start_Type_FGA_Type ");
  
    sysSetVariableInt(sysvar::SysVar_PROXI::DIAG_ProxiLesen,1);
    testWaitForTimeout (200);
    sysSetVariableInt(sysvar::SysVar_PROXI::DIAG_ProxiLesen,0);
    testWaitForTimeout (200);
    sysSetVariableInt(sysvar::SysVar_PROXI::pByte88Bit01,Stop_And_Start_Type_FGA_Type);		
    sysSetVariableInt(sysvar::SysVar_PROXI::DIAG_eLoadAll,1);
    testWaitForTimeout (200);
    sysSetVariableInt(sysvar::SysVar_PROXI::DIAG_eLoadAll,0);
testWaitForTimeout (2000);
    sysSetVariableInt(sysvar::SysVar_PROXI::DIAG_eSendProxi,1);
    testWaitForTimeout (200);
    sysSetVariableInt(sysvar::SysVar_PROXI::DIAG_eSendProxi,0);
    testWaitForTimeout (200);
				
}

	export testfunction Stop_And_Start_Type_CG_Type ()
{
  testModuleTitle("Stop_And_Start_Type_CG_Type ");
  //write("Stop_And_Start_Type_CG_Type ");
  
    sysSetVariableInt(sysvar::SysVar_PROXI::DIAG_ProxiLesen,1);
    testWaitForTimeout (200);
    sysSetVariableInt(sysvar::SysVar_PROXI::DIAG_ProxiLesen,0);
    testWaitForTimeout (200);
    sysSetVariableInt(sysvar::SysVar_PROXI::pByte88Bit01,Stop_And_Start_Type_CG_Type);		
    sysSetVariableInt(sysvar::SysVar_PROXI::DIAG_eLoadAll,1);
    testWaitForTimeout (200);
    sysSetVariableInt(sysvar::SysVar_PROXI::DIAG_eLoadAll,0);
testWaitForTimeout (2000);
    sysSetVariableInt(sysvar::SysVar_PROXI::DIAG_eSendProxi,1);
    testWaitForTimeout (200);
    sysSetVariableInt(sysvar::SysVar_PROXI::DIAG_eSendProxi,0);
    testWaitForTimeout (200);
				
}

export testfunction CMRIF_01 ()
{
  testModuleTitle("CMRIF_01");
  //write("CMRIF_01");
  
    sysSetVariableInt(sysvar::SysVar_PROXI::DIAG_ProxiLesen,1);
    testWaitForTimeout (200);
    sysSetVariableInt(sysvar::SysVar_PROXI::DIAG_ProxiLesen,0);
    testWaitForTimeout (200);
		sysSetVariableInt(sysvar::SysVar_PROXI::pByte76Bit4567,CMRIF_01);		
		sysSetVariableInt(sysvar::SysVar_PROXI::DIAG_eLoadAll,1);
    testWaitForTimeout (200);
    sysSetVariableInt(sysvar::SysVar_PROXI::DIAG_eLoadAll,0);
testWaitForTimeout (2000);
		sysSetVariableInt(sysvar::SysVar_PROXI::DIAG_eSendProxi,1);
    testWaitForTimeout (200);
    sysSetVariableInt(sysvar::SysVar_PROXI::DIAG_eSendProxi,0);
    testWaitForTimeout (200);
				
}

export testfunction CMRIF_02 ()
{
  testModuleTitle("CMRIF_02");
  //write("CMRIF_02");
  
    sysSetVariableInt(sysvar::SysVar_PROXI::DIAG_ProxiLesen,1);
    testWaitForTimeout (200);
    sysSetVariableInt(sysvar::SysVar_PROXI::DIAG_ProxiLesen,0);
    testWaitForTimeout (200);
		sysSetVariableInt(sysvar::SysVar_PROXI::pByte76Bit4567,CMRIF_02);		
		sysSetVariableInt(sysvar::SysVar_PROXI::DIAG_eLoadAll,1);
    testWaitForTimeout (200);
    sysSetVariableInt(sysvar::SysVar_PROXI::DIAG_eLoadAll,0);
testWaitForTimeout (2000);
		sysSetVariableInt(sysvar::SysVar_PROXI::DIAG_eSendProxi,1);
    testWaitForTimeout (200);
    sysSetVariableInt(sysvar::SysVar_PROXI::DIAG_eSendProxi,0);
    testWaitForTimeout (200);
				
}

export testfunction CMRIF_03 ()
{
  testModuleTitle("CMRIF_03");
  //write("CMRIF_03");
  
    sysSetVariableInt(sysvar::SysVar_PROXI::DIAG_ProxiLesen,1);
    testWaitForTimeout (200);
    sysSetVariableInt(sysvar::SysVar_PROXI::DIAG_ProxiLesen,0);
    testWaitForTimeout (200);
		sysSetVariableInt(sysvar::SysVar_PROXI::pByte76Bit4567,CMRIF_03);		
		sysSetVariableInt(sysvar::SysVar_PROXI::DIAG_eLoadAll,1);
    testWaitForTimeout (200);
    sysSetVariableInt(sysvar::SysVar_PROXI::DIAG_eLoadAll,0);
testWaitForTimeout (2000);
		sysSetVariableInt(sysvar::SysVar_PROXI::DIAG_eSendProxi,1);
    testWaitForTimeout (200);
    sysSetVariableInt(sysvar::SysVar_PROXI::DIAG_eSendProxi,0);
    testWaitForTimeout (200);
				
}

export testfunction CMRIF_04 ()
{
  testModuleTitle("CMRIF_04");
  //write("CMRIF_04");
  
    sysSetVariableInt(sysvar::SysVar_PROXI::DIAG_ProxiLesen,1);
    testWaitForTimeout (200);
    sysSetVariableInt(sysvar::SysVar_PROXI::DIAG_ProxiLesen,0);
    testWaitForTimeout (200);
		sysSetVariableInt(sysvar::SysVar_PROXI::pByte76Bit4567,CMRIF_04);		
		sysSetVariableInt(sysvar::SysVar_PROXI::DIAG_eLoadAll,1);
    testWaitForTimeout (200);
    sysSetVariableInt(sysvar::SysVar_PROXI::DIAG_eLoadAll,0);
testWaitForTimeout (2000);
		sysSetVariableInt(sysvar::SysVar_PROXI::DIAG_eSendProxi,1);
    testWaitForTimeout (200);
    sysSetVariableInt(sysvar::SysVar_PROXI::DIAG_eSendProxi,0);
    testWaitForTimeout (200);
				
}


export testfunction CMRIF_05 ()
{
  testModuleTitle("CMRIF_05");
  //write("CMRIF_05");
  
    sysSetVariableInt(sysvar::SysVar_PROXI::DIAG_ProxiLesen,1);
    testWaitForTimeout (200);
    sysSetVariableInt(sysvar::SysVar_PROXI::DIAG_ProxiLesen,0);
    testWaitForTimeout (200);
		sysSetVariableInt(sysvar::SysVar_PROXI::pByte76Bit4567,CMRIF_05);		
		sysSetVariableInt(sysvar::SysVar_PROXI::DIAG_eLoadAll,1);
    testWaitForTimeout (200);
    sysSetVariableInt(sysvar::SysVar_PROXI::DIAG_eLoadAll,0);
testWaitForTimeout (2000);
		sysSetVariableInt(sysvar::SysVar_PROXI::DIAG_eSendProxi,1);
    testWaitForTimeout (200);
    sysSetVariableInt(sysvar::SysVar_PROXI::DIAG_eSendProxi,0);
    testWaitForTimeout (200);
				
}

export testfunction CMRIF_06 ()
{
  testModuleTitle("CMRIF_06");
  //write("CMRIF_06");
  
    sysSetVariableInt(sysvar::SysVar_PROXI::DIAG_ProxiLesen,1);
    testWaitForTimeout (200);
    sysSetVariableInt(sysvar::SysVar_PROXI::DIAG_ProxiLesen,0);
    testWaitForTimeout (200);
		sysSetVariableInt(sysvar::SysVar_PROXI::pByte76Bit4567,CMRIF_06);		
		sysSetVariableInt(sysvar::SysVar_PROXI::DIAG_eLoadAll,1);
    testWaitForTimeout (200);
    sysSetVariableInt(sysvar::SysVar_PROXI::DIAG_eLoadAll,0);
testWaitForTimeout (2000);
		sysSetVariableInt(sysvar::SysVar_PROXI::DIAG_eSendProxi,1);
    testWaitForTimeout (200);
    sysSetVariableInt(sysvar::SysVar_PROXI::DIAG_eSendProxi,0);
    testWaitForTimeout (200);
				
}

export testfunction CMRIF_07 ()
{
  testModuleTitle("CMRIF_07");
  //write("CMRIF_07");
  
    sysSetVariableInt(sysvar::SysVar_PROXI::DIAG_ProxiLesen,1);
    testWaitForTimeout (200);
    sysSetVariableInt(sysvar::SysVar_PROXI::DIAG_ProxiLesen,0);
    testWaitForTimeout (200);
		sysSetVariableInt(sysvar::SysVar_PROXI::pByte76Bit4567,CMRIF_07);		
		sysSetVariableInt(sysvar::SysVar_PROXI::DIAG_eLoadAll,1);
    testWaitForTimeout (200);
    sysSetVariableInt(sysvar::SysVar_PROXI::DIAG_eLoadAll,0);
testWaitForTimeout (2000);
		sysSetVariableInt(sysvar::SysVar_PROXI::DIAG_eSendProxi,1);
    testWaitForTimeout (200);
    sysSetVariableInt(sysvar::SysVar_PROXI::DIAG_eSendProxi,0);
    testWaitForTimeout (200);
				
}

export testfunction CMRIF_08 ()
{
  testModuleTitle("CMRIF_08");
  //write("CMRIF_08");
  
    sysSetVariableInt(sysvar::SysVar_PROXI::DIAG_ProxiLesen,1);
    testWaitForTimeout (200);
    sysSetVariableInt(sysvar::SysVar_PROXI::DIAG_ProxiLesen,0);
    testWaitForTimeout (200);
		sysSetVariableInt(sysvar::SysVar_PROXI::pByte76Bit4567,CMRIF_08);		
		sysSetVariableInt(sysvar::SysVar_PROXI::DIAG_eLoadAll,1);
    testWaitForTimeout (200);
    sysSetVariableInt(sysvar::SysVar_PROXI::DIAG_eLoadAll,0);
testWaitForTimeout (2000);
		sysSetVariableInt(sysvar::SysVar_PROXI::DIAG_eSendProxi,1);
    testWaitForTimeout (200);
    sysSetVariableInt(sysvar::SysVar_PROXI::DIAG_eSendProxi,0);
    testWaitForTimeout (200);
				
}

export testfunction CMRIF_09 ()
{
  testModuleTitle("CMRIF_09");
  //write("CMRIF_09");
  
    sysSetVariableInt(sysvar::SysVar_PROXI::DIAG_ProxiLesen,1);
    testWaitForTimeout (200);
    sysSetVariableInt(sysvar::SysVar_PROXI::DIAG_ProxiLesen,0);
    testWaitForTimeout (200);
		sysSetVariableInt(sysvar::SysVar_PROXI::pByte76Bit4567,CMRIF_09);		
		sysSetVariableInt(sysvar::SysVar_PROXI::DIAG_eLoadAll,1);
    testWaitForTimeout (200);
    sysSetVariableInt(sysvar::SysVar_PROXI::DIAG_eLoadAll,0);
testWaitForTimeout (2000);
		sysSetVariableInt(sysvar::SysVar_PROXI::DIAG_eSendProxi,1);
    testWaitForTimeout (200);
    sysSetVariableInt(sysvar::SysVar_PROXI::DIAG_eSendProxi,0);
    testWaitForTimeout (200);
				
}

export testfunction N_ServiceCouponLim_0 ()
{
  testModuleTitle("N_ServiceCouponLim_0 ");
  //write("N_ServiceCouponLim_0 ");
  
    sysSetVariableInt(sysvar::SysVar_PROXI::DIAG_ProxiLesen,1);
    testWaitForTimeout (200);
    sysSetVariableInt(sysvar::SysVar_PROXI::DIAG_ProxiLesen,0);
    testWaitForTimeout (200);
	  sysSetVariableInt(sysvar::SysVar_PROXI::pByte74Bit4567,N_ServiceCouponLim_0 );		
	  sysSetVariableInt(sysvar::SysVar_PROXI::DIAG_eLoadAll,1);
    testWaitForTimeout (200);
    sysSetVariableInt(sysvar::SysVar_PROXI::DIAG_eLoadAll,0);
testWaitForTimeout (2000);
	  sysSetVariableInt(sysvar::SysVar_PROXI::DIAG_eSendProxi,1);
    testWaitForTimeout (200);
    sysSetVariableInt(sysvar::SysVar_PROXI::DIAG_eSendProxi,0);
    testWaitForTimeout (200);
				
}

export testfunction N_ServiceCouponLim_1 ()
{
  testModuleTitle("N_ServiceCouponLim_1 ");
  //write("N_ServiceCouponLim_1 ");
  
    sysSetVariableInt(sysvar::SysVar_PROXI::DIAG_ProxiLesen,1);
    testWaitForTimeout (200);
    sysSetVariableInt(sysvar::SysVar_PROXI::DIAG_ProxiLesen,0);
    testWaitForTimeout (200);
	  sysSetVariableInt(sysvar::SysVar_PROXI::pByte74Bit4567,N_ServiceCouponLim_1 );		
	  sysSetVariableInt(sysvar::SysVar_PROXI::DIAG_eLoadAll,1);
    testWaitForTimeout (200);
    sysSetVariableInt(sysvar::SysVar_PROXI::DIAG_eLoadAll,0);
testWaitForTimeout (2000);
	  sysSetVariableInt(sysvar::SysVar_PROXI::DIAG_eSendProxi,1);
    testWaitForTimeout (200);
    sysSetVariableInt(sysvar::SysVar_PROXI::DIAG_eSendProxi,0);
    testWaitForTimeout (200);
				
}

export testfunction N_ServiceCouponLim_2  ()
{
  testModuleTitle("N_ServiceCouponLim_2  ");
  //write("N_ServiceCouponLim_2  ");
  
    sysSetVariableInt(sysvar::SysVar_PROXI::DIAG_ProxiLesen,1);
    testWaitForTimeout (200);
    sysSetVariableInt(sysvar::SysVar_PROXI::DIAG_ProxiLesen,0);
    testWaitForTimeout (200);
	  sysSetVariableInt(sysvar::SysVar_PROXI::pByte74Bit4567,N_ServiceCouponLim_2  );		
	  sysSetVariableInt(sysvar::SysVar_PROXI::DIAG_eLoadAll,1);
    testWaitForTimeout (200);
    sysSetVariableInt(sysvar::SysVar_PROXI::DIAG_eLoadAll,0);
testWaitForTimeout (2000);
	  sysSetVariableInt(sysvar::SysVar_PROXI::DIAG_eSendProxi,1);
    testWaitForTimeout (200);
    sysSetVariableInt(sysvar::SysVar_PROXI::DIAG_eSendProxi,0);
    testWaitForTimeout (200);
				
}

export testfunction N_ServiceCouponLim_3()
{
  testModuleTitle("N_ServiceCouponLim_3");
  //write("N_ServiceCouponLim_3");
  
    sysSetVariableInt(sysvar::SysVar_PROXI::DIAG_ProxiLesen,1);
    testWaitForTimeout (200);
    sysSetVariableInt(sysvar::SysVar_PROXI::DIAG_ProxiLesen,0);
    testWaitForTimeout (200);
	  sysSetVariableInt(sysvar::SysVar_PROXI::pByte74Bit4567,N_ServiceCouponLim_3   );		
	  sysSetVariableInt(sysvar::SysVar_PROXI::DIAG_eLoadAll,1);
    testWaitForTimeout (200);
    sysSetVariableInt(sysvar::SysVar_PROXI::DIAG_eLoadAll,0);
testWaitForTimeout (2000);
	  sysSetVariableInt(sysvar::SysVar_PROXI::DIAG_eSendProxi,1);
    testWaitForTimeout (200);
    sysSetVariableInt(sysvar::SysVar_PROXI::DIAG_eSendProxi,0);
    testWaitForTimeout (200);
				
}

export testfunction N_ServiceCouponLim_4()
{
  testModuleTitle("N_ServiceCouponLim_4");
  //write("N_ServiceCouponLim_4");
  
    sysSetVariableInt(sysvar::SysVar_PROXI::DIAG_ProxiLesen,1);
    testWaitForTimeout (200);
    sysSetVariableInt(sysvar::SysVar_PROXI::DIAG_ProxiLesen,0);
    testWaitForTimeout (200);
	  sysSetVariableInt(sysvar::SysVar_PROXI::pByte74Bit4567,N_ServiceCouponLim_4);		
	  sysSetVariableInt(sysvar::SysVar_PROXI::DIAG_eLoadAll,1);
    testWaitForTimeout (200);
    sysSetVariableInt(sysvar::SysVar_PROXI::DIAG_eLoadAll,0);
testWaitForTimeout (2000);
	  sysSetVariableInt(sysvar::SysVar_PROXI::DIAG_eSendProxi,1);
    testWaitForTimeout (200);
    sysSetVariableInt(sysvar::SysVar_PROXI::DIAG_eSendProxi,0);
    testWaitForTimeout (200);
				
}

export testfunction N_ServiceCouponLim_5()
{
  testModuleTitle("N_ServiceCouponLim_5");
  //write("N_ServiceCouponLim_5");
  
    sysSetVariableInt(sysvar::SysVar_PROXI::DIAG_ProxiLesen,1);
    testWaitForTimeout (200);
    sysSetVariableInt(sysvar::SysVar_PROXI::DIAG_ProxiLesen,0);
    testWaitForTimeout (200);
	  sysSetVariableInt(sysvar::SysVar_PROXI::pByte74Bit4567,N_ServiceCouponLim_5);		
	  sysSetVariableInt(sysvar::SysVar_PROXI::DIAG_eLoadAll,1);
    testWaitForTimeout (200);
    sysSetVariableInt(sysvar::SysVar_PROXI::DIAG_eLoadAll,0);
testWaitForTimeout (2000);
	  sysSetVariableInt(sysvar::SysVar_PROXI::DIAG_eSendProxi,1);
    testWaitForTimeout (200);
    sysSetVariableInt(sysvar::SysVar_PROXI::DIAG_eSendProxi,0);
    testWaitForTimeout (200);
				
}

export testfunction N_ServiceCouponLim_6()
{
  testModuleTitle("N_ServiceCouponLim_6");
  //write("N_ServiceCouponLim_6");
  
    sysSetVariableInt(sysvar::SysVar_PROXI::DIAG_ProxiLesen,1);
    testWaitForTimeout (200);
    sysSetVariableInt(sysvar::SysVar_PROXI::DIAG_ProxiLesen,0);
    testWaitForTimeout (200);
	  sysSetVariableInt(sysvar::SysVar_PROXI::pByte74Bit4567,N_ServiceCouponLim_6);		
	  sysSetVariableInt(sysvar::SysVar_PROXI::DIAG_eLoadAll,1);
    testWaitForTimeout (200);
    sysSetVariableInt(sysvar::SysVar_PROXI::DIAG_eLoadAll,0);
testWaitForTimeout (2000);
	  sysSetVariableInt(sysvar::SysVar_PROXI::DIAG_eSendProxi,1);
    testWaitForTimeout (200);
    sysSetVariableInt(sysvar::SysVar_PROXI::DIAG_eSendProxi,0);
    testWaitForTimeout (200);
				
}

export testfunction N_ServiceCouponLim_7()
{
  testModuleTitle("N_ServiceCouponLim_7");
  //write("N_ServiceCouponLim_7");
  
    sysSetVariableInt(sysvar::SysVar_PROXI::DIAG_ProxiLesen,1);
    testWaitForTimeout (200);
    sysSetVariableInt(sysvar::SysVar_PROXI::DIAG_ProxiLesen,0);
    testWaitForTimeout (200);
	  sysSetVariableInt(sysvar::SysVar_PROXI::pByte74Bit4567,N_ServiceCouponLim_7);		
	  sysSetVariableInt(sysvar::SysVar_PROXI::DIAG_eLoadAll,1);
    testWaitForTimeout (200);
    sysSetVariableInt(sysvar::SysVar_PROXI::DIAG_eLoadAll,0);
testWaitForTimeout (2000);
	  sysSetVariableInt(sysvar::SysVar_PROXI::DIAG_eSendProxi,1);
    testWaitForTimeout (200);
    sysSetVariableInt(sysvar::SysVar_PROXI::DIAG_eSendProxi,0);
    testWaitForTimeout (200);
				
}

export testfunction N_ServiceCouponLim_8()
{
  testModuleTitle("N_ServiceCouponLim_8");
  //write("N_ServiceCouponLim_8");
  
    sysSetVariableInt(sysvar::SysVar_PROXI::DIAG_ProxiLesen,1);
    testWaitForTimeout (200);
    sysSetVariableInt(sysvar::SysVar_PROXI::DIAG_ProxiLesen,0);
    testWaitForTimeout (200);
	  sysSetVariableInt(sysvar::SysVar_PROXI::pByte74Bit4567,N_ServiceCouponLim_8);		
	  sysSetVariableInt(sysvar::SysVar_PROXI::DIAG_eLoadAll,1);
    testWaitForTimeout (200);
    sysSetVariableInt(sysvar::SysVar_PROXI::DIAG_eLoadAll,0);
testWaitForTimeout (2000);
	  sysSetVariableInt(sysvar::SysVar_PROXI::DIAG_eSendProxi,1);
    testWaitForTimeout (200);
    sysSetVariableInt(sysvar::SysVar_PROXI::DIAG_eSendProxi,0);
    testWaitForTimeout (200);
				
}

export testfunction N_ServiceCouponLim_9()
{
  testModuleTitle("N_ServiceCouponLim_9");
  //write("N_ServiceCouponLim_9");
  
    sysSetVariableInt(sysvar::SysVar_PROXI::DIAG_ProxiLesen,1);
    testWaitForTimeout (200);
    sysSetVariableInt(sysvar::SysVar_PROXI::DIAG_ProxiLesen,0);
    testWaitForTimeout (200);
	  sysSetVariableInt(sysvar::SysVar_PROXI::pByte74Bit4567,N_ServiceCouponLim_9);		
	  sysSetVariableInt(sysvar::SysVar_PROXI::DIAG_eLoadAll,1);
    testWaitForTimeout (200);
    sysSetVariableInt(sysvar::SysVar_PROXI::DIAG_eLoadAll,0);
testWaitForTimeout (2000);
	  sysSetVariableInt(sysvar::SysVar_PROXI::DIAG_eSendProxi,1);
    testWaitForTimeout (200);
    sysSetVariableInt(sysvar::SysVar_PROXI::DIAG_eSendProxi,0);
    testWaitForTimeout (200);
				
}

export testfunction N_ServiceCouponLim_10()
{
  testModuleTitle("N_ServiceCouponLim_10");
  //write("N_ServiceCouponLim_10");
  
    sysSetVariableInt(sysvar::SysVar_PROXI::DIAG_ProxiLesen,1);
    testWaitForTimeout (200);
    sysSetVariableInt(sysvar::SysVar_PROXI::DIAG_ProxiLesen,0);
    testWaitForTimeout (200);
	  sysSetVariableInt(sysvar::SysVar_PROXI::pByte74Bit4567,N_ServiceCouponLim_10);		
	  sysSetVariableInt(sysvar::SysVar_PROXI::DIAG_eLoadAll,1);
    testWaitForTimeout (200);
    sysSetVariableInt(sysvar::SysVar_PROXI::DIAG_eLoadAll,0);
testWaitForTimeout (2000);
	  sysSetVariableInt(sysvar::SysVar_PROXI::DIAG_eSendProxi,1);
    testWaitForTimeout (200);
    sysSetVariableInt(sysvar::SysVar_PROXI::DIAG_eSendProxi,0);
    testWaitForTimeout (200);
				
}

export testfunction N_ServiceCouponLim_11()
{
  testModuleTitle("N_ServiceCouponLim_11");
  //write("N_ServiceCouponLim_11");
  
    sysSetVariableInt(sysvar::SysVar_PROXI::DIAG_ProxiLesen,1);
    testWaitForTimeout (200);
    sysSetVariableInt(sysvar::SysVar_PROXI::DIAG_ProxiLesen,0);
    testWaitForTimeout (200);
	  sysSetVariableInt(sysvar::SysVar_PROXI::pByte74Bit4567,N_ServiceCouponLim_11);		
	  sysSetVariableInt(sysvar::SysVar_PROXI::DIAG_eLoadAll,1);
    testWaitForTimeout (200);
    sysSetVariableInt(sysvar::SysVar_PROXI::DIAG_eLoadAll,0);
testWaitForTimeout (2000);
	  sysSetVariableInt(sysvar::SysVar_PROXI::DIAG_eSendProxi,1);
    testWaitForTimeout (200);
    sysSetVariableInt(sysvar::SysVar_PROXI::DIAG_eSendProxi,0);
    testWaitForTimeout (200);
				
}

export testfunction N_ServiceCouponLim_12()
{
  testModuleTitle("N_ServiceCouponLim_12");
  //write("N_ServiceCouponLim_12");
  
    sysSetVariableInt(sysvar::SysVar_PROXI::DIAG_ProxiLesen,1);
    testWaitForTimeout (200);
    sysSetVariableInt(sysvar::SysVar_PROXI::DIAG_ProxiLesen,0);
    testWaitForTimeout (200);
	  sysSetVariableInt(sysvar::SysVar_PROXI::pByte74Bit4567,N_ServiceCouponLim_12);		
	  sysSetVariableInt(sysvar::SysVar_PROXI::DIAG_eLoadAll,1);
    testWaitForTimeout (200);
    sysSetVariableInt(sysvar::SysVar_PROXI::DIAG_eLoadAll,0);
testWaitForTimeout (2000);
	  sysSetVariableInt(sysvar::SysVar_PROXI::DIAG_eSendProxi,1);
    testWaitForTimeout (200);
    sysSetVariableInt(sysvar::SysVar_PROXI::DIAG_eSendProxi,0);
    testWaitForTimeout (200);
				
}

export testfunction N_ServiceCouponLim_13()
{
  testModuleTitle("N_ServiceCouponLim_13");
  //write("N_ServiceCouponLim_13");
  
    sysSetVariableInt(sysvar::SysVar_PROXI::DIAG_ProxiLesen,1);
    testWaitForTimeout (200);
    sysSetVariableInt(sysvar::SysVar_PROXI::DIAG_ProxiLesen,0);
    testWaitForTimeout (200);
	  sysSetVariableInt(sysvar::SysVar_PROXI::pByte74Bit4567,N_ServiceCouponLim_13);		
	  sysSetVariableInt(sysvar::SysVar_PROXI::DIAG_eLoadAll,1);
    testWaitForTimeout (200);
    sysSetVariableInt(sysvar::SysVar_PROXI::DIAG_eLoadAll,0);
testWaitForTimeout (2000);
	sysSetVariableInt(sysvar::SysVar_PROXI::DIAG_eSendProxi,1);
    testWaitForTimeout (200);
    sysSetVariableInt(sysvar::SysVar_PROXI::DIAG_eSendProxi,0);
    testWaitForTimeout (200);
				
}


export testfunction N_ServiceCouponLim_14()
{
  testModuleTitle("N_ServiceCouponLim_14");
  //write("N_ServiceCouponLim_14");
  
    sysSetVariableInt(sysvar::SysVar_PROXI::DIAG_ProxiLesen,1);
    testWaitForTimeout (200);
    sysSetVariableInt(sysvar::SysVar_PROXI::DIAG_ProxiLesen,0);
    testWaitForTimeout (200);
	  sysSetVariableInt(sysvar::SysVar_PROXI::pByte74Bit4567,N_ServiceCouponLim_14);		
	  sysSetVariableInt(sysvar::SysVar_PROXI::DIAG_eLoadAll,1);
    testWaitForTimeout (200);
    sysSetVariableInt(sysvar::SysVar_PROXI::DIAG_eLoadAll,0);
testWaitForTimeout (2000);
	  sysSetVariableInt(sysvar::SysVar_PROXI::DIAG_eSendProxi,1);
    testWaitForTimeout (200);
    sysSetVariableInt(sysvar::SysVar_PROXI::DIAG_eSendProxi,0);
    testWaitForTimeout (200);
				
}

export testfunction N_ServiceCouponLim_15()
{
  testModuleTitle("N_ServiceCouponLim_15");
  //write("N_ServiceCouponLim_15");
  
    sysSetVariableInt(sysvar::SysVar_PROXI::DIAG_ProxiLesen,1);
    testWaitForTimeout (200);
    sysSetVariableInt(sysvar::SysVar_PROXI::DIAG_ProxiLesen,0);
    testWaitForTimeout (200);
	  sysSetVariableInt(sysvar::SysVar_PROXI::pByte74Bit4567,N_ServiceCouponLim_15);		
	  sysSetVariableInt(sysvar::SysVar_PROXI::DIAG_eLoadAll,1);
    testWaitForTimeout (200);
    sysSetVariableInt(sysvar::SysVar_PROXI::DIAG_eLoadAll,0);
testWaitForTimeout (2000);
	  sysSetVariableInt(sysvar::SysVar_PROXI::DIAG_eSendProxi,1);
    testWaitForTimeout (200);
    sysSetVariableInt(sysvar::SysVar_PROXI::DIAG_eSendProxi,0);
    testWaitForTimeout (200);
				
}

export testfunction Speedometer_Tolerance_0()
{
  testModuleTitle("Speedometer_Tolerance_0");
  //write("Speedometer_Tolerance_0");
  
    sysSetVariableInt(sysvar::SysVar_PROXI::DIAG_ProxiLesen,1);
    testWaitForTimeout (200);
    sysSetVariableInt(sysvar::SysVar_PROXI::DIAG_ProxiLesen,0);
    testWaitForTimeout (200);
	sysSetVariableInt(sysvar::SysVar_PROXI::pByte73,Speedometer_Tolerance_0);		
	sysSetVariableInt(sysvar::SysVar_PROXI::DIAG_eLoadAll,1);
    testWaitForTimeout (200);
    sysSetVariableInt(sysvar::SysVar_PROXI::DIAG_eLoadAll,0);
testWaitForTimeout (2000);
	sysSetVariableInt(sysvar::SysVar_PROXI::DIAG_eSendProxi,1);
    testWaitForTimeout (200);
    sysSetVariableInt(sysvar::SysVar_PROXI::DIAG_eSendProxi,0);
    testWaitForTimeout (200);
				
}

export testfunction Speedometer_Tolerance_1()
{
  testModuleTitle("Speedometer_Tolerance_1");
  //write("Speedometer_Tolerance_1");
  
    sysSetVariableInt(sysvar::SysVar_PROXI::DIAG_ProxiLesen,1);
    testWaitForTimeout (200);
    sysSetVariableInt(sysvar::SysVar_PROXI::DIAG_ProxiLesen,0);
    testWaitForTimeout (200);
	sysSetVariableInt(sysvar::SysVar_PROXI::pByte73,Speedometer_Tolerance_1);		
	sysSetVariableInt(sysvar::SysVar_PROXI::DIAG_eLoadAll,1);
    testWaitForTimeout (200);
    sysSetVariableInt(sysvar::SysVar_PROXI::DIAG_eLoadAll,0);
testWaitForTimeout (2000);
	sysSetVariableInt(sysvar::SysVar_PROXI::DIAG_eSendProxi,1);
    testWaitForTimeout (200);
    sysSetVariableInt(sysvar::SysVar_PROXI::DIAG_eSendProxi,0);
    testWaitForTimeout (200);
				
}

export testfunction Speedometer_Tolerance_2()
{
  testModuleTitle("Speedometer_Tolerance_2");
  //write("Speedometer_Tolerance_2");
  
    sysSetVariableInt(sysvar::SysVar_PROXI::DIAG_ProxiLesen,1);
    testWaitForTimeout (200);
    sysSetVariableInt(sysvar::SysVar_PROXI::DIAG_ProxiLesen,0);
    testWaitForTimeout (200);
	sysSetVariableInt(sysvar::SysVar_PROXI::pByte73,Speedometer_Tolerance_2);		
	sysSetVariableInt(sysvar::SysVar_PROXI::DIAG_eLoadAll,1);
    testWaitForTimeout (200);
    sysSetVariableInt(sysvar::SysVar_PROXI::DIAG_eLoadAll,0);
testWaitForTimeout (2000);
	sysSetVariableInt(sysvar::SysVar_PROXI::DIAG_eSendProxi,1);
    testWaitForTimeout (200);
    sysSetVariableInt(sysvar::SysVar_PROXI::DIAG_eSendProxi,0);
    testWaitForTimeout (200);
				
}

export testfunction Speedometer_Tolerance_3()
{
  testModuleTitle("Speedometer_Tolerance_3");
  //write("Speedometer_Tolerance_3");
  
    sysSetVariableInt(sysvar::SysVar_PROXI::DIAG_ProxiLesen,1);
    testWaitForTimeout (200);
    sysSetVariableInt(sysvar::SysVar_PROXI::DIAG_ProxiLesen,0);
    testWaitForTimeout (200);
	sysSetVariableInt(sysvar::SysVar_PROXI::pByte73,Speedometer_Tolerance_3);		
	sysSetVariableInt(sysvar::SysVar_PROXI::DIAG_eLoadAll,1);
    testWaitForTimeout (200);
    sysSetVariableInt(sysvar::SysVar_PROXI::DIAG_eLoadAll,0);
testWaitForTimeout (2000);
	sysSetVariableInt(sysvar::SysVar_PROXI::DIAG_eSendProxi,1);
    testWaitForTimeout (200);
    sysSetVariableInt(sysvar::SysVar_PROXI::DIAG_eSendProxi,0);
    testWaitForTimeout (200);
				
}

export testfunction Speedometer_Tolerance_4()
{
  testModuleTitle("Speedometer_Tolerance_4");
  //write("Speedometer_Tolerance_4");
  
    sysSetVariableInt(sysvar::SysVar_PROXI::DIAG_ProxiLesen,1);
    testWaitForTimeout (200);
    sysSetVariableInt(sysvar::SysVar_PROXI::DIAG_ProxiLesen,0);
    testWaitForTimeout (200);
	sysSetVariableInt(sysvar::SysVar_PROXI::pByte73,Speedometer_Tolerance_4);		
	sysSetVariableInt(sysvar::SysVar_PROXI::DIAG_eLoadAll,1);
    testWaitForTimeout (200);
    sysSetVariableInt(sysvar::SysVar_PROXI::DIAG_eLoadAll,0);
testWaitForTimeout (2000);
	sysSetVariableInt(sysvar::SysVar_PROXI::DIAG_eSendProxi,1);
    testWaitForTimeout (200);
    sysSetVariableInt(sysvar::SysVar_PROXI::DIAG_eSendProxi,0);
    testWaitForTimeout (200);
				
}

export testfunction Speedometer_Tolerance_5()
{
  testModuleTitle("Speedometer_Tolerance_5");
  //write("Speedometer_Tolerance_5");
  
    sysSetVariableInt(sysvar::SysVar_PROXI::DIAG_ProxiLesen,1);
    testWaitForTimeout (200);
    sysSetVariableInt(sysvar::SysVar_PROXI::DIAG_ProxiLesen,0);
    testWaitForTimeout (200);
	sysSetVariableInt(sysvar::SysVar_PROXI::pByte73,Speedometer_Tolerance_5);		
	sysSetVariableInt(sysvar::SysVar_PROXI::DIAG_eLoadAll,1);
    testWaitForTimeout (200);
    sysSetVariableInt(sysvar::SysVar_PROXI::DIAG_eLoadAll,0);
testWaitForTimeout (2000);
	sysSetVariableInt(sysvar::SysVar_PROXI::DIAG_eSendProxi,1);
    testWaitForTimeout (200);
    sysSetVariableInt(sysvar::SysVar_PROXI::DIAG_eSendProxi,0);
    testWaitForTimeout (200);
				
}

export testfunction Speedometer_Tolerance_6()
{
  testModuleTitle("Speedometer_Tolerance_6");
  //write("Speedometer_Tolerance_6");
  
    sysSetVariableInt(sysvar::SysVar_PROXI::DIAG_ProxiLesen,1);
    testWaitForTimeout (200);
    sysSetVariableInt(sysvar::SysVar_PROXI::DIAG_ProxiLesen,0);
    testWaitForTimeout (200);
	sysSetVariableInt(sysvar::SysVar_PROXI::pByte73,Speedometer_Tolerance_6);		
	sysSetVariableInt(sysvar::SysVar_PROXI::DIAG_eLoadAll,1);
    testWaitForTimeout (200);
    sysSetVariableInt(sysvar::SysVar_PROXI::DIAG_eLoadAll,0);
testWaitForTimeout (2000);
	sysSetVariableInt(sysvar::SysVar_PROXI::DIAG_eSendProxi,1);
    testWaitForTimeout (200);
    sysSetVariableInt(sysvar::SysVar_PROXI::DIAG_eSendProxi,0);
    testWaitForTimeout (200);
				
}

export testfunction Speedometer_Tolerance_7()
{
  testModuleTitle("Speedometer_Tolerance_7");
  //write("Speedometer_Tolerance_7");
  
    sysSetVariableInt(sysvar::SysVar_PROXI::DIAG_ProxiLesen,1);
    testWaitForTimeout (200);
    sysSetVariableInt(sysvar::SysVar_PROXI::DIAG_ProxiLesen,0);
    testWaitForTimeout (200);
	sysSetVariableInt(sysvar::SysVar_PROXI::pByte73,Speedometer_Tolerance_7);		
	sysSetVariableInt(sysvar::SysVar_PROXI::DIAG_eLoadAll,1);
    testWaitForTimeout (200);
    sysSetVariableInt(sysvar::SysVar_PROXI::DIAG_eLoadAll,0);
testWaitForTimeout (2000);
	sysSetVariableInt(sysvar::SysVar_PROXI::DIAG_eSendProxi,1);
    testWaitForTimeout (200);
    sysSetVariableInt(sysvar::SysVar_PROXI::DIAG_eSendProxi,0);
    testWaitForTimeout (200);
				
}

export testfunction Speedometer_Tolerance_8()
{
  testModuleTitle("Speedometer_Tolerance_8");
  //write("Speedometer_Tolerance_8");
  
    sysSetVariableInt(sysvar::SysVar_PROXI::DIAG_ProxiLesen,1);
    testWaitForTimeout (200);
    sysSetVariableInt(sysvar::SysVar_PROXI::DIAG_ProxiLesen,0);
    testWaitForTimeout (200);
	sysSetVariableInt(sysvar::SysVar_PROXI::pByte73,Speedometer_Tolerance_8);		
	sysSetVariableInt(sysvar::SysVar_PROXI::DIAG_eLoadAll,1);
    testWaitForTimeout (200);
    sysSetVariableInt(sysvar::SysVar_PROXI::DIAG_eLoadAll,0);
testWaitForTimeout (2000);
	sysSetVariableInt(sysvar::SysVar_PROXI::DIAG_eSendProxi,1);
    testWaitForTimeout (200);
    sysSetVariableInt(sysvar::SysVar_PROXI::DIAG_eSendProxi,0);
    testWaitForTimeout (200);
				
}

export testfunction Speedometer_Tolerance_9()
{
  testModuleTitle("Speedometer_Tolerance_9");
  //write("Speedometer_Tolerance_9");
  
    sysSetVariableInt(sysvar::SysVar_PROXI::DIAG_ProxiLesen,1);
    testWaitForTimeout (200);
    sysSetVariableInt(sysvar::SysVar_PROXI::DIAG_ProxiLesen,0);
    testWaitForTimeout (200);
	sysSetVariableInt(sysvar::SysVar_PROXI::pByte73,Speedometer_Tolerance_9);		
	sysSetVariableInt(sysvar::SysVar_PROXI::DIAG_eLoadAll,1);
    testWaitForTimeout (200);
    sysSetVariableInt(sysvar::SysVar_PROXI::DIAG_eLoadAll,0);
testWaitForTimeout (2000);
	sysSetVariableInt(sysvar::SysVar_PROXI::DIAG_eSendProxi,1);
    testWaitForTimeout (200);
    sysSetVariableInt(sysvar::SysVar_PROXI::DIAG_eSendProxi,0);
    testWaitForTimeout (200);
				
}

export testfunction Speedometer_Tolerance_10()
{
  testModuleTitle("Speedometer_Tolerance_10");
  //write("Speedometer_Tolerance_10");
  
    sysSetVariableInt(sysvar::SysVar_PROXI::DIAG_ProxiLesen,1);
    testWaitForTimeout (200);
    sysSetVariableInt(sysvar::SysVar_PROXI::DIAG_ProxiLesen,0);
    testWaitForTimeout (200);
	sysSetVariableInt(sysvar::SysVar_PROXI::pByte73,Speedometer_Tolerance_10);		
	sysSetVariableInt(sysvar::SysVar_PROXI::DIAG_eLoadAll,1);
    testWaitForTimeout (200);
    sysSetVariableInt(sysvar::SysVar_PROXI::DIAG_eLoadAll,0);
testWaitForTimeout (2000);
	sysSetVariableInt(sysvar::SysVar_PROXI::DIAG_eSendProxi,1);
    testWaitForTimeout (200);
    sysSetVariableInt(sysvar::SysVar_PROXI::DIAG_eSendProxi,0);
    testWaitForTimeout (200);
				
}

export testfunction Speedometer_Tolerance_11()
{
  testModuleTitle("Speedometer_Tolerance_11");
  //write("Speedometer_Tolerance_11");
  
    sysSetVariableInt(sysvar::SysVar_PROXI::DIAG_ProxiLesen,1);
    testWaitForTimeout (200);
    sysSetVariableInt(sysvar::SysVar_PROXI::DIAG_ProxiLesen,0);
    testWaitForTimeout (200);
	sysSetVariableInt(sysvar::SysVar_PROXI::pByte73,Speedometer_Tolerance_11);		
	sysSetVariableInt(sysvar::SysVar_PROXI::DIAG_eLoadAll,1);
    testWaitForTimeout (200);
    sysSetVariableInt(sysvar::SysVar_PROXI::DIAG_eLoadAll,0);
testWaitForTimeout (2000);
	sysSetVariableInt(sysvar::SysVar_PROXI::DIAG_eSendProxi,1);
    testWaitForTimeout (200);
    sysSetVariableInt(sysvar::SysVar_PROXI::DIAG_eSendProxi,0);
    testWaitForTimeout (200);
				
}

export testfunction Speedometer_Tolerance_12()
{
  testModuleTitle("Speedometer_Tolerance_12");
  //write("Speedometer_Tolerance_12");
  
    sysSetVariableInt(sysvar::SysVar_PROXI::DIAG_ProxiLesen,1);
    testWaitForTimeout (200);
    sysSetVariableInt(sysvar::SysVar_PROXI::DIAG_ProxiLesen,0);
    testWaitForTimeout (200);
	sysSetVariableInt(sysvar::SysVar_PROXI::pByte73,Speedometer_Tolerance_12);		
	sysSetVariableInt(sysvar::SysVar_PROXI::DIAG_eLoadAll,1);
    testWaitForTimeout (200);
    sysSetVariableInt(sysvar::SysVar_PROXI::DIAG_eLoadAll,0);
testWaitForTimeout (2000);
	sysSetVariableInt(sysvar::SysVar_PROXI::DIAG_eSendProxi,1);
    testWaitForTimeout (200);
    sysSetVariableInt(sysvar::SysVar_PROXI::DIAG_eSendProxi,0);
    testWaitForTimeout (200);
				
}

export testfunction Speedometer_Tolerance_13()
{
  testModuleTitle("Speedometer_Tolerance_13");
  //write("Speedometer_Tolerance_13");
  
    sysSetVariableInt(sysvar::SysVar_PROXI::DIAG_ProxiLesen,1);
    testWaitForTimeout (200);
    sysSetVariableInt(sysvar::SysVar_PROXI::DIAG_ProxiLesen,0);
    testWaitForTimeout (200);
	sysSetVariableInt(sysvar::SysVar_PROXI::pByte73,Speedometer_Tolerance_13);		
	sysSetVariableInt(sysvar::SysVar_PROXI::DIAG_eLoadAll,1);
    testWaitForTimeout (200);
    sysSetVariableInt(sysvar::SysVar_PROXI::DIAG_eLoadAll,0);
testWaitForTimeout (2000);
	sysSetVariableInt(sysvar::SysVar_PROXI::DIAG_eSendProxi,1);
    testWaitForTimeout (200);
    sysSetVariableInt(sysvar::SysVar_PROXI::DIAG_eSendProxi,0);
    testWaitForTimeout (200);
				
}

export testfunction Speedometer_Tolerance_14()
{
  testModuleTitle("Speedometer_Tolerance_14");
  //write("Speedometer_Tolerance_14");
  
    sysSetVariableInt(sysvar::SysVar_PROXI::DIAG_ProxiLesen,1);
    testWaitForTimeout (200);
    sysSetVariableInt(sysvar::SysVar_PROXI::DIAG_ProxiLesen,0);
    testWaitForTimeout (200);
	sysSetVariableInt(sysvar::SysVar_PROXI::pByte73,Speedometer_Tolerance_14);		
	sysSetVariableInt(sysvar::SysVar_PROXI::DIAG_eLoadAll,1);
    testWaitForTimeout (200);
    sysSetVariableInt(sysvar::SysVar_PROXI::DIAG_eLoadAll,0);
testWaitForTimeout (2000);
	sysSetVariableInt(sysvar::SysVar_PROXI::DIAG_eSendProxi,1);
    testWaitForTimeout (200);
    sysSetVariableInt(sysvar::SysVar_PROXI::DIAG_eSendProxi,0);
    testWaitForTimeout (200);
				
}

export testfunction Speedometer_Tolerance_15()
{
  testModuleTitle("Speedometer_Tolerance_15");
  //write("Speedometer_Tolerance_15");
  
    sysSetVariableInt(sysvar::SysVar_PROXI::DIAG_ProxiLesen,1);
    testWaitForTimeout (200);
    sysSetVariableInt(sysvar::SysVar_PROXI::DIAG_ProxiLesen,0);
    testWaitForTimeout (200);
	sysSetVariableInt(sysvar::SysVar_PROXI::pByte73,Speedometer_Tolerance_15);		
	sysSetVariableInt(sysvar::SysVar_PROXI::DIAG_eLoadAll,1);
    testWaitForTimeout (200);
    sysSetVariableInt(sysvar::SysVar_PROXI::DIAG_eLoadAll,0);
testWaitForTimeout (2000);
	sysSetVariableInt(sysvar::SysVar_PROXI::DIAG_eSendProxi,1);
    testWaitForTimeout (200);
    sysSetVariableInt(sysvar::SysVar_PROXI::DIAG_eSendProxi,0);
    testWaitForTimeout (200);
				
}

export testfunction Speedometer_Tolerance_16()
{
  testModuleTitle("Speedometer_Tolerance_16");
  //write("Speedometer_Tolerance_16");
  
    sysSetVariableInt(sysvar::SysVar_PROXI::DIAG_ProxiLesen,1);
    testWaitForTimeout (200);
    sysSetVariableInt(sysvar::SysVar_PROXI::DIAG_ProxiLesen,0);
    testWaitForTimeout (200);
	sysSetVariableInt(sysvar::SysVar_PROXI::pByte73,Speedometer_Tolerance_16);		
	sysSetVariableInt(sysvar::SysVar_PROXI::DIAG_eLoadAll,1);
    testWaitForTimeout (200);
    sysSetVariableInt(sysvar::SysVar_PROXI::DIAG_eLoadAll,0);
testWaitForTimeout (2000);
	sysSetVariableInt(sysvar::SysVar_PROXI::DIAG_eSendProxi,1);
    testWaitForTimeout (200);
    sysSetVariableInt(sysvar::SysVar_PROXI::DIAG_eSendProxi,0);
    testWaitForTimeout (200);
				
}

export testfunction Tank_Fuel_Capacity_51L()
{
  testModuleTitle("Tank_Fuel_Capacity_51L");
  //write("Tank_Fuel_Capacity_51L");
  
    sysSetVariableInt(sysvar::SysVar_PROXI::DIAG_ProxiLesen,1);
    testWaitForTimeout (200);
    sysSetVariableInt(sysvar::SysVar_PROXI::DIAG_ProxiLesen,0);
    testWaitForTimeout (200);
	  sysSetVariableInt(sysvar::SysVar_PROXI::pByte67A,Tank_Fuel_Capacity_51L);		
	  sysSetVariableInt(sysvar::SysVar_PROXI::DIAG_eLoadAll,1);
    testWaitForTimeout (200);
    sysSetVariableInt(sysvar::SysVar_PROXI::DIAG_eLoadAll,0);
testWaitForTimeout (2000);
	  sysSetVariableInt(sysvar::SysVar_PROXI::DIAG_eSendProxi,1);
    testWaitForTimeout (200);
    sysSetVariableInt(sysvar::SysVar_PROXI::DIAG_eSendProxi,0);
    testWaitForTimeout (200);
				
}

export testfunction CAN_node0_BCM_Absent ()
{
  testModuleTitle("CAN_node0_BCM_Absent");
  //write("CAN_node0_BCM_Absent");
  
    sysSetVariableInt(sysvar::SysVar_PROXI::DIAG_ProxiLesen,1);
    testWaitForTimeout (200);
    sysSetVariableInt(sysvar::SysVar_PROXI::DIAG_ProxiLesen,0);
    testWaitForTimeout (200);
    sysSetVariableInt(sysvar::SysVar_PROXI::pByte26Bit0,CAN_node0_BCM_Absent);		
    sysSetVariableInt(sysvar::SysVar_PROXI::DIAG_eLoadAll,1);
    testWaitForTimeout (200);
    sysSetVariableInt(sysvar::SysVar_PROXI::DIAG_eLoadAll,0);
testWaitForTimeout (2000);
    sysSetVariableInt(sysvar::SysVar_PROXI::DIAG_eSendProxi,1);
    testWaitForTimeout (200);
    sysSetVariableInt(sysvar::SysVar_PROXI::DIAG_eSendProxi,0);
    testWaitForTimeout (200);
				
}

export testfunction CAN_node1_ECM_Present ()
{
  testModuleTitle("CAN_node1_ECM_Present");
  //write("CAN_node1_ECM_Present");
  
    sysSetVariableInt(sysvar::SysVar_PROXI::DIAG_ProxiLesen,1);
    testWaitForTimeout (200);
    sysSetVariableInt(sysvar::SysVar_PROXI::DIAG_ProxiLesen,0);
    testWaitForTimeout (200);
    sysSetVariableInt(sysvar::SysVar_PROXI::pByte26Bit1,CAN_node1_ECM_Present);		
    sysSetVariableInt(sysvar::SysVar_PROXI::DIAG_eLoadAll,1);
    testWaitForTimeout (200);
    sysSetVariableInt(sysvar::SysVar_PROXI::DIAG_eLoadAll,0);
testWaitForTimeout (2000);
    sysSetVariableInt(sysvar::SysVar_PROXI::DIAG_eSendProxi,1);
    testWaitForTimeout (200);
    sysSetVariableInt(sysvar::SysVar_PROXI::DIAG_eSendProxi,0);
    testWaitForTimeout (200);
				
}

export testfunction CAN_node1_ECM_Absent ()
{
  testModuleTitle("CAN_node1_ECM_Absent");
  //write("CAN_node1_ECM_Absent");
  
    sysSetVariableInt(sysvar::SysVar_PROXI::DIAG_ProxiLesen,1);
    testWaitForTimeout (200);
    sysSetVariableInt(sysvar::SysVar_PROXI::DIAG_ProxiLesen,0);
    testWaitForTimeout (200);
    sysSetVariableInt(sysvar::SysVar_PROXI::pByte26Bit1,CAN_node1_ECM_Absent);		
    sysSetVariableInt(sysvar::SysVar_PROXI::DIAG_eLoadAll,1);
    testWaitForTimeout (200);
    sysSetVariableInt(sysvar::SysVar_PROXI::DIAG_eLoadAll,0);
testWaitForTimeout (2000);
    sysSetVariableInt(sysvar::SysVar_PROXI::DIAG_eSendProxi,1);
    testWaitForTimeout (200);
    sysSetVariableInt(sysvar::SysVar_PROXI::DIAG_eSendProxi,0);
    testWaitForTimeout (200);
				
}

export testfunction CAN_node2_EPS_Present ()
{
  testModuleTitle("CAN_node2_EPS_Present");
  //write("CAN_node2_EPS_Present");
  
    sysSetVariableInt(sysvar::SysVar_PROXI::DIAG_ProxiLesen,1);
    testWaitForTimeout (200);
    sysSetVariableInt(sysvar::SysVar_PROXI::DIAG_ProxiLesen,0);
    testWaitForTimeout (200);
    sysSetVariableInt(sysvar::SysVar_PROXI::pByte26Bit2,CAN_node2_EPS_Present);		
    sysSetVariableInt(sysvar::SysVar_PROXI::DIAG_eLoadAll,1);
    testWaitForTimeout (200);
    sysSetVariableInt(sysvar::SysVar_PROXI::DIAG_eLoadAll,0);
testWaitForTimeout (2000);
    sysSetVariableInt(sysvar::SysVar_PROXI::DIAG_eSendProxi,1);
    testWaitForTimeout (200);
    sysSetVariableInt(sysvar::SysVar_PROXI::DIAG_eSendProxi,0);
    testWaitForTimeout (200);
				
}

export testfunction CAN_node2_EPS_Absent ()
{
  testModuleTitle("CAN_node2_EPS_Absent");
  //write("CAN_node2_EPS_Absent");
  
    sysSetVariableInt(sysvar::SysVar_PROXI::DIAG_ProxiLesen,1);
    testWaitForTimeout (200);
    sysSetVariableInt(sysvar::SysVar_PROXI::DIAG_ProxiLesen,0);
    testWaitForTimeout (200);
    sysSetVariableInt(sysvar::SysVar_PROXI::pByte26Bit2,CAN_node2_EPS_Absent);		
    sysSetVariableInt(sysvar::SysVar_PROXI::DIAG_eLoadAll,1);
    testWaitForTimeout (200);
    sysSetVariableInt(sysvar::SysVar_PROXI::DIAG_eLoadAll,0);
testWaitForTimeout (2000);
    sysSetVariableInt(sysvar::SysVar_PROXI::DIAG_eSendProxi,1);
    testWaitForTimeout (200);
    sysSetVariableInt(sysvar::SysVar_PROXI::DIAG_eSendProxi,0);
    testWaitForTimeout (200);
				
}

export testfunction CAN_node3_IPC_Present ()
{
  testModuleTitle("CAN_node3_IPC_Present");
  //write("CAN_node3_IPC_Present");
  
    sysSetVariableInt(sysvar::SysVar_PROXI::DIAG_ProxiLesen,1);
    testWaitForTimeout (200);
    sysSetVariableInt(sysvar::SysVar_PROXI::DIAG_ProxiLesen,0);
    testWaitForTimeout (200);
    sysSetVariableInt(sysvar::SysVar_PROXI::pByte26Bit3,CAN_node3_IPC_Present);		
    sysSetVariableInt(sysvar::SysVar_PROXI::DIAG_eLoadAll,1);
    testWaitForTimeout (200);
    sysSetVariableInt(sysvar::SysVar_PROXI::DIAG_eLoadAll,0);
testWaitForTimeout (2000);
    sysSetVariableInt(sysvar::SysVar_PROXI::DIAG_eSendProxi,1);
    testWaitForTimeout (200);
    sysSetVariableInt(sysvar::SysVar_PROXI::DIAG_eSendProxi,0);
    testWaitForTimeout (200);
				
}

export testfunction CAN_node3_IPC_Absent ()
{
  testModuleTitle("CAN_node3_IPC_Absent");
  //write("CAN_node3_IPC_Absent");
  
    sysSetVariableInt(sysvar::SysVar_PROXI::DIAG_ProxiLesen,1);
    testWaitForTimeout (200);
    sysSetVariableInt(sysvar::SysVar_PROXI::DIAG_ProxiLesen,0);
    testWaitForTimeout (200);
    sysSetVariableInt(sysvar::SysVar_PROXI::pByte26Bit3,CAN_node3_IPC_Absent);		
    sysSetVariableInt(sysvar::SysVar_PROXI::DIAG_eLoadAll,1);
    testWaitForTimeout (200);
    sysSetVariableInt(sysvar::SysVar_PROXI::DIAG_eLoadAll,0);
testWaitForTimeout (2000);
    sysSetVariableInt(sysvar::SysVar_PROXI::DIAG_eSendProxi,1);
    testWaitForTimeout (200);
    sysSetVariableInt(sysvar::SysVar_PROXI::DIAG_eSendProxi,0);
    testWaitForTimeout (200);
				
}

export testfunction CAN_node5_RRM_Present ()
{
  testModuleTitle("CAN_node5_RRM_Present");
  //write("CAN_node5_RRM_Present");
  
    sysSetVariableInt(sysvar::SysVar_PROXI::DIAG_ProxiLesen,1);
    testWaitForTimeout (200);
    sysSetVariableInt(sysvar::SysVar_PROXI::DIAG_ProxiLesen,0);
    testWaitForTimeout (200);
    sysSetVariableInt(sysvar::SysVar_PROXI::pByte26Bit5,CAN_node5_RRM_Present);		
    sysSetVariableInt(sysvar::SysVar_PROXI::DIAG_eLoadAll,1);
    testWaitForTimeout (200);
    sysSetVariableInt(sysvar::SysVar_PROXI::DIAG_eLoadAll,0);
testWaitForTimeout (2000);
    sysSetVariableInt(sysvar::SysVar_PROXI::DIAG_eSendProxi,1);
    testWaitForTimeout (200);
    sysSetVariableInt(sysvar::SysVar_PROXI::DIAG_eSendProxi,0);
    testWaitForTimeout (200);
				
}

export testfunction CAN_node5_RRM_Absent ()
{
  testModuleTitle("CAN_node5_RRM_Absent");
  //write("CAN_node5_RRM_Absent");
  
    sysSetVariableInt(sysvar::SysVar_PROXI::DIAG_ProxiLesen,1);
    testWaitForTimeout (200);
    sysSetVariableInt(sysvar::SysVar_PROXI::DIAG_ProxiLesen,0);
    testWaitForTimeout (200);
    sysSetVariableInt(sysvar::SysVar_PROXI::pByte26Bit5,CAN_node5_RRM_Absent);		
    sysSetVariableInt(sysvar::SysVar_PROXI::DIAG_eLoadAll,1);
    testWaitForTimeout (200);
    sysSetVariableInt(sysvar::SysVar_PROXI::DIAG_eLoadAll,0);
testWaitForTimeout (2000);
    sysSetVariableInt(sysvar::SysVar_PROXI::DIAG_eSendProxi,1);
    testWaitForTimeout (200);
    sysSetVariableInt(sysvar::SysVar_PROXI::DIAG_eSendProxi,0);
    testWaitForTimeout (200);
				
}

export testfunction CAN_node6_BSM_Present ()
{
  testModuleTitle("CAN_node6_BSM_Present");
  //write("CAN_node6_BSM_Present");
  
    sysSetVariableInt(sysvar::SysVar_PROXI::DIAG_ProxiLesen,1);
    testWaitForTimeout (200);
    sysSetVariableInt(sysvar::SysVar_PROXI::DIAG_ProxiLesen,0);
    testWaitForTimeout (200);
	sysSetVariableInt(sysvar::SysVar_PROXI::pByte26Bit6,CAN_node6_BSM_Present);		
	sysSetVariableInt(sysvar::SysVar_PROXI::DIAG_eLoadAll,1);
    testWaitForTimeout (200);
    sysSetVariableInt(sysvar::SysVar_PROXI::DIAG_eLoadAll,0);
testWaitForTimeout (2000);
	sysSetVariableInt(sysvar::SysVar_PROXI::DIAG_eSendProxi,1);
    testWaitForTimeout (200);
    sysSetVariableInt(sysvar::SysVar_PROXI::DIAG_eSendProxi,0);
    testWaitForTimeout (200);
				
}

export testfunction CAN_node6_BSM_Absent ()
{
  testModuleTitle("CAN_node6_BSM_Absent");
  //write("CAN_node6_BSM_Absent");
  
    sysSetVariableInt(sysvar::SysVar_PROXI::DIAG_ProxiLesen,1);
    testWaitForTimeout (200);
    sysSetVariableInt(sysvar::SysVar_PROXI::DIAG_ProxiLesen,0);
    testWaitForTimeout (200);
	sysSetVariableInt(sysvar::SysVar_PROXI::pByte26Bit6,CAN_node6_BSM_Absent);		
	sysSetVariableInt(sysvar::SysVar_PROXI::DIAG_eLoadAll,1);
    testWaitForTimeout (200);
    sysSetVariableInt(sysvar::SysVar_PROXI::DIAG_eLoadAll,0);
testWaitForTimeout (2000);
	sysSetVariableInt(sysvar::SysVar_PROXI::DIAG_eSendProxi,1);
    testWaitForTimeout (200);
    sysSetVariableInt(sysvar::SysVar_PROXI::DIAG_eSendProxi,0);
    testWaitForTimeout (200);
				
}

export testfunction  CAN_node8_DDM_DMM_FDM_UDM_Present ()
{
  testModuleTitle(" CAN_node8_DDM_DMM_FDM_UDM_Present");
  //write(" CAN_node8_DDM_DMM_FDM_UDM_Present");
  
    sysSetVariableInt(sysvar::SysVar_PROXI::DIAG_ProxiLesen,1);
    testWaitForTimeout (200);
    sysSetVariableInt(sysvar::SysVar_PROXI::DIAG_ProxiLesen,0);
    testWaitForTimeout (200);
	sysSetVariableInt(sysvar::SysVar_PROXI::pByte27Bit0, CAN_node8_DDM_DMM_FDM_UDM_Present);		
	sysSetVariableInt(sysvar::SysVar_PROXI::DIAG_eLoadAll,1);
    testWaitForTimeout (200);
    sysSetVariableInt(sysvar::SysVar_PROXI::DIAG_eLoadAll,0);
testWaitForTimeout (2000);
	sysSetVariableInt(sysvar::SysVar_PROXI::DIAG_eSendProxi,1);
    testWaitForTimeout (200);
    sysSetVariableInt(sysvar::SysVar_PROXI::DIAG_eSendProxi,0);
    testWaitForTimeout (200);
				
}

export testfunction  CAN_node8_DDM_DMM_FDM_UDM_Absent ()
{
  testModuleTitle(" CAN_node8_DDM_DMM_FDM_UDM_Absent");
  //write(" CAN_node8_DDM_DMM_FDM_UDM_Absent");
  
    sysSetVariableInt(sysvar::SysVar_PROXI::DIAG_ProxiLesen,1);
    testWaitForTimeout (200);
    sysSetVariableInt(sysvar::SysVar_PROXI::DIAG_ProxiLesen,0);
    testWaitForTimeout (200);
	sysSetVariableInt(sysvar::SysVar_PROXI::pByte27Bit0, CAN_node8_DDM_DMM_FDM_UDM_Absent);		
	sysSetVariableInt(sysvar::SysVar_PROXI::DIAG_eLoadAll,1);
    testWaitForTimeout (200);
    sysSetVariableInt(sysvar::SysVar_PROXI::DIAG_eLoadAll,0);
testWaitForTimeout (2000);
	sysSetVariableInt(sysvar::SysVar_PROXI::DIAG_eSendProxi,1);
    testWaitForTimeout (200);
    sysSetVariableInt(sysvar::SysVar_PROXI::DIAG_eSendProxi,0);
    testWaitForTimeout (200);
				
}

export testfunction  CAN_node10_ECC_ACM_MCM_MHM_Present ()
{
  testModuleTitle(" CAN_node10_ECC_ACM_MCM_MHM_Present");
  //write(" CAN_node10_ECC_ACM_MCM_MHM_Present");
  
    sysSetVariableInt(sysvar::SysVar_PROXI::DIAG_ProxiLesen,1);
    testWaitForTimeout (200);
    sysSetVariableInt(sysvar::SysVar_PROXI::DIAG_ProxiLesen,0);
    testWaitForTimeout (200);
	sysSetVariableInt(sysvar::SysVar_PROXI::pByte27Bit2, CAN_node10_ECC_ACM_MCM_MHM_Present);		
	sysSetVariableInt(sysvar::SysVar_PROXI::DIAG_eLoadAll,1);
    testWaitForTimeout (200);
    sysSetVariableInt(sysvar::SysVar_PROXI::DIAG_eLoadAll,0);
testWaitForTimeout (2000);
	sysSetVariableInt(sysvar::SysVar_PROXI::DIAG_eSendProxi,1);
    testWaitForTimeout (200);
    sysSetVariableInt(sysvar::SysVar_PROXI::DIAG_eSendProxi,0);
    testWaitForTimeout (200);
				
}

export testfunction  CAN_node10_ECC_ACM_MCM_MHM_Absent ()
{
  testModuleTitle(" CAN_node10_ECC_ACM_MCM_MHM_Absent");
  //write(" CAN_node10_ECC_ACM_MCM_MHM_Absent");
  
    sysSetVariableInt(sysvar::SysVar_PROXI::DIAG_ProxiLesen,1);
    testWaitForTimeout (200);
    sysSetVariableInt(sysvar::SysVar_PROXI::DIAG_ProxiLesen,0);
    testWaitForTimeout (200);
	sysSetVariableInt(sysvar::SysVar_PROXI::pByte27Bit2, CAN_node10_ECC_ACM_MCM_MHM_Absent);		
	sysSetVariableInt(sysvar::SysVar_PROXI::DIAG_eLoadAll,1);
    testWaitForTimeout (200);
    sysSetVariableInt(sysvar::SysVar_PROXI::DIAG_eLoadAll,0);
testWaitForTimeout (2000);
	sysSetVariableInt(sysvar::SysVar_PROXI::DIAG_eSendProxi,1);
    testWaitForTimeout (200);
    sysSetVariableInt(sysvar::SysVar_PROXI::DIAG_eSendProxi,0);
    testWaitForTimeout (200);
				
}

export testfunction  CAN_node11_MTA_TCM_DCTM_Present ()
{
  testModuleTitle(" CAN_node11_MTA_TCM_DCTM_Present");
  //write(" CAN_node11_MTA_TCM_DCTM_Present");
  
    sysSetVariableInt(sysvar::SysVar_PROXI::DIAG_ProxiLesen,1);
    testWaitForTimeout (200);
    sysSetVariableInt(sysvar::SysVar_PROXI::DIAG_ProxiLesen,0);
    testWaitForTimeout (200);
	sysSetVariableInt(sysvar::SysVar_PROXI::pByte27Bit3, CAN_node11_MTA_TCM_DCTM_Present);		
	sysSetVariableInt(sysvar::SysVar_PROXI::DIAG_eLoadAll,1);
    testWaitForTimeout (200);
    sysSetVariableInt(sysvar::SysVar_PROXI::DIAG_eLoadAll,0);
testWaitForTimeout (2000);
	sysSetVariableInt(sysvar::SysVar_PROXI::DIAG_eSendProxi,1);
    testWaitForTimeout (200);
    sysSetVariableInt(sysvar::SysVar_PROXI::DIAG_eSendProxi,0);
    testWaitForTimeout (200);
				
}

export testfunction  CAN_node11_MTA_TCM_DCTM_Absent ()
{
  testModuleTitle(" CAN_node11_MTA_TCM_DCTM_Absent");
  //write(" CAN_node11_MTA_TCM_DCTM_Absent");
  
    sysSetVariableInt(sysvar::SysVar_PROXI::DIAG_ProxiLesen,1);
    testWaitForTimeout (200);
    sysSetVariableInt(sysvar::SysVar_PROXI::DIAG_ProxiLesen,0);
    testWaitForTimeout (200);
	sysSetVariableInt(sysvar::SysVar_PROXI::pByte27Bit3, CAN_node11_MTA_TCM_DCTM_Absent);		
	sysSetVariableInt(sysvar::SysVar_PROXI::DIAG_eLoadAll,1);
    testWaitForTimeout (200);
    sysSetVariableInt(sysvar::SysVar_PROXI::DIAG_eLoadAll,0);
testWaitForTimeout (2000);
	sysSetVariableInt(sysvar::SysVar_PROXI::DIAG_eSendProxi,1);
    testWaitForTimeout (200);
    sysSetVariableInt(sysvar::SysVar_PROXI::DIAG_eSendProxi,0);
    testWaitForTimeout (200);
				
}

export testfunction  CAN_node22_GSM_STM_AGSM_DCSM_Present ()
{
  testModuleTitle(" CAN_node22_GSM_STM_AGSM_DCSM_Present");
  //write(" CAN_node22_GSM_STM_AGSM_DCSM_Present");
  
    sysSetVariableInt(sysvar::SysVar_PROXI::DIAG_ProxiLesen,1);
    testWaitForTimeout (200);
    sysSetVariableInt(sysvar::SysVar_PROXI::DIAG_ProxiLesen,0);
    testWaitForTimeout (200);
	sysSetVariableInt(sysvar::SysVar_PROXI::pByte28Bit6, CAN_node22_GSM_STM_AGSM_DCSM_Present);		
	sysSetVariableInt(sysvar::SysVar_PROXI::DIAG_eLoadAll,1);
    testWaitForTimeout (200);
    sysSetVariableInt(sysvar::SysVar_PROXI::DIAG_eLoadAll,0);
testWaitForTimeout (2000);
	sysSetVariableInt(sysvar::SysVar_PROXI::DIAG_eSendProxi,1);
    testWaitForTimeout (200);
    sysSetVariableInt(sysvar::SysVar_PROXI::DIAG_eSendProxi,0);
    testWaitForTimeout (200);
				
}

export testfunction  CAN_node22_GSM_STM_AGSM_DCSM_Absent ()
{
  testModuleTitle(" CAN_node22_GSM_STM_AGSM_DCSM_Absent");
  //write(" CAN_node22_GSM_STM_AGSM_DCSM_Absent");
  
    sysSetVariableInt(sysvar::SysVar_PROXI::DIAG_ProxiLesen,1);
    testWaitForTimeout (200);
    sysSetVariableInt(sysvar::SysVar_PROXI::DIAG_ProxiLesen,0);
    testWaitForTimeout (200);
	sysSetVariableInt(sysvar::SysVar_PROXI::pByte28Bit6, CAN_node22_GSM_STM_AGSM_DCSM_Absent);		
	sysSetVariableInt(sysvar::SysVar_PROXI::DIAG_eLoadAll,1);
    testWaitForTimeout (200);
    sysSetVariableInt(sysvar::SysVar_PROXI::DIAG_eLoadAll,0);
testWaitForTimeout (2000);
	sysSetVariableInt(sysvar::SysVar_PROXI::DIAG_eSendProxi,1);
    testWaitForTimeout (200);
    sysSetVariableInt(sysvar::SysVar_PROXI::DIAG_eSendProxi,0);
    testWaitForTimeout (200);
				
}

export testfunction  CAN_node24_PAM_Present ()
{
  testModuleTitle(" CAN_node24_PAM_Present");
  //write(" CAN_node24_PAM_Present");
  
    sysSetVariableInt(sysvar::SysVar_PROXI::DIAG_ProxiLesen,1);
    testWaitForTimeout (200);
    sysSetVariableInt(sysvar::SysVar_PROXI::DIAG_ProxiLesen,0);
    testWaitForTimeout (200);
	sysSetVariableInt(sysvar::SysVar_PROXI::pByte29Bit0, CAN_node24_PAM_Present);		
	sysSetVariableInt(sysvar::SysVar_PROXI::DIAG_eLoadAll,1);
    testWaitForTimeout (200);
    sysSetVariableInt(sysvar::SysVar_PROXI::DIAG_eLoadAll,0);
testWaitForTimeout (2000);
	sysSetVariableInt(sysvar::SysVar_PROXI::DIAG_eSendProxi,1);
    testWaitForTimeout (200);
    sysSetVariableInt(sysvar::SysVar_PROXI::DIAG_eSendProxi,0);
    testWaitForTimeout (200);
				
}

export testfunction  CAN_node24_PAM_Absent ()
{
  testModuleTitle(" CAN_node24_PAM_Absent");
  //write(" CAN_node24_PAM_Absent");
  
    sysSetVariableInt(sysvar::SysVar_PROXI::DIAG_ProxiLesen,1);
    testWaitForTimeout (200);
    sysSetVariableInt(sysvar::SysVar_PROXI::DIAG_ProxiLesen,0);
    testWaitForTimeout (200);
	sysSetVariableInt(sysvar::SysVar_PROXI::pByte29Bit0, CAN_node24_PAM_Absent);		
	sysSetVariableInt(sysvar::SysVar_PROXI::DIAG_eLoadAll,1);
    testWaitForTimeout (200);
    sysSetVariableInt(sysvar::SysVar_PROXI::DIAG_eLoadAll,0);
testWaitForTimeout (2000);
	sysSetVariableInt(sysvar::SysVar_PROXI::DIAG_eSendProxi,1);
    testWaitForTimeout (200);
    sysSetVariableInt(sysvar::SysVar_PROXI::DIAG_eSendProxi,0);
    testWaitForTimeout (200);
				
}

export testfunction  CAN_node26_SDM_ORC_Present ()
{
  testModuleTitle(" CAN_node26_SDM_ORC_Present");
  //write(" CAN_node26_SDM_ORC_Present");
  
    sysSetVariableInt(sysvar::SysVar_PROXI::DIAG_ProxiLesen,1);
    testWaitForTimeout (200);
    sysSetVariableInt(sysvar::SysVar_PROXI::DIAG_ProxiLesen,0);
    testWaitForTimeout (200);
	sysSetVariableInt(sysvar::SysVar_PROXI::pByte29Bit2, CAN_node26_SDM_ORC_Present);		
	sysSetVariableInt(sysvar::SysVar_PROXI::DIAG_eLoadAll,1);
    testWaitForTimeout (200);
    sysSetVariableInt(sysvar::SysVar_PROXI::DIAG_eLoadAll,0);
testWaitForTimeout (2000);
	sysSetVariableInt(sysvar::SysVar_PROXI::DIAG_eSendProxi,1);
    testWaitForTimeout (200);
    sysSetVariableInt(sysvar::SysVar_PROXI::DIAG_eSendProxi,0);
    testWaitForTimeout (200);
				
}

export testfunction  CAN_node26_SDM_ORC_Absent ()
{
  testModuleTitle(" CAN_node26_SDM_ORC_Absent");
  //write(" CAN_node26_SDM_ORC_Absent");
  
    sysSetVariableInt(sysvar::SysVar_PROXI::DIAG_ProxiLesen,1);
    testWaitForTimeout (200);
    sysSetVariableInt(sysvar::SysVar_PROXI::DIAG_ProxiLesen,0);
    testWaitForTimeout (200);
	sysSetVariableInt(sysvar::SysVar_PROXI::pByte29Bit2, CAN_node26_SDM_ORC_Absent);		
	sysSetVariableInt(sysvar::SysVar_PROXI::DIAG_eLoadAll,1);
    testWaitForTimeout (200);
    sysSetVariableInt(sysvar::SysVar_PROXI::DIAG_eLoadAll,0);
testWaitForTimeout (2000);
	sysSetVariableInt(sysvar::SysVar_PROXI::DIAG_eSendProxi,1);
    testWaitForTimeout (200);
    sysSetVariableInt(sysvar::SysVar_PROXI::DIAG_eSendProxi,0);
    testWaitForTimeout (200);
				
}

export testfunction  CAN_node30_HALF_Present ()
{
  testModuleTitle(" CAN_node30_HALF_Present");
  //write(" CAN_node30_HALF_Present");
  
    sysSetVariableInt(sysvar::SysVar_PROXI::DIAG_ProxiLesen,1);
    testWaitForTimeout (200);
    sysSetVariableInt(sysvar::SysVar_PROXI::DIAG_ProxiLesen,0);
    testWaitForTimeout (200);
	sysSetVariableInt(sysvar::SysVar_PROXI::pByte29Bit6, CAN_node30_HALF_Present);		
	sysSetVariableInt(sysvar::SysVar_PROXI::DIAG_eLoadAll,1);
    testWaitForTimeout (200);
    sysSetVariableInt(sysvar::SysVar_PROXI::DIAG_eLoadAll,0);
testWaitForTimeout (2000);
	sysSetVariableInt(sysvar::SysVar_PROXI::DIAG_eSendProxi,1);
    testWaitForTimeout (200);
    sysSetVariableInt(sysvar::SysVar_PROXI::DIAG_eSendProxi,0);
    testWaitForTimeout (200);
				
}

export testfunction  CAN_node30_HALF_Absent ()
{
  testModuleTitle(" CAN_node30_HALF_Absent");
  //write(" CAN_node30_HALF_Absent");
  
    sysSetVariableInt(sysvar::SysVar_PROXI::DIAG_ProxiLesen,1);
    testWaitForTimeout (200);
    sysSetVariableInt(sysvar::SysVar_PROXI::DIAG_ProxiLesen,0);
    testWaitForTimeout (200);
	sysSetVariableInt(sysvar::SysVar_PROXI::pByte29Bit6, CAN_node30_HALF_Absent);		
	sysSetVariableInt(sysvar::SysVar_PROXI::DIAG_eLoadAll,1);
    testWaitForTimeout (200);
    sysSetVariableInt(sysvar::SysVar_PROXI::DIAG_eLoadAll,0);
testWaitForTimeout (2000);
	sysSetVariableInt(sysvar::SysVar_PROXI::DIAG_eSendProxi,1);
    testWaitForTimeout (200);
    sysSetVariableInt(sysvar::SysVar_PROXI::DIAG_eSendProxi,0);
    testWaitForTimeout (200);
				
}

export testfunction  CAN_node35_TBM_Present ()
{
  testModuleTitle(" CAN_node35_TBM_Present");
  //write(" CAN_node35_TBM_Present");
  
    sysSetVariableInt(sysvar::SysVar_PROXI::DIAG_ProxiLesen,1);
    testWaitForTimeout (200);
    sysSetVariableInt(sysvar::SysVar_PROXI::DIAG_ProxiLesen,0);
    testWaitForTimeout (200);
	sysSetVariableInt(sysvar::SysVar_PROXI::pByte30Bit3, CAN_node35_TBM_Present);		
	sysSetVariableInt(sysvar::SysVar_PROXI::DIAG_eLoadAll,1);
    testWaitForTimeout (200);
    sysSetVariableInt(sysvar::SysVar_PROXI::DIAG_eLoadAll,0);
testWaitForTimeout (2000);
	sysSetVariableInt(sysvar::SysVar_PROXI::DIAG_eSendProxi,1);
    testWaitForTimeout (200);
    sysSetVariableInt(sysvar::SysVar_PROXI::DIAG_eSendProxi,0);
    testWaitForTimeout (200);
				
}

export testfunction  CAN_node35_TBM_Absent ()
{
  testModuleTitle(" CAN_node35_TBM_Absent");
  //write(" CAN_node35_TBM_Absent");
  
    sysSetVariableInt(sysvar::SysVar_PROXI::DIAG_ProxiLesen,1);
    testWaitForTimeout (200);
    sysSetVariableInt(sysvar::SysVar_PROXI::DIAG_ProxiLesen,0);
    testWaitForTimeout (200);
	sysSetVariableInt(sysvar::SysVar_PROXI::pByte30Bit3, CAN_node35_TBM_Absent);		
	sysSetVariableInt(sysvar::SysVar_PROXI::DIAG_eLoadAll,1);
    testWaitForTimeout (200);
    sysSetVariableInt(sysvar::SysVar_PROXI::DIAG_eLoadAll,0);
testWaitForTimeout (2000);
	sysSetVariableInt(sysvar::SysVar_PROXI::DIAG_eSendProxi,1);
    testWaitForTimeout (200);
    sysSetVariableInt(sysvar::SysVar_PROXI::DIAG_eSendProxi,0);
    testWaitForTimeout (200);
				
}

export testfunction  CAN_node36_LTM_ETM_HTM_Present ()
{
  testModuleTitle(" CAN_node36_LTM_ETM_HTM_Present");
  //write(" CAN_node36_LTM_ETM_HTM_Present");
  
    sysSetVariableInt(sysvar::SysVar_PROXI::DIAG_ProxiLesen,1);
    testWaitForTimeout (200);
    sysSetVariableInt(sysvar::SysVar_PROXI::DIAG_ProxiLesen,0);
    testWaitForTimeout (200);
	sysSetVariableInt(sysvar::SysVar_PROXI::pByte30Bit4, CAN_node36_LTM_ETM_HTM_Present);		
	sysSetVariableInt(sysvar::SysVar_PROXI::DIAG_eLoadAll,1);
    testWaitForTimeout (200);
    sysSetVariableInt(sysvar::SysVar_PROXI::DIAG_eLoadAll,0);
testWaitForTimeout (2000);
	sysSetVariableInt(sysvar::SysVar_PROXI::DIAG_eSendProxi,1);
    testWaitForTimeout (200);
    sysSetVariableInt(sysvar::SysVar_PROXI::DIAG_eSendProxi,0);
    testWaitForTimeout (200);
				
}

export testfunction  CAN_node36_LTM_ETM_HTM_Absent ()
{
  testModuleTitle(" CAN_node36_LTM_ETM_HTM_Absent");
  //write(" CAN_node36_LTM_ETM_HTM_Absent");
  
    sysSetVariableInt(sysvar::SysVar_PROXI::DIAG_ProxiLesen,1);
    testWaitForTimeout (200);
    sysSetVariableInt(sysvar::SysVar_PROXI::DIAG_ProxiLesen,0);
    testWaitForTimeout (200);
	sysSetVariableInt(sysvar::SysVar_PROXI::pByte30Bit4, CAN_node36_LTM_ETM_HTM_Absent);		
	sysSetVariableInt(sysvar::SysVar_PROXI::DIAG_eLoadAll,1);
    testWaitForTimeout (200);
    sysSetVariableInt(sysvar::SysVar_PROXI::DIAG_eLoadAll,0);
testWaitForTimeout (2000);
	sysSetVariableInt(sysvar::SysVar_PROXI::DIAG_eSendProxi,1);
    testWaitForTimeout (200);
    sysSetVariableInt(sysvar::SysVar_PROXI::DIAG_eSendProxi,0);
    testWaitForTimeout (200);
				
}

export testfunction  CAN_node46_AMP_Present ()
{
  testModuleTitle(" CAN_node46_AMP_Present");
  //write(" CAN_node46_AMP_Present");
  
    sysSetVariableInt(sysvar::SysVar_PROXI::DIAG_ProxiLesen,1);
    testWaitForTimeout (200);
    sysSetVariableInt(sysvar::SysVar_PROXI::DIAG_ProxiLesen,0);
    testWaitForTimeout (200);
	sysSetVariableInt(sysvar::SysVar_PROXI::pByte31Bit6, CAN_node46_AMP_Present);		
	sysSetVariableInt(sysvar::SysVar_PROXI::DIAG_eLoadAll,1);
    testWaitForTimeout (200);
    sysSetVariableInt(sysvar::SysVar_PROXI::DIAG_eLoadAll,0);
testWaitForTimeout (2000);
	sysSetVariableInt(sysvar::SysVar_PROXI::DIAG_eSendProxi,1);
    testWaitForTimeout (200);
    sysSetVariableInt(sysvar::SysVar_PROXI::DIAG_eSendProxi,0);
    testWaitForTimeout (200);
				
}

export testfunction  CAN_node46_AMP_Absent ()
{
  testModuleTitle(" CAN_node46_AMP_Absent");
  //write(" CAN_node46_AMP_Absent");
  
    sysSetVariableInt(sysvar::SysVar_PROXI::DIAG_ProxiLesen,1);
    testWaitForTimeout (200);
    sysSetVariableInt(sysvar::SysVar_PROXI::DIAG_ProxiLesen,0);
    testWaitForTimeout (200);
	sysSetVariableInt(sysvar::SysVar_PROXI::pByte31Bit6, CAN_node46_AMP_Absent);		
	sysSetVariableInt(sysvar::SysVar_PROXI::DIAG_eLoadAll,1);
    testWaitForTimeout (200);
    sysSetVariableInt(sysvar::SysVar_PROXI::DIAG_eLoadAll,0);
testWaitForTimeout (2000);
	sysSetVariableInt(sysvar::SysVar_PROXI::DIAG_eSendProxi,1);
    testWaitForTimeout (200);
    sysSetVariableInt(sysvar::SysVar_PROXI::DIAG_eSendProxi,0);
    testWaitForTimeout (200);
				
}

export testfunction  CAN_node47_CDM_Present ()
{
  testModuleTitle(" CAN_node47_CDM_Present");
  //write(" CAN_node47_CDM_Present");
  
    sysSetVariableInt(sysvar::SysVar_PROXI::DIAG_ProxiLesen,1);
    testWaitForTimeout (200);
    sysSetVariableInt(sysvar::SysVar_PROXI::DIAG_ProxiLesen,0);
    testWaitForTimeout (200);
	sysSetVariableInt(sysvar::SysVar_PROXI::pByte31Bit7, CAN_node47_CDM_Present);		
	sysSetVariableInt(sysvar::SysVar_PROXI::DIAG_eLoadAll,1);
    testWaitForTimeout (200);
    sysSetVariableInt(sysvar::SysVar_PROXI::DIAG_eLoadAll,0);
testWaitForTimeout (2000);
	sysSetVariableInt(sysvar::SysVar_PROXI::DIAG_eSendProxi,1);
    testWaitForTimeout (200);
    sysSetVariableInt(sysvar::SysVar_PROXI::DIAG_eSendProxi,0);
    testWaitForTimeout (200);
				
}

export testfunction  CAN_node47_CDM_Absent ()
{
  testModuleTitle(" CAN_node47_CDM_Absent");
  //write(" CAN_node47_CDM_Absent");
  
    sysSetVariableInt(sysvar::SysVar_PROXI::DIAG_ProxiLesen,1);
    testWaitForTimeout (200);
    sysSetVariableInt(sysvar::SysVar_PROXI::DIAG_ProxiLesen,0);
    testWaitForTimeout (200);
	sysSetVariableInt(sysvar::SysVar_PROXI::pByte31Bit7, CAN_node47_CDM_Absent);		
	sysSetVariableInt(sysvar::SysVar_PROXI::DIAG_eLoadAll,1);
    testWaitForTimeout (200);
    sysSetVariableInt(sysvar::SysVar_PROXI::DIAG_eLoadAll,0);
testWaitForTimeout (2000);
	sysSetVariableInt(sysvar::SysVar_PROXI::DIAG_eSendProxi,1);
    testWaitForTimeout (200);
    sysSetVariableInt(sysvar::SysVar_PROXI::DIAG_eSendProxi,0);
    testWaitForTimeout (200);
				
}

export testfunction  CAN_node49_VTM_Present ()
{
  testModuleTitle(" CAN_node49_VTM_Present");
  //write(" CAN_node49_VTM_Present");
  
    sysSetVariableInt(sysvar::SysVar_PROXI::DIAG_ProxiLesen,1);
    testWaitForTimeout (200);
    sysSetVariableInt(sysvar::SysVar_PROXI::DIAG_ProxiLesen,0);
    testWaitForTimeout (200);
	sysSetVariableInt(sysvar::SysVar_PROXI::pByte32Bit1, CAN_node49_VTM_Present);		
	sysSetVariableInt(sysvar::SysVar_PROXI::DIAG_eLoadAll,1);
    testWaitForTimeout (200);
    sysSetVariableInt(sysvar::SysVar_PROXI::DIAG_eLoadAll,0);
testWaitForTimeout (2000);
	sysSetVariableInt(sysvar::SysVar_PROXI::DIAG_eSendProxi,1);
    testWaitForTimeout (200);
    sysSetVariableInt(sysvar::SysVar_PROXI::DIAG_eSendProxi,0);
    testWaitForTimeout (200);
				
}

export testfunction  CAN_node49_VTM_Absent ()
{
  testModuleTitle(" CAN_node49_VTM_Absent");
  //write(" CAN_node49_VTM_Absent");
  
    sysSetVariableInt(sysvar::SysVar_PROXI::DIAG_ProxiLesen,1);
    testWaitForTimeout (200);
    sysSetVariableInt(sysvar::SysVar_PROXI::DIAG_ProxiLesen,0);
    testWaitForTimeout (200);
	sysSetVariableInt(sysvar::SysVar_PROXI::pByte32Bit1, CAN_node49_VTM_Absent);		
	sysSetVariableInt(sysvar::SysVar_PROXI::DIAG_eLoadAll,1);
    testWaitForTimeout (200);
    sysSetVariableInt(sysvar::SysVar_PROXI::DIAG_eLoadAll,0);
testWaitForTimeout (2000);
	sysSetVariableInt(sysvar::SysVar_PROXI::DIAG_eSendProxi,1);
    testWaitForTimeout (200);
    sysSetVariableInt(sysvar::SysVar_PROXI::DIAG_eSendProxi,0);
    testWaitForTimeout (200);
				
}

export testfunction  CAN_node50_ICS_HCPM_Present ()
{
  testModuleTitle(" CAN_node50_ICS_HCPM_Present");
  //write(" CAN_node50_ICS_HCPM_Present");
  
    sysSetVariableInt(sysvar::SysVar_PROXI::DIAG_ProxiLesen,1);
    testWaitForTimeout (200);
    sysSetVariableInt(sysvar::SysVar_PROXI::DIAG_ProxiLesen,0);
    testWaitForTimeout (200);
	sysSetVariableInt(sysvar::SysVar_PROXI::pByte32Bit2, CAN_node50_ICS_HCPM_Present);		
	sysSetVariableInt(sysvar::SysVar_PROXI::DIAG_eLoadAll,1);
    testWaitForTimeout (200);
    sysSetVariableInt(sysvar::SysVar_PROXI::DIAG_eLoadAll,0);
testWaitForTimeout (2000);
	sysSetVariableInt(sysvar::SysVar_PROXI::DIAG_eSendProxi,1);
    testWaitForTimeout (200);
    sysSetVariableInt(sysvar::SysVar_PROXI::DIAG_eSendProxi,0);
    testWaitForTimeout (200);
				
}

export testfunction  CAN_node50_ICS_HCPM_Absent ()
{
  testModuleTitle(" CAN_node50_ICS_HCPM_Absent");
  //write(" CAN_node50_ICS_HCPM_Absent");
  
    sysSetVariableInt(sysvar::SysVar_PROXI::DIAG_ProxiLesen,1);
    testWaitForTimeout (200);
    sysSetVariableInt(sysvar::SysVar_PROXI::DIAG_ProxiLesen,0);
    testWaitForTimeout (200);
	sysSetVariableInt(sysvar::SysVar_PROXI::pByte32Bit2, CAN_node50_ICS_HCPM_Absent);		
	sysSetVariableInt(sysvar::SysVar_PROXI::DIAG_eLoadAll,1);
    testWaitForTimeout (200);
    sysSetVariableInt(sysvar::SysVar_PROXI::DIAG_eLoadAll,0);
testWaitForTimeout (2000);
	sysSetVariableInt(sysvar::SysVar_PROXI::DIAG_eSendProxi,1);
    testWaitForTimeout (200);
    sysSetVariableInt(sysvar::SysVar_PROXI::DIAG_eSendProxi,0);
    testWaitForTimeout (200);
				
}

export testfunction  CAN_node51_LBSS_Present ()
{
  testModuleTitle(" CAN_node51_LBSS_Present");
  //write(" CAN_node51_LBSS_Present");
  
    sysSetVariableInt(sysvar::SysVar_PROXI::DIAG_ProxiLesen,1);
    testWaitForTimeout (200);
    sysSetVariableInt(sysvar::SysVar_PROXI::DIAG_ProxiLesen,0);
    testWaitForTimeout (200);
	sysSetVariableInt(sysvar::SysVar_PROXI::pByte32Bit3, CAN_node51_LBSS_Present);		
	sysSetVariableInt(sysvar::SysVar_PROXI::DIAG_eLoadAll,1);
    testWaitForTimeout (200);
    sysSetVariableInt(sysvar::SysVar_PROXI::DIAG_eLoadAll,0);
testWaitForTimeout (2000);
	sysSetVariableInt(sysvar::SysVar_PROXI::DIAG_eSendProxi,1);
    testWaitForTimeout (200);
    sysSetVariableInt(sysvar::SysVar_PROXI::DIAG_eSendProxi,0);
    testWaitForTimeout (200);
				
}

export testfunction  CAN_node51_LBSS_Absent ()
{
  testModuleTitle(" CAN_node51_LBSS_Absent");
  //write(" CAN_node51_LBSS_Absent");
  
    sysSetVariableInt(sysvar::SysVar_PROXI::DIAG_ProxiLesen,1);
    testWaitForTimeout (200);
    sysSetVariableInt(sysvar::SysVar_PROXI::DIAG_ProxiLesen,0);
    testWaitForTimeout (200);
	sysSetVariableInt(sysvar::SysVar_PROXI::pByte32Bit3, CAN_node51_LBSS_Absent);		
	sysSetVariableInt(sysvar::SysVar_PROXI::DIAG_eLoadAll,1);
    testWaitForTimeout (200);
    sysSetVariableInt(sysvar::SysVar_PROXI::DIAG_eLoadAll,0);
testWaitForTimeout (2000);
	sysSetVariableInt(sysvar::SysVar_PROXI::DIAG_eSendProxi,1);
    testWaitForTimeout (200);
    sysSetVariableInt(sysvar::SysVar_PROXI::DIAG_eSendProxi,0);
    testWaitForTimeout (200);
				
}

export testfunction  CAN_node52_RBSS_Present ()
{
  testModuleTitle(" CAN_node52_RBSS_Present");
  //write(" CAN_node52_RBSS_Present");
  
    sysSetVariableInt(sysvar::SysVar_PROXI::DIAG_ProxiLesen,1);
    testWaitForTimeout (200);
    sysSetVariableInt(sysvar::SysVar_PROXI::DIAG_ProxiLesen,0);
    testWaitForTimeout (200);
	sysSetVariableInt(sysvar::SysVar_PROXI::pByte32Bit4, CAN_node52_RBSS_Present);		
	sysSetVariableInt(sysvar::SysVar_PROXI::DIAG_eLoadAll,1);
    testWaitForTimeout (200);
    sysSetVariableInt(sysvar::SysVar_PROXI::DIAG_eLoadAll,0);
testWaitForTimeout (2000);
	sysSetVariableInt(sysvar::SysVar_PROXI::DIAG_eSendProxi,1);
    testWaitForTimeout (200);
    sysSetVariableInt(sysvar::SysVar_PROXI::DIAG_eSendProxi,0);
    testWaitForTimeout (200);
				
}

export testfunction  CAN_node52_RBSS_Absent ()
{
  testModuleTitle(" CAN_node52_RBSS_Absent");
  //write(" CAN_node52_RBSS_Absent");
  
    sysSetVariableInt(sysvar::SysVar_PROXI::DIAG_ProxiLesen,1);
    testWaitForTimeout (200);
    sysSetVariableInt(sysvar::SysVar_PROXI::DIAG_ProxiLesen,0);
    testWaitForTimeout (200);
	sysSetVariableInt(sysvar::SysVar_PROXI::pByte32Bit4, CAN_node52_RBSS_Absent);		
	sysSetVariableInt(sysvar::SysVar_PROXI::DIAG_eLoadAll,1);
    testWaitForTimeout (200);
    sysSetVariableInt(sysvar::SysVar_PROXI::DIAG_eLoadAll,0);
testWaitForTimeout (2000);
	sysSetVariableInt(sysvar::SysVar_PROXI::DIAG_eSendProxi,1);
    testWaitForTimeout (200);
    sysSetVariableInt(sysvar::SysVar_PROXI::DIAG_eSendProxi,0);
    testWaitForTimeout (200);
				
}

export testfunction  CAN_node57_DASM_Present ()
{
  testModuleTitle(" CAN_node57_DASM_Present");
  //write(" CAN_node57_DASM_Present");
  
    sysSetVariableInt(sysvar::SysVar_PROXI::DIAG_ProxiLesen,1);
    testWaitForTimeout (200);
    sysSetVariableInt(sysvar::SysVar_PROXI::DIAG_ProxiLesen,0);
    testWaitForTimeout (200);
	  sysSetVariableInt(sysvar::SysVar_PROXI::pByte33Bit1, CAN_node57_DASM_Present);		
	  sysSetVariableInt(sysvar::SysVar_PROXI::DIAG_eLoadAll,1);
    testWaitForTimeout (200);
    sysSetVariableInt(sysvar::SysVar_PROXI::DIAG_eLoadAll,0);
testWaitForTimeout (2000);
	  sysSetVariableInt(sysvar::SysVar_PROXI::DIAG_eSendProxi,1);
    testWaitForTimeout (200);
    sysSetVariableInt(sysvar::SysVar_PROXI::DIAG_eSendProxi,0);
    testWaitForTimeout (200);
				
}

export testfunction  CAN_node57_DASM_Absent ()
{
  testModuleTitle(" CAN_node57_DASM_Absent");
  //write(" CAN_node57_DASM_Absent");
  
    sysSetVariableInt(sysvar::SysVar_PROXI::DIAG_ProxiLesen,1);
    testWaitForTimeout (200);
    sysSetVariableInt(sysvar::SysVar_PROXI::DIAG_ProxiLesen,0);
    testWaitForTimeout (200);
	sysSetVariableInt(sysvar::SysVar_PROXI::pByte33Bit1, CAN_node57_DASM_Absent);		
	sysSetVariableInt(sysvar::SysVar_PROXI::DIAG_eLoadAll,1);
    testWaitForTimeout (200);
    sysSetVariableInt(sysvar::SysVar_PROXI::DIAG_eLoadAll,0);
testWaitForTimeout (2000);
	sysSetVariableInt(sysvar::SysVar_PROXI::DIAG_eSendProxi,1);
    testWaitForTimeout (200);
    sysSetVariableInt(sysvar::SysVar_PROXI::DIAG_eSendProxi,0);
    testWaitForTimeout (200);
				
}

export testfunction  CAN_node63_TTM_Present ()
{
  testModuleTitle(" CAN_node63_TTM_Present");
  //write(" CAN_node63_TTM_Present");
  
    sysSetVariableInt(sysvar::SysVar_PROXI::DIAG_ProxiLesen,1);
    testWaitForTimeout (200);
    sysSetVariableInt(sysvar::SysVar_PROXI::DIAG_ProxiLesen,0);
    testWaitForTimeout (200);
	sysSetVariableInt(sysvar::SysVar_PROXI::pByte33Bit7, CAN_node63_TTM_Present);		
	sysSetVariableInt(sysvar::SysVar_PROXI::DIAG_eLoadAll,1);
    testWaitForTimeout (200);
    sysSetVariableInt(sysvar::SysVar_PROXI::DIAG_eLoadAll,0);
testWaitForTimeout (2000);
	sysSetVariableInt(sysvar::SysVar_PROXI::DIAG_eSendProxi,1);
    testWaitForTimeout (200);
    sysSetVariableInt(sysvar::SysVar_PROXI::DIAG_eSendProxi,0);
    testWaitForTimeout (200);
				
}

export testfunction  CAN_node63_TTM_Absent ()
{
  testModuleTitle(" CAN_node63_TTM_Absent");
  //write(" CAN_node63_TTM_Absent");
  
    sysSetVariableInt(sysvar::SysVar_PROXI::DIAG_ProxiLesen,1);
    testWaitForTimeout (200);
    sysSetVariableInt(sysvar::SysVar_PROXI::DIAG_ProxiLesen,0);
    testWaitForTimeout (200);
	sysSetVariableInt(sysvar::SysVar_PROXI::pByte33Bit7, CAN_node63_TTM_Absent);		
	sysSetVariableInt(sysvar::SysVar_PROXI::DIAG_eLoadAll,1);
    testWaitForTimeout (200);
    sysSetVariableInt(sysvar::SysVar_PROXI::DIAG_eLoadAll,0);
testWaitForTimeout (2000);
	sysSetVariableInt(sysvar::SysVar_PROXI::DIAG_eSendProxi,1);
    testWaitForTimeout (200);
    sysSetVariableInt(sysvar::SysVar_PROXI::DIAG_eSendProxi,0);
    testWaitForTimeout (200);
				
}

export testfunction  CAN_node65_RFHM_Present ()
{
  testModuleTitle(" CAN_node65_RFHM_Present");
  //write(" CAN_node65_RFHM_Present");
  
    sysSetVariableInt(sysvar::SysVar_PROXI::DIAG_ProxiLesen,1);
    testWaitForTimeout (200);
    sysSetVariableInt(sysvar::SysVar_PROXI::DIAG_ProxiLesen,0);
    testWaitForTimeout (200);
	sysSetVariableInt(sysvar::SysVar_PROXI::pByte34Bit1, CAN_node65_RFHM_Present);		
	sysSetVariableInt(sysvar::SysVar_PROXI::DIAG_eLoadAll,1);
    testWaitForTimeout (200);
    sysSetVariableInt(sysvar::SysVar_PROXI::DIAG_eLoadAll,0);
testWaitForTimeout (2000);
	sysSetVariableInt(sysvar::SysVar_PROXI::DIAG_eSendProxi,1);
    testWaitForTimeout (200);
    sysSetVariableInt(sysvar::SysVar_PROXI::DIAG_eSendProxi,0);
    testWaitForTimeout (200);
				
}

export testfunction  CAN_node65_RFHM_Absent ()
{
  testModuleTitle(" CAN_node65_RFHM_Absent");
  //write(" CAN_node65_RFHM_Absent");
  
    sysSetVariableInt(sysvar::SysVar_PROXI::DIAG_ProxiLesen,1);
    testWaitForTimeout (200);
    sysSetVariableInt(sysvar::SysVar_PROXI::DIAG_ProxiLesen,0);
    testWaitForTimeout (200);
	sysSetVariableInt(sysvar::SysVar_PROXI::pByte34Bit1, CAN_node65_RFHM_Absent);		
	sysSetVariableInt(sysvar::SysVar_PROXI::DIAG_eLoadAll,1);
    testWaitForTimeout (200);
    sysSetVariableInt(sysvar::SysVar_PROXI::DIAG_eLoadAll,0);
testWaitForTimeout (2000);
	sysSetVariableInt(sysvar::SysVar_PROXI::DIAG_eSendProxi,1);
    testWaitForTimeout (200);
    sysSetVariableInt(sysvar::SysVar_PROXI::DIAG_eSendProxi,0);
    testWaitForTimeout (200);
				
}

export testfunction  CAN_node67_DTCM_Present ()
{
  testModuleTitle(" CAN_node67_DTCM_Present");
  //write(" CAN_node67_DTCM_Present");
  
    sysSetVariableInt(sysvar::SysVar_PROXI::DIAG_ProxiLesen,1);
    testWaitForTimeout (200);
    sysSetVariableInt(sysvar::SysVar_PROXI::DIAG_ProxiLesen,0);
    testWaitForTimeout (200);
	sysSetVariableInt(sysvar::SysVar_PROXI::pByte50Bit3, CAN_node67_DTCM_Present);		
	sysSetVariableInt(sysvar::SysVar_PROXI::DIAG_eLoadAll,1);
    testWaitForTimeout (200);
    sysSetVariableInt(sysvar::SysVar_PROXI::DIAG_eLoadAll,0);
testWaitForTimeout (2000);
	sysSetVariableInt(sysvar::SysVar_PROXI::DIAG_eSendProxi,1);
    testWaitForTimeout (200);
    sysSetVariableInt(sysvar::SysVar_PROXI::DIAG_eSendProxi,0);
    testWaitForTimeout (200);
				
}

export testfunction  CAN_node67_DTCM_Absent ()
{
  testModuleTitle(" CAN_node67_DTCM_Absent");
  //write(" CAN_node67_DTCM_Absent");
  
    sysSetVariableInt(sysvar::SysVar_PROXI::DIAG_ProxiLesen,1);
    testWaitForTimeout (200);
    sysSetVariableInt(sysvar::SysVar_PROXI::DIAG_ProxiLesen,0);
    testWaitForTimeout (200);
	sysSetVariableInt(sysvar::SysVar_PROXI::pByte50Bit3, CAN_node67_DTCM_Absent);		
	sysSetVariableInt(sysvar::SysVar_PROXI::DIAG_eLoadAll,1);
    testWaitForTimeout (200);
    sysSetVariableInt(sysvar::SysVar_PROXI::DIAG_eLoadAll,0);
testWaitForTimeout (2000);
	sysSetVariableInt(sysvar::SysVar_PROXI::DIAG_eSendProxi,1);
    testWaitForTimeout (200);
    sysSetVariableInt(sysvar::SysVar_PROXI::DIAG_eSendProxi,0);
    testWaitForTimeout (200);
				
}

export testfunction CAN_node_eol0_BCM_Present ()
{
  testModuleTitle("CAN_node_eol0_BCM_Present");
  //write("CAN_node_eol0_BCM_Present");
  
    sysSetVariableInt(sysvar::SysVar_PROXI::DIAG_ProxiLesen,1);
    testWaitForTimeout (200);
    sysSetVariableInt(sysvar::SysVar_PROXI::DIAG_ProxiLesen,0);
    testWaitForTimeout (200);
    sysSetVariableInt(sysvar::SysVar_PROXI::pByte42Bit0,CAN_node_eol0_BCM_Present);		
    sysSetVariableInt(sysvar::SysVar_PROXI::DIAG_eLoadAll,1);
    testWaitForTimeout (200);
    sysSetVariableInt(sysvar::SysVar_PROXI::DIAG_eLoadAll,0);
testWaitForTimeout (2000);
    sysSetVariableInt(sysvar::SysVar_PROXI::DIAG_eSendProxi,1);
    testWaitForTimeout (200);
    sysSetVariableInt(sysvar::SysVar_PROXI::DIAG_eSendProxi,0);
    testWaitForTimeout (200);
				
}

export testfunction CAN_node_eol0_BCM_Absent ()
{
  testModuleTitle("CAN_node_eol0_BCM_Absent");
  //write("CAN_node_eol0_BCM_Absent");
  
    sysSetVariableInt(sysvar::SysVar_PROXI::DIAG_ProxiLesen,1);
    testWaitForTimeout (200);
    sysSetVariableInt(sysvar::SysVar_PROXI::DIAG_ProxiLesen,0);
    testWaitForTimeout (200);
    sysSetVariableInt(sysvar::SysVar_PROXI::pByte42Bit0,CAN_node_eol0_BCM_Absent);		
    sysSetVariableInt(sysvar::SysVar_PROXI::DIAG_eLoadAll,1);
    testWaitForTimeout (200);
    sysSetVariableInt(sysvar::SysVar_PROXI::DIAG_eLoadAll,0);
testWaitForTimeout (2000);
    sysSetVariableInt(sysvar::SysVar_PROXI::DIAG_eSendProxi,1);
    testWaitForTimeout (200);
    sysSetVariableInt(sysvar::SysVar_PROXI::DIAG_eSendProxi,0);
    testWaitForTimeout (200);
				
}

export testfunction CAN_node_eol1_ECM_Present ()
{
  testModuleTitle("CAN_node_eol1_ECM_Present");
  //write("CAN_node_eol1_ECM_Present");
  
    sysSetVariableInt(sysvar::SysVar_PROXI::DIAG_ProxiLesen,1);
    testWaitForTimeout (200);
    sysSetVariableInt(sysvar::SysVar_PROXI::DIAG_ProxiLesen,0);
    testWaitForTimeout (200);
    sysSetVariableInt(sysvar::SysVar_PROXI::pByte42Bit1,CAN_node_eol1_ECM_Present);		
    sysSetVariableInt(sysvar::SysVar_PROXI::DIAG_eLoadAll,1);
    testWaitForTimeout (200);
    sysSetVariableInt(sysvar::SysVar_PROXI::DIAG_eLoadAll,0);
testWaitForTimeout (2000);
    sysSetVariableInt(sysvar::SysVar_PROXI::DIAG_eSendProxi,1);
    testWaitForTimeout (200);
    sysSetVariableInt(sysvar::SysVar_PROXI::DIAG_eSendProxi,0);
    testWaitForTimeout (200);
				
}

export testfunction CAN_node_eol1_ECM_Absent ()
{
  testModuleTitle("CAN_node_eol1_ECM_Absent");
  //write("CAN_node_eol1_ECM_Absent");
  
    sysSetVariableInt(sysvar::SysVar_PROXI::DIAG_ProxiLesen,1);
    testWaitForTimeout (200);
    sysSetVariableInt(sysvar::SysVar_PROXI::DIAG_ProxiLesen,0);
    testWaitForTimeout (200);
    sysSetVariableInt(sysvar::SysVar_PROXI::pByte42Bit1,CAN_node_eol1_ECM_Absent);		
    sysSetVariableInt(sysvar::SysVar_PROXI::DIAG_eLoadAll,1);
    testWaitForTimeout (200);
    sysSetVariableInt(sysvar::SysVar_PROXI::DIAG_eLoadAll,0);
testWaitForTimeout (2000);
    sysSetVariableInt(sysvar::SysVar_PROXI::DIAG_eSendProxi,1);
    testWaitForTimeout (200);
    sysSetVariableInt(sysvar::SysVar_PROXI::DIAG_eSendProxi,0);
    testWaitForTimeout (200);
				
}

export testfunction CAN_node_eol2_EPS_Present ()
{
  testModuleTitle("CAN_node_eol2_EPS_Present");
  //write("CAN_node_eol2_EPS_Present");
  
    sysSetVariableInt(sysvar::SysVar_PROXI::DIAG_ProxiLesen,1);
    testWaitForTimeout (200);
    sysSetVariableInt(sysvar::SysVar_PROXI::DIAG_ProxiLesen,0);
    testWaitForTimeout (200);
    sysSetVariableInt(sysvar::SysVar_PROXI::pByte42Bit2,CAN_node_eol2_EPS_Present);		
    sysSetVariableInt(sysvar::SysVar_PROXI::DIAG_eLoadAll,1);
    testWaitForTimeout (200);
    sysSetVariableInt(sysvar::SysVar_PROXI::DIAG_eLoadAll,0);
testWaitForTimeout (2000);
    sysSetVariableInt(sysvar::SysVar_PROXI::DIAG_eSendProxi,1);
    testWaitForTimeout (200);
    sysSetVariableInt(sysvar::SysVar_PROXI::DIAG_eSendProxi,0);
    testWaitForTimeout (200);
				
}

export testfunction CAN_node_eol2_EPS_Absent ()
{
  testModuleTitle("CAN_node_eol2_EPS_Absent");
  //write("CAN_node_eol2_EPS_Absent");
  
    sysSetVariableInt(sysvar::SysVar_PROXI::DIAG_ProxiLesen,1);
    testWaitForTimeout (200);
    sysSetVariableInt(sysvar::SysVar_PROXI::DIAG_ProxiLesen,0);
    testWaitForTimeout (200);
    sysSetVariableInt(sysvar::SysVar_PROXI::pByte42Bit2,CAN_node_eol2_EPS_Absent);		
    sysSetVariableInt(sysvar::SysVar_PROXI::DIAG_eLoadAll,1);
    testWaitForTimeout (200);
    sysSetVariableInt(sysvar::SysVar_PROXI::DIAG_eLoadAll,0);
testWaitForTimeout (2000);
    sysSetVariableInt(sysvar::SysVar_PROXI::DIAG_eSendProxi,1);
    testWaitForTimeout (200);
    sysSetVariableInt(sysvar::SysVar_PROXI::DIAG_eSendProxi,0);
    testWaitForTimeout (200);
				
}

export testfunction CAN_node_eol3_IPC_Present ()
{
  testModuleTitle("CAN_node_eol3_IPC_Present");
  //write("CAN_node_eol3_IPC_Present");
  
    sysSetVariableInt(sysvar::SysVar_PROXI::DIAG_ProxiLesen,1);
    testWaitForTimeout (200);
    sysSetVariableInt(sysvar::SysVar_PROXI::DIAG_ProxiLesen,0);
    testWaitForTimeout (200);
    sysSetVariableInt(sysvar::SysVar_PROXI::pByte42Bit3,CAN_node_eol3_IPC_Present);		
    sysSetVariableInt(sysvar::SysVar_PROXI::DIAG_eLoadAll,1);
    testWaitForTimeout (200);
    sysSetVariableInt(sysvar::SysVar_PROXI::DIAG_eLoadAll,0);
testWaitForTimeout (2000);
    sysSetVariableInt(sysvar::SysVar_PROXI::DIAG_eSendProxi,1);
    testWaitForTimeout (200);
    sysSetVariableInt(sysvar::SysVar_PROXI::DIAG_eSendProxi,0);
    testWaitForTimeout (200);
				
}

export testfunction CAN_node_eol3_IPC_Absent ()
{
  testModuleTitle("CAN_node_eol3_IPC_Absent");
  //write("CAN_node_eol3_IPC_Absent");
  
    sysSetVariableInt(sysvar::SysVar_PROXI::DIAG_ProxiLesen,1);
    testWaitForTimeout (200);
    sysSetVariableInt(sysvar::SysVar_PROXI::DIAG_ProxiLesen,0);
    testWaitForTimeout (200);
    sysSetVariableInt(sysvar::SysVar_PROXI::pByte42Bit3,CAN_node_eol3_IPC_Absent);		
    sysSetVariableInt(sysvar::SysVar_PROXI::DIAG_eLoadAll,1);
    testWaitForTimeout (200);
    sysSetVariableInt(sysvar::SysVar_PROXI::DIAG_eLoadAll,0);
testWaitForTimeout (2000);
    sysSetVariableInt(sysvar::SysVar_PROXI::DIAG_eSendProxi,1);
    testWaitForTimeout (200);
    sysSetVariableInt(sysvar::SysVar_PROXI::DIAG_eSendProxi,0);
    testWaitForTimeout (200);
				
}

export testfunction CAN_node_eol6_BSM_Present ()
{
  testModuleTitle("CAN_node_eol6_BSM_Present");
  //write("CAN_node_eol6_BSM_Present");
  
    sysSetVariableInt(sysvar::SysVar_PROXI::DIAG_ProxiLesen,1);
    testWaitForTimeout (200);
    sysSetVariableInt(sysvar::SysVar_PROXI::DIAG_ProxiLesen,0);
    testWaitForTimeout (200);
	sysSetVariableInt(sysvar::SysVar_PROXI::pByte42Bit6,CAN_node_eol6_BSM_Present);		
	sysSetVariableInt(sysvar::SysVar_PROXI::DIAG_eLoadAll,1);
    testWaitForTimeout (200);
    sysSetVariableInt(sysvar::SysVar_PROXI::DIAG_eLoadAll,0);
testWaitForTimeout (2000);
	sysSetVariableInt(sysvar::SysVar_PROXI::DIAG_eSendProxi,1);
    testWaitForTimeout (200);
    sysSetVariableInt(sysvar::SysVar_PROXI::DIAG_eSendProxi,0);
    testWaitForTimeout (200);
				
}

export testfunction CAN_node_eol6_BSM_Absent ()
{
  testModuleTitle("CAN_node_eol6_BSM_Absent");
  //write("CAN_node_eol6_BSM_Absent");
  
    sysSetVariableInt(sysvar::SysVar_PROXI::DIAG_ProxiLesen,1);
    testWaitForTimeout (200);
    sysSetVariableInt(sysvar::SysVar_PROXI::DIAG_ProxiLesen,0);
    testWaitForTimeout (200);
	sysSetVariableInt(sysvar::SysVar_PROXI::pByte42Bit6,CAN_node_eol6_BSM_Absent);		
	sysSetVariableInt(sysvar::SysVar_PROXI::DIAG_eLoadAll,1);
    testWaitForTimeout (200);
    sysSetVariableInt(sysvar::SysVar_PROXI::DIAG_eLoadAll,0);
testWaitForTimeout (2000);
	sysSetVariableInt(sysvar::SysVar_PROXI::DIAG_eSendProxi,1);
    testWaitForTimeout (200);
    sysSetVariableInt(sysvar::SysVar_PROXI::DIAG_eSendProxi,0);
    testWaitForTimeout (200);
				
}

export testfunction  CAN_node_eol8_DDM_DMM_FDM_UDM_Present ()
{
  testModuleTitle(" CAN_node_eol8_DDM_DMM_FDM_UDM_Present");
  //write(" CAN_node_eol8_DDM_DMM_FDM_UDM_Present");
  
    sysSetVariableInt(sysvar::SysVar_PROXI::DIAG_ProxiLesen,1);
    testWaitForTimeout (200);
    sysSetVariableInt(sysvar::SysVar_PROXI::DIAG_ProxiLesen,0);
    testWaitForTimeout (200);
	sysSetVariableInt(sysvar::SysVar_PROXI::pByte27Bit0, CAN_node_eol8_DDM_DMM_FDM_UDM_Present);		
	sysSetVariableInt(sysvar::SysVar_PROXI::DIAG_eLoadAll,1);
    testWaitForTimeout (200);
    sysSetVariableInt(sysvar::SysVar_PROXI::DIAG_eLoadAll,0);
testWaitForTimeout (2000);
	sysSetVariableInt(sysvar::SysVar_PROXI::DIAG_eSendProxi,1);
    testWaitForTimeout (200);
    sysSetVariableInt(sysvar::SysVar_PROXI::DIAG_eSendProxi,0);
    testWaitForTimeout (200);
				
}

export testfunction  CAN_node_eol8_DDM_DMM_FDM_UDM_Absent ()
{
  testModuleTitle(" CAN_node_eol8_DDM_DMM_FDM_UDM_Absent");
  //write(" CAN_node_eol8_DDM_DMM_FDM_UDM_Absent");
  
    sysSetVariableInt(sysvar::SysVar_PROXI::DIAG_ProxiLesen,1);
    testWaitForTimeout (200);
    sysSetVariableInt(sysvar::SysVar_PROXI::DIAG_ProxiLesen,0);
    testWaitForTimeout (200);
	sysSetVariableInt(sysvar::SysVar_PROXI::pByte27Bit0, CAN_node_eol8_DDM_DMM_FDM_UDM_Absent);		
	sysSetVariableInt(sysvar::SysVar_PROXI::DIAG_eLoadAll,1);
    testWaitForTimeout (200);
    sysSetVariableInt(sysvar::SysVar_PROXI::DIAG_eLoadAll,0);
testWaitForTimeout (2000);
	sysSetVariableInt(sysvar::SysVar_PROXI::DIAG_eSendProxi,1);
    testWaitForTimeout (200);
    sysSetVariableInt(sysvar::SysVar_PROXI::DIAG_eSendProxi,0);
    testWaitForTimeout (200);
				
}

export testfunction  CAN_node_eol10_ECC_ACM_MCM_MHM_Present ()
{
  testModuleTitle(" CAN_node_eol10_ECC_ACM_MCM_MHM_Present");
  //write(" CAN_node_eol10_ECC_ACM_MCM_MHM_Present");
  
    sysSetVariableInt(sysvar::SysVar_PROXI::DIAG_ProxiLesen,1);
    testWaitForTimeout (200);
    sysSetVariableInt(sysvar::SysVar_PROXI::DIAG_ProxiLesen,0);
    testWaitForTimeout (200);
	sysSetVariableInt(sysvar::SysVar_PROXI::pByte43Bit2, CAN_node_eol10_ECC_ACM_MCM_MHM_Present);		
	sysSetVariableInt(sysvar::SysVar_PROXI::DIAG_eLoadAll,1);
    testWaitForTimeout (200);
    sysSetVariableInt(sysvar::SysVar_PROXI::DIAG_eLoadAll,0);
testWaitForTimeout (2000);
	sysSetVariableInt(sysvar::SysVar_PROXI::DIAG_eSendProxi,1);
    testWaitForTimeout (200);
    sysSetVariableInt(sysvar::SysVar_PROXI::DIAG_eSendProxi,0);
    testWaitForTimeout (200);
				
}

export testfunction  CAN_node_eol10_ECC_ACM_MCM_MHM_Absent ()
{
  testModuleTitle(" CAN_node_eol10_ECC_ACM_MCM_MHM_Absent");
  //write(" CAN_node_eol10_ECC_ACM_MCM_MHM_Absent");
  
    sysSetVariableInt(sysvar::SysVar_PROXI::DIAG_ProxiLesen,1);
    testWaitForTimeout (200);
    sysSetVariableInt(sysvar::SysVar_PROXI::DIAG_ProxiLesen,0);
    testWaitForTimeout (200);
	sysSetVariableInt(sysvar::SysVar_PROXI::pByte43Bit2, CAN_node_eol10_ECC_ACM_MCM_MHM_Absent);		
	sysSetVariableInt(sysvar::SysVar_PROXI::DIAG_eLoadAll,1);
    testWaitForTimeout (200);
    sysSetVariableInt(sysvar::SysVar_PROXI::DIAG_eLoadAll,0);
testWaitForTimeout (2000);
	sysSetVariableInt(sysvar::SysVar_PROXI::DIAG_eSendProxi,1);
    testWaitForTimeout (200);
    sysSetVariableInt(sysvar::SysVar_PROXI::DIAG_eSendProxi,0);
    testWaitForTimeout (200);
				
}

export testfunction  CAN_node_eol11_MTA_TCM_DCTM_Present ()
{
  testModuleTitle(" CAN_node_eol11_MTA_TCM_DCTM_Present");
  //write(" CAN_node_eol11_MTA_TCM_DCTM_Present");
  
    sysSetVariableInt(sysvar::SysVar_PROXI::DIAG_ProxiLesen,1);
    testWaitForTimeout (200);
    sysSetVariableInt(sysvar::SysVar_PROXI::DIAG_ProxiLesen,0);
    testWaitForTimeout (200);
	sysSetVariableInt(sysvar::SysVar_PROXI::pByte43Bit3, CAN_node_eol11_MTA_TCM_DCTM_Present);		
	sysSetVariableInt(sysvar::SysVar_PROXI::DIAG_eLoadAll,1);
    testWaitForTimeout (200);
    sysSetVariableInt(sysvar::SysVar_PROXI::DIAG_eLoadAll,0);
testWaitForTimeout (2000);
	sysSetVariableInt(sysvar::SysVar_PROXI::DIAG_eSendProxi,1);
    testWaitForTimeout (200);
    sysSetVariableInt(sysvar::SysVar_PROXI::DIAG_eSendProxi,0);
    testWaitForTimeout (200);
				
}

export testfunction  CAN_node_eol11_MTA_TCM_DCTM_Absent ()
{
  testModuleTitle(" CAN_node_eol11_MTA_TCM_DCTM_Absent");
  //write(" CAN_node_eol11_MTA_TCM_DCTM_Absent");
  
    sysSetVariableInt(sysvar::SysVar_PROXI::DIAG_ProxiLesen,1);
    testWaitForTimeout (200);
    sysSetVariableInt(sysvar::SysVar_PROXI::DIAG_ProxiLesen,0);
    testWaitForTimeout (200);
	sysSetVariableInt(sysvar::SysVar_PROXI::pByte43Bit3, CAN_node_eol11_MTA_TCM_DCTM_Absent);		
	sysSetVariableInt(sysvar::SysVar_PROXI::DIAG_eLoadAll,1);
    testWaitForTimeout (200);
    sysSetVariableInt(sysvar::SysVar_PROXI::DIAG_eLoadAll,0);
testWaitForTimeout (2000);
	sysSetVariableInt(sysvar::SysVar_PROXI::DIAG_eSendProxi,1);
    testWaitForTimeout (200);
    sysSetVariableInt(sysvar::SysVar_PROXI::DIAG_eSendProxi,0);
    testWaitForTimeout (200);
				
}

export testfunction  CAN_node_eol22_GSM_STM_AGSM_DCSM_Present ()
{
  testModuleTitle(" CAN_node_eol22_GSM_STM_AGSM_DCSM_Present");
  //write(" CAN_node_eol22_GSM_STM_AGSM_DCSM_Present");
  
    sysSetVariableInt(sysvar::SysVar_PROXI::DIAG_ProxiLesen,1);
    testWaitForTimeout (200);
    sysSetVariableInt(sysvar::SysVar_PROXI::DIAG_ProxiLesen,0);
    testWaitForTimeout (200);
	sysSetVariableInt(sysvar::SysVar_PROXI::pByte44Bit6, CAN_node_eol22_GSM_STM_AGSM_DCSM_Present);		
	sysSetVariableInt(sysvar::SysVar_PROXI::DIAG_eLoadAll,1);
    testWaitForTimeout (200);
    sysSetVariableInt(sysvar::SysVar_PROXI::DIAG_eLoadAll,0);
testWaitForTimeout (2000);
	sysSetVariableInt(sysvar::SysVar_PROXI::DIAG_eSendProxi,1);
    testWaitForTimeout (200);
    sysSetVariableInt(sysvar::SysVar_PROXI::DIAG_eSendProxi,0);
    testWaitForTimeout (200);
				
}

export testfunction  CAN_node_eol22_GSM_STM_AGSM_DCSM_Absent ()
{
  testModuleTitle(" CAN_node_eol22_GSM_STM_AGSM_DCSM_Absent");
  //write(" CAN_node_eol22_GSM_STM_AGSM_DCSM_Absent");
  
    sysSetVariableInt(sysvar::SysVar_PROXI::DIAG_ProxiLesen,1);
    testWaitForTimeout (200);
    sysSetVariableInt(sysvar::SysVar_PROXI::DIAG_ProxiLesen,0);
    testWaitForTimeout (200);
	sysSetVariableInt(sysvar::SysVar_PROXI::pByte44Bit6, CAN_node_eol22_GSM_STM_AGSM_DCSM_Absent);		
	sysSetVariableInt(sysvar::SysVar_PROXI::DIAG_eLoadAll,1);
    testWaitForTimeout (200);
    sysSetVariableInt(sysvar::SysVar_PROXI::DIAG_eLoadAll,0);
testWaitForTimeout (2000);
	sysSetVariableInt(sysvar::SysVar_PROXI::DIAG_eSendProxi,1);
    testWaitForTimeout (200);
    sysSetVariableInt(sysvar::SysVar_PROXI::DIAG_eSendProxi,0);
    testWaitForTimeout (200);
				
}

export testfunction  CAN_node_eol24_PAM_Present ()
{
  testModuleTitle(" CAN_node_eol24_PAM_Present");
  //write(" CAN_node_eol24_PAM_Present");
  
    sysSetVariableInt(sysvar::SysVar_PROXI::DIAG_ProxiLesen,1);
    testWaitForTimeout (200);
    sysSetVariableInt(sysvar::SysVar_PROXI::DIAG_ProxiLesen,0);
    testWaitForTimeout (200);
	sysSetVariableInt(sysvar::SysVar_PROXI::pByte45Bit0, CAN_node_eol24_PAM_Present);		
	sysSetVariableInt(sysvar::SysVar_PROXI::DIAG_eLoadAll,1);
    testWaitForTimeout (200);
    sysSetVariableInt(sysvar::SysVar_PROXI::DIAG_eLoadAll,0);
testWaitForTimeout (2000);
	sysSetVariableInt(sysvar::SysVar_PROXI::DIAG_eSendProxi,1);
    testWaitForTimeout (200);
    sysSetVariableInt(sysvar::SysVar_PROXI::DIAG_eSendProxi,0);
    testWaitForTimeout (200);
				
}

export testfunction  CAN_node_eol24_PAM_Absent ()
{
  testModuleTitle(" CAN_node_eol24_PAM_Absent");
  //write(" CAN_node_eol24_PAM_Absent");
  
    sysSetVariableInt(sysvar::SysVar_PROXI::DIAG_ProxiLesen,1);
    testWaitForTimeout (200);
    sysSetVariableInt(sysvar::SysVar_PROXI::DIAG_ProxiLesen,0);
    testWaitForTimeout (200);
	sysSetVariableInt(sysvar::SysVar_PROXI::pByte45Bit0, CAN_node_eol24_PAM_Absent);		
	sysSetVariableInt(sysvar::SysVar_PROXI::DIAG_eLoadAll,1);
    testWaitForTimeout (200);
    sysSetVariableInt(sysvar::SysVar_PROXI::DIAG_eLoadAll,0);
testWaitForTimeout (2000);
	sysSetVariableInt(sysvar::SysVar_PROXI::DIAG_eSendProxi,1);
    testWaitForTimeout (200);
    sysSetVariableInt(sysvar::SysVar_PROXI::DIAG_eSendProxi,0);
    testWaitForTimeout (200);
				
}

export testfunction  CAN_node_eol26_SDM_ORC_Present ()
{
  testModuleTitle(" CAN_node_eol26_SDM_ORC_Present");
  //write(" CAN_node_eol26_SDM_ORC_Present");
  
    sysSetVariableInt(sysvar::SysVar_PROXI::DIAG_ProxiLesen,1);
    testWaitForTimeout (200);
    sysSetVariableInt(sysvar::SysVar_PROXI::DIAG_ProxiLesen,0);
    testWaitForTimeout (200);
	sysSetVariableInt(sysvar::SysVar_PROXI::pByte45Bit2, CAN_node_eol26_SDM_ORC_Present);		
	sysSetVariableInt(sysvar::SysVar_PROXI::DIAG_eLoadAll,1);
    testWaitForTimeout (200);
    sysSetVariableInt(sysvar::SysVar_PROXI::DIAG_eLoadAll,0);
testWaitForTimeout (2000);
	sysSetVariableInt(sysvar::SysVar_PROXI::DIAG_eSendProxi,1);
    testWaitForTimeout (200);
    sysSetVariableInt(sysvar::SysVar_PROXI::DIAG_eSendProxi,0);
    testWaitForTimeout (200);
				
}

export testfunction  CAN_node_eol26_SDM_ORC_Absent ()
{
  testModuleTitle(" CAN_node_eol26_SDM_ORC_Absent");
  //write(" CAN_node_eol26_SDM_ORC_Absent");
  
    sysSetVariableInt(sysvar::SysVar_PROXI::DIAG_ProxiLesen,1);
    testWaitForTimeout (200);
    sysSetVariableInt(sysvar::SysVar_PROXI::DIAG_ProxiLesen,0);
    testWaitForTimeout (200);
	sysSetVariableInt(sysvar::SysVar_PROXI::pByte45Bit2, CAN_node_eol26_SDM_ORC_Absent);		
	sysSetVariableInt(sysvar::SysVar_PROXI::DIAG_eLoadAll,1);
    testWaitForTimeout (200);
    sysSetVariableInt(sysvar::SysVar_PROXI::DIAG_eLoadAll,0);
testWaitForTimeout (2000);
	sysSetVariableInt(sysvar::SysVar_PROXI::DIAG_eSendProxi,1);
    testWaitForTimeout (200);
    sysSetVariableInt(sysvar::SysVar_PROXI::DIAG_eSendProxi,0);
    testWaitForTimeout (200);
				
}

export testfunction  CAN_node_eol30_HALF_Present ()
{
  testModuleTitle(" CAN_node_eol30_HALF_Present");
  //write(" CAN_node_eol30_HALF_Present");
  
    sysSetVariableInt(sysvar::SysVar_PROXI::DIAG_ProxiLesen,1);
    testWaitForTimeout (200);
    sysSetVariableInt(sysvar::SysVar_PROXI::DIAG_ProxiLesen,0);
    testWaitForTimeout (200);
	sysSetVariableInt(sysvar::SysVar_PROXI::pByte45Bit6, CAN_node_eol30_HALF_Present);		
	sysSetVariableInt(sysvar::SysVar_PROXI::DIAG_eLoadAll,1);
    testWaitForTimeout (200);
    sysSetVariableInt(sysvar::SysVar_PROXI::DIAG_eLoadAll,0);
testWaitForTimeout (2000);
	sysSetVariableInt(sysvar::SysVar_PROXI::DIAG_eSendProxi,1);
    testWaitForTimeout (200);
    sysSetVariableInt(sysvar::SysVar_PROXI::DIAG_eSendProxi,0);
    testWaitForTimeout (200);
				
}

export testfunction  CAN_node_eol30_HALF_Absent ()
{
  testModuleTitle(" CAN_node_eol30_HALF_Absent");
  //write(" CAN_node_eol30_HALF_Absent");
  
    sysSetVariableInt(sysvar::SysVar_PROXI::DIAG_ProxiLesen,1);
    testWaitForTimeout (200);
    sysSetVariableInt(sysvar::SysVar_PROXI::DIAG_ProxiLesen,0);
    testWaitForTimeout (200);
	sysSetVariableInt(sysvar::SysVar_PROXI::pByte45Bit6, CAN_node_eol30_HALF_Absent);		
	sysSetVariableInt(sysvar::SysVar_PROXI::DIAG_eLoadAll,1);
    testWaitForTimeout (200);
    sysSetVariableInt(sysvar::SysVar_PROXI::DIAG_eLoadAll,0);
testWaitForTimeout (2000);
	sysSetVariableInt(sysvar::SysVar_PROXI::DIAG_eSendProxi,1);
    testWaitForTimeout (200);
    sysSetVariableInt(sysvar::SysVar_PROXI::DIAG_eSendProxi,0);
    testWaitForTimeout (200);
				
}

export testfunction  CAN_node_eol35_TBM_Present ()
{
  testModuleTitle(" CAN_node_eol35_TBM_Present");
  //write(" CAN_node_eol35_TBM_Present");
  
    sysSetVariableInt(sysvar::SysVar_PROXI::DIAG_ProxiLesen,1);
    testWaitForTimeout (200);
    sysSetVariableInt(sysvar::SysVar_PROXI::DIAG_ProxiLesen,0);
    testWaitForTimeout (200);
	sysSetVariableInt(sysvar::SysVar_PROXI::pByte46Bit3, CAN_node_eol35_TBM_Present);		
	sysSetVariableInt(sysvar::SysVar_PROXI::DIAG_eLoadAll,1);
    testWaitForTimeout (200);
    sysSetVariableInt(sysvar::SysVar_PROXI::DIAG_eLoadAll,0);
testWaitForTimeout (2000);
	sysSetVariableInt(sysvar::SysVar_PROXI::DIAG_eSendProxi,1);
    testWaitForTimeout (200);
    sysSetVariableInt(sysvar::SysVar_PROXI::DIAG_eSendProxi,0);
    testWaitForTimeout (200);
				
}

export testfunction  CAN_node_eol35_TBM_Absent ()
{
  testModuleTitle(" CAN_node_eol35_TBM_Absent");
  //write(" CAN_node_eol35_TBM_Absent");
  
    sysSetVariableInt(sysvar::SysVar_PROXI::DIAG_ProxiLesen,1);
    testWaitForTimeout (200);
    sysSetVariableInt(sysvar::SysVar_PROXI::DIAG_ProxiLesen,0);
    testWaitForTimeout (200);
	sysSetVariableInt(sysvar::SysVar_PROXI::pByte46Bit3, CAN_node_eol35_TBM_Absent);		
	sysSetVariableInt(sysvar::SysVar_PROXI::DIAG_eLoadAll,1);
    testWaitForTimeout (200);
    sysSetVariableInt(sysvar::SysVar_PROXI::DIAG_eLoadAll,0);
testWaitForTimeout (2000);
	sysSetVariableInt(sysvar::SysVar_PROXI::DIAG_eSendProxi,1);
    testWaitForTimeout (200);
    sysSetVariableInt(sysvar::SysVar_PROXI::DIAG_eSendProxi,0);
    testWaitForTimeout (200);
				
}

export testfunction  CAN_node_eol36_LTM_ETM_HTM_Present ()
{
  testModuleTitle(" CAN_node_eol36_LTM_ETM_HTM_Present");
  //write(" CAN_node_eol36_LTM_ETM_HTM_Present");
  
    sysSetVariableInt(sysvar::SysVar_PROXI::DIAG_ProxiLesen,1);
    testWaitForTimeout (200);
    sysSetVariableInt(sysvar::SysVar_PROXI::DIAG_ProxiLesen,0);
    testWaitForTimeout (200);
	sysSetVariableInt(sysvar::SysVar_PROXI::pByte46Bit4, CAN_node_eol36_LTM_ETM_HTM_Present);		
	sysSetVariableInt(sysvar::SysVar_PROXI::DIAG_eLoadAll,1);
    testWaitForTimeout (200);
    sysSetVariableInt(sysvar::SysVar_PROXI::DIAG_eLoadAll,0);
testWaitForTimeout (2000);
	sysSetVariableInt(sysvar::SysVar_PROXI::DIAG_eSendProxi,1);
    testWaitForTimeout (200);
    sysSetVariableInt(sysvar::SysVar_PROXI::DIAG_eSendProxi,0);
    testWaitForTimeout (200);
				
}

export testfunction  CAN_node_eol36_LTM_ETM_HTM_Absent ()
{
  testModuleTitle(" CAN_node_eol36_LTM_ETM_HTM_Absent");
  //write(" CAN_node_eol36_LTM_ETM_HTM_Absent");
  
    sysSetVariableInt(sysvar::SysVar_PROXI::DIAG_ProxiLesen,1);
    testWaitForTimeout (200);
    sysSetVariableInt(sysvar::SysVar_PROXI::DIAG_ProxiLesen,0);
    testWaitForTimeout (200);
	sysSetVariableInt(sysvar::SysVar_PROXI::pByte46Bit4, CAN_node_eol36_LTM_ETM_HTM_Absent);		
	sysSetVariableInt(sysvar::SysVar_PROXI::DIAG_eLoadAll,1);
    testWaitForTimeout (200);
    sysSetVariableInt(sysvar::SysVar_PROXI::DIAG_eLoadAll,0);
testWaitForTimeout (2000);
	sysSetVariableInt(sysvar::SysVar_PROXI::DIAG_eSendProxi,1);
    testWaitForTimeout (200);
    sysSetVariableInt(sysvar::SysVar_PROXI::DIAG_eSendProxi,0);
    testWaitForTimeout (200);
				
}

export testfunction  CAN_node_eol46_AMP_Present ()
{
  testModuleTitle(" CAN_node_eol46_AMP_Present");
  //write(" CAN_node_eol46_AMP_Present");
  
    sysSetVariableInt(sysvar::SysVar_PROXI::DIAG_ProxiLesen,1);
    testWaitForTimeout (200);
    sysSetVariableInt(sysvar::SysVar_PROXI::DIAG_ProxiLesen,0);
    testWaitForTimeout (200);
	sysSetVariableInt(sysvar::SysVar_PROXI::pByte47Bit6, CAN_node_eol46_AMP_Present);		
	sysSetVariableInt(sysvar::SysVar_PROXI::DIAG_eLoadAll,1);
    testWaitForTimeout (200);
    sysSetVariableInt(sysvar::SysVar_PROXI::DIAG_eLoadAll,0);
testWaitForTimeout (2000);
	sysSetVariableInt(sysvar::SysVar_PROXI::DIAG_eSendProxi,1);
    testWaitForTimeout (200);
    sysSetVariableInt(sysvar::SysVar_PROXI::DIAG_eSendProxi,0);
    testWaitForTimeout (200);
				
}

export testfunction  CAN_node_eol46_AMP_Absent ()
{
  testModuleTitle(" CAN_node_eol46_AMP_Absent");
  //write(" CAN_node_eol46_AMP_Absent");
  
    sysSetVariableInt(sysvar::SysVar_PROXI::DIAG_ProxiLesen,1);
    testWaitForTimeout (200);
    sysSetVariableInt(sysvar::SysVar_PROXI::DIAG_ProxiLesen,0);
    testWaitForTimeout (200);
	sysSetVariableInt(sysvar::SysVar_PROXI::pByte47Bit6, CAN_node_eol46_AMP_Absent);		
	sysSetVariableInt(sysvar::SysVar_PROXI::DIAG_eLoadAll,1);
    testWaitForTimeout (200);
    sysSetVariableInt(sysvar::SysVar_PROXI::DIAG_eLoadAll,0);
testWaitForTimeout (2000);
	sysSetVariableInt(sysvar::SysVar_PROXI::DIAG_eSendProxi,1);
    testWaitForTimeout (200);
    sysSetVariableInt(sysvar::SysVar_PROXI::DIAG_eSendProxi,0);
    testWaitForTimeout (200);
				
}

export testfunction  CAN_node_eol51_LBSS_Present ()
{
  testModuleTitle(" CAN_node_eol51_LBSS_Present");
  //write(" CAN_node_eol51_LBSS_Present");
  
    sysSetVariableInt(sysvar::SysVar_PROXI::DIAG_ProxiLesen,1);
    testWaitForTimeout (200);
    sysSetVariableInt(sysvar::SysVar_PROXI::DIAG_ProxiLesen,0);
    testWaitForTimeout (200);
	sysSetVariableInt(sysvar::SysVar_PROXI::pByte48Bit3, CAN_node_eol51_LBSS_Present);		
	sysSetVariableInt(sysvar::SysVar_PROXI::DIAG_eLoadAll,1);
    testWaitForTimeout (200);
    sysSetVariableInt(sysvar::SysVar_PROXI::DIAG_eLoadAll,0);
testWaitForTimeout (2000);
	sysSetVariableInt(sysvar::SysVar_PROXI::DIAG_eSendProxi,1);
    testWaitForTimeout (200);
    sysSetVariableInt(sysvar::SysVar_PROXI::DIAG_eSendProxi,0);
    testWaitForTimeout (200);
				
}

export testfunction  CAN_node_eol51_LBSS_Absent ()
{
  testModuleTitle(" CAN_node_eol51_LBSS_Absent");
  //write(" CAN_node_eol51_LBSS_Absent");
  
    sysSetVariableInt(sysvar::SysVar_PROXI::DIAG_ProxiLesen,1);
    testWaitForTimeout (200);
    sysSetVariableInt(sysvar::SysVar_PROXI::DIAG_ProxiLesen,0);
    testWaitForTimeout (200);
	sysSetVariableInt(sysvar::SysVar_PROXI::pByte48Bit3, CAN_node_eol51_LBSS_Absent);		
	sysSetVariableInt(sysvar::SysVar_PROXI::DIAG_eLoadAll,1);
    testWaitForTimeout (200);
    sysSetVariableInt(sysvar::SysVar_PROXI::DIAG_eLoadAll,0);
testWaitForTimeout (2000);
	sysSetVariableInt(sysvar::SysVar_PROXI::DIAG_eSendProxi,1);
    testWaitForTimeout (200);
    sysSetVariableInt(sysvar::SysVar_PROXI::DIAG_eSendProxi,0);
    testWaitForTimeout (200);
				
}

export testfunction  CAN_node_eol52_RBSS_Present ()
{
  testModuleTitle(" CAN_node_eol52_RBSS_Present");
  //write(" CAN_node_eol52_RBSS_Present");
  
    sysSetVariableInt(sysvar::SysVar_PROXI::DIAG_ProxiLesen,1);
    testWaitForTimeout (200);
    sysSetVariableInt(sysvar::SysVar_PROXI::DIAG_ProxiLesen,0);
    testWaitForTimeout (200);
	sysSetVariableInt(sysvar::SysVar_PROXI::pByte32Bit4, CAN_node_eol52_RBSS_Present);		
	sysSetVariableInt(sysvar::SysVar_PROXI::DIAG_eLoadAll,1);
    testWaitForTimeout (200);
    sysSetVariableInt(sysvar::SysVar_PROXI::DIAG_eLoadAll,0);
testWaitForTimeout (2000);
	sysSetVariableInt(sysvar::SysVar_PROXI::DIAG_eSendProxi,1);
    testWaitForTimeout (200);
    sysSetVariableInt(sysvar::SysVar_PROXI::DIAG_eSendProxi,0);
    testWaitForTimeout (200);
				
}

export testfunction  CAN_node_eol52_RBSS_Absent ()
{
  testModuleTitle(" CAN_node_eol52_RBSS_Absent");
  //write(" CAN_node_eol52_RBSS_Absent");
  
    sysSetVariableInt(sysvar::SysVar_PROXI::DIAG_ProxiLesen,1);
    testWaitForTimeout (200);
    sysSetVariableInt(sysvar::SysVar_PROXI::DIAG_ProxiLesen,0);
    testWaitForTimeout (200);
	sysSetVariableInt(sysvar::SysVar_PROXI::pByte32Bit4, CAN_node_eol52_RBSS_Absent);		
	sysSetVariableInt(sysvar::SysVar_PROXI::DIAG_eLoadAll,1);
    testWaitForTimeout (200);
    sysSetVariableInt(sysvar::SysVar_PROXI::DIAG_eLoadAll,0);
testWaitForTimeout (2000);
	sysSetVariableInt(sysvar::SysVar_PROXI::DIAG_eSendProxi,1);
    testWaitForTimeout (200);
    sysSetVariableInt(sysvar::SysVar_PROXI::DIAG_eSendProxi,0);
    testWaitForTimeout (200);
				
}

export testfunction  CAN_node_eol57_DASM_Present ()
{
  testModuleTitle(" CAN_node_eol57_DASM_Present");
  //write(" CAN_node_eol57_DASM_Present");
  
    sysSetVariableInt(sysvar::SysVar_PROXI::DIAG_ProxiLesen,1);
    testWaitForTimeout (200);
    sysSetVariableInt(sysvar::SysVar_PROXI::DIAG_ProxiLesen,0);
    testWaitForTimeout (200);
	sysSetVariableInt(sysvar::SysVar_PROXI::pByte49Bit1, CAN_node_eol57_DASM_Present);		
	sysSetVariableInt(sysvar::SysVar_PROXI::DIAG_eLoadAll,1);
    testWaitForTimeout (200);
    sysSetVariableInt(sysvar::SysVar_PROXI::DIAG_eLoadAll,0);
testWaitForTimeout (2000);
	sysSetVariableInt(sysvar::SysVar_PROXI::DIAG_eSendProxi,1);
    testWaitForTimeout (200);
    sysSetVariableInt(sysvar::SysVar_PROXI::DIAG_eSendProxi,0);
    testWaitForTimeout (200);
				
}

export testfunction  CAN_node_eol57_DASM_Absent ()
{
  testModuleTitle(" CAN_node_eol57_DASM_Absent");
  //write(" CAN_node_eol57_DASM_Absent");
  
    sysSetVariableInt(sysvar::SysVar_PROXI::DIAG_ProxiLesen,1);
    testWaitForTimeout (200);
    sysSetVariableInt(sysvar::SysVar_PROXI::DIAG_ProxiLesen,0);
    testWaitForTimeout (200);
	sysSetVariableInt(sysvar::SysVar_PROXI::pByte49Bit1, CAN_node_eol57_DASM_Absent);		
	sysSetVariableInt(sysvar::SysVar_PROXI::DIAG_eLoadAll,1);
    testWaitForTimeout (200);
    sysSetVariableInt(sysvar::SysVar_PROXI::DIAG_eLoadAll,0);
testWaitForTimeout (2000);
	sysSetVariableInt(sysvar::SysVar_PROXI::DIAG_eSendProxi,1);
    testWaitForTimeout (200);
    sysSetVariableInt(sysvar::SysVar_PROXI::DIAG_eSendProxi,0);
    testWaitForTimeout (200);
				
}

export testfunction  CAN_node_eol63_TTM_Present ()
{
  testModuleTitle(" CAN_node_eol63_TTM_Present");
  //write(" CAN_node_eol63_TTM_Present");
  
    sysSetVariableInt(sysvar::SysVar_PROXI::DIAG_ProxiLesen,1);
    testWaitForTimeout (200);
    sysSetVariableInt(sysvar::SysVar_PROXI::DIAG_ProxiLesen,0);
    testWaitForTimeout (200);
	sysSetVariableInt(sysvar::SysVar_PROXI::pByte49Bit7, CAN_node_eol63_TTM_Present);		
	sysSetVariableInt(sysvar::SysVar_PROXI::DIAG_eLoadAll,1);
    testWaitForTimeout (200);
    sysSetVariableInt(sysvar::SysVar_PROXI::DIAG_eLoadAll,0);
testWaitForTimeout (2000);
	sysSetVariableInt(sysvar::SysVar_PROXI::DIAG_eSendProxi,1);
    testWaitForTimeout (200);
    sysSetVariableInt(sysvar::SysVar_PROXI::DIAG_eSendProxi,0);
    testWaitForTimeout (200);
				
}

export testfunction  CAN_node_eol63_TTM_Absent ()
{
  testModuleTitle(" CAN_node_eol63_TTM_Absent");
  //write(" CAN_node_eol63_TTM_Absent");
  
    sysSetVariableInt(sysvar::SysVar_PROXI::DIAG_ProxiLesen,1);
    testWaitForTimeout (200);
    sysSetVariableInt(sysvar::SysVar_PROXI::DIAG_ProxiLesen,0);
    testWaitForTimeout (200);
	sysSetVariableInt(sysvar::SysVar_PROXI::pByte49Bit7, CAN_node_eol63_TTM_Absent);		
	sysSetVariableInt(sysvar::SysVar_PROXI::DIAG_eLoadAll,1);
    testWaitForTimeout (200);
    sysSetVariableInt(sysvar::SysVar_PROXI::DIAG_eLoadAll,0);
testWaitForTimeout (2000);
	sysSetVariableInt(sysvar::SysVar_PROXI::DIAG_eSendProxi,1);
    testWaitForTimeout (200);
    sysSetVariableInt(sysvar::SysVar_PROXI::DIAG_eSendProxi,0);
    testWaitForTimeout (200);
				
}

export testfunction  CAN_node_eol65_RFHM_Present ()
{
  testModuleTitle(" CAN_node_eol65_RFHM_Present");
  //write(" CAN_node_eol65_RFHM_Present");
  
    sysSetVariableInt(sysvar::SysVar_PROXI::DIAG_ProxiLesen,1);
    testWaitForTimeout (200);
    sysSetVariableInt(sysvar::SysVar_PROXI::DIAG_ProxiLesen,0);
    testWaitForTimeout (200);
	sysSetVariableInt(sysvar::SysVar_PROXI::pByte50Bit1, CAN_node_eol65_RFHM_Present);		
	sysSetVariableInt(sysvar::SysVar_PROXI::DIAG_eLoadAll,1);
    testWaitForTimeout (200);
    sysSetVariableInt(sysvar::SysVar_PROXI::DIAG_eLoadAll,0);
testWaitForTimeout (2000);
	sysSetVariableInt(sysvar::SysVar_PROXI::DIAG_eSendProxi,1);
    testWaitForTimeout (200);
    sysSetVariableInt(sysvar::SysVar_PROXI::DIAG_eSendProxi,0);
    testWaitForTimeout (200);
				
}

export testfunction  CAN_node_eol65_RFHM_Absent ()
{
  testModuleTitle(" CAN_node_eol65_RFHM_Absent");
  //write(" CAN_node_eol65_RFHM_Absent");
  
    sysSetVariableInt(sysvar::SysVar_PROXI::DIAG_ProxiLesen,1);
    testWaitForTimeout (200);
    sysSetVariableInt(sysvar::SysVar_PROXI::DIAG_ProxiLesen,0);
    testWaitForTimeout (200);
	sysSetVariableInt(sysvar::SysVar_PROXI::pByte50Bit1, CAN_node_eol65_RFHM_Absent);		
	sysSetVariableInt(sysvar::SysVar_PROXI::DIAG_eLoadAll,1);
    testWaitForTimeout (200);
    sysSetVariableInt(sysvar::SysVar_PROXI::DIAG_eLoadAll,0);
testWaitForTimeout (2000);
	sysSetVariableInt(sysvar::SysVar_PROXI::DIAG_eSendProxi,1);
    testWaitForTimeout (200);
    sysSetVariableInt(sysvar::SysVar_PROXI::DIAG_eSendProxi,0);
    testWaitForTimeout (200);
				
}































