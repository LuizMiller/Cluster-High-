/*@!Encoding:1252*/
/*******************************************************************************/
/* Title: PROXI                                                                */
/* Company:	Magneti Marelli Electronics System                                 */
/*                                                                             */
/* Release note:                                                               */
/* v1 - First release;                                                         */
/* v2 - Added "delay_DIAG_eLoadAll";                                           */
/* v3 - Updadte for SysVar, Added read and write from byte 171 up to 200;      */
/*                                                                             */
/*                                                                             */
/*******************************************************************************/

includes
{
   
}

variables
{   
  //PROXI blocks Offsets
  const int   PROXI_TST_CODE_OFFSET = 11;
  const int   PROXI_PROD_DATE_OFFSET = 21;
  //PROXI blocks Sizes
  const int   PROXI_CFG_CODE_SIZE = 11;
  const int   PROXI_TST_CODE_SIZE = 10;
  const int   PROXI_PROD_DATE_SIZE = 4;
  //Constants for CRC calculation
  byte  ProxiFileLenght;
  byte  PBL1;
  byte  PBL2;
  const int   LAST_BYTE_TO_CRC = 255; 
  const int   FIRST_BYTE_TO_CRC = 25;  
  message     DIAGNOSTIC_REQUEST_IPC msg;
  const byte  __PROXIDataRead_size = 3;  
  msTimer     PROXI_tNoResponse;
  const long  PROXI_iNoResponse = 3000;
  byte        PROXI_boIsTimeout;
  byte        PROXI_bDataBuffer[255];
  byte        PROXI_bWriteDataBuffer[260];
  int         DIAG__iTxNumberOfBytes = 0;
  int         DIAG_bCFRequest = 0;
  int         DIAG__iNextByteToSend = 0;
  int         DIAG__iMissingBytes = 0;
  int         DIAG__iSendNextCF = 0;
  msTimer     PROXI__tTimeoutFC;
  const long  PROXI__iTimeoutFC = 1000;
  msTimer     PROXI__tTxNextCF;
  const long  PROXI__iTxNextCF = 20;
  // 22 10 2A - Check EOL Configuration Data Read
  const int   __PROXI_CheckEOL_DataRead = 12;  // Service response size in bytes
  byte        PROXI_abCheckEOL_Data[__PROXI_CheckEOL_DataRead];   // Service response
  byte        DIAG__abCheckEOLConfig[__PROXIDataRead_size] = {0x22, 0x10, 0x2a};
  // 22 29 A1 - PROXI write counter Read
  const int   __PROXI_EOL_WriteCounter = 4;  // Service response size in bytes
  byte        PROXI_abProxiWriteCounter_Data[__PROXI_EOL_WriteCounter];   // Service response
  byte        DIAG__abProxiWriteCounterRead[__PROXIDataRead_size] = {0x22, 0x29, 0x2e};
  byte        PROXI__abWriteProxiPosResp[__PROXIDataRead_size] = {0x6E, 0x20, 0x23};
  byte        PROXI__bIsPositiveResponse = 0;
  mstimer     PROXI__tIPCResponse;
  const int   PROXI__iIPCResponse = 4000;
  /*****************************************************
                        CRC KERMIT
  *****************************************************/
  enum        boolean_flag { FALSE = 0,TRUE };  
  const word  P_KERMIT               = 0x8408;
  const int   CRC_SIZE_IN_BYTES      = 5;
  int         crc_tabkermit_init = FALSE;
  word        crc_tabkermit[256];
  word        crc_kermit = 0;
  byte        input_data[4] = { 0xFB, 0x80, 0x78, 0xF6 };
  byte        crc_array[CRC_SIZE_IN_BYTES] = { 0x30, 0x30, 0x30, 0x30, 0x30 };
  /* ----------------------- CONSTANT VALUES ---------------------------- */
	int         DEBUG = 1;
	/* Definition: transport layer blocksize								                */
	const int   TP_BS = 255;
	const int   TP_STMIN = 0;
  /* Definition: Transport layer separation time						            	*/
	const int   DIAG_BUFFER_SIZE = 	255;
	/* Definition: receiption timeout [ms]									                */
  //  const int   DIAG_TMO_RX = 10000;
  /* Definition: transmitting delay slow [ms]							              	*/
  // const int   DIAG_DLY_TX_SLOW = 5000;
  /* Definition: transmitting delay fast [ms]							              	*/
  //  const int   DIAG_DLY_TX_FAST = 100;
	/* --------------------------------------------------------------------	*/
	/* ----------------------- GLOBAL VARIABLES --------------------------- */
  byte        TPL__pbRxDataBuffer[DIAG_BUFFER_SIZE];	/* Receive Buffer		*/
  byte        TPL__NumberOfByteEOL;
  byte        TPL__NumberOfByteEOL2;
	int         TPL__iTxNumberOfBytes =	0x00;
  int         TPL__iMissingBytes = 0x00;	/* Stores the number of bytes that has to be received by the transport layer 	*/
	int         TPL__iSendNumberOfCF = 0x00;	/* Stores the total number of consecutive frames to receive*/
  int         TPL__iSendNextCF = 0x00;	/* Stores the number of the next consecutive frame to receive */
  int         TPL__iReceivedBytes = 0x00;	/* Stores the number of bytes received by transport layer 	*/
  byte        TPL__pbTxDataBuffer[DIAG_BUFFER_SIZE];	/* Transmit Buffer		*/
	int         TPL__iNextByteToSend = 0x00;
	/* --------------------------------------------------------------------	*/
	/* ----------------------------- TIMER -------------------------------- */
	msTimer     TPL__tTimeoutFC;
  const int   TPL__iTimeoutFC = 100;
	msTimer     TPL__tDelayFC;
	const int   TPL__iDelayFC = 5;
	mstimer     TPL__tTxNextCF;
	int         TPL__iTxNextCF = 5;
	mstimer     TPL__tCFTimeOut;
  int         TPL__iCFTimeOut = 100;	//arbitrary value, long enough, after this flag TPL_bCFRequest is reset
  byte        TPL_bCFRequest = 0;
  /* --------------------------------------------------------------------	*/
  byte        TPL__iReceivedFrames = 0;
  msTimer     delay_DIAG_eLoadAll;
  long        copiedbytes;
  byte        buf[255];
  long        size = 255;
  long        timeArray[9];
}

on start
{
  PROXI_vInit_crckermit_tab();
  @sysvar::SysVar_PROXI::PROXI_bReadRqst = 0;
  @sysvar::SysVar_PROXI::SYS_SimulationRunnning = 1;
  putvaluetocontrol("PROXI327_v7","outputversion","     Version: 01.05      ");
  putvaluetocontrol("PROXI520_v4","outputversion","     Version: 01.05      ");
}

on preStop
{
	@sysvar::SysVar_PROXI::SYS_SimulationRunnning = 0;	
}

on SysVar sysvar::SysVar_PROXI::TPL_eRxIndication
{
  int i;
  if(PROXI_boIsTimeout == 0)
  {
    cancelTimer(PROXI_tNoResponse);   
    if(@sysvar::SysVar_PROXI::PROXI_bCheckEOLRqst)
    {
      sysGetVariableData(sysvar::SysVar_PROXI::PROXI_eCheckEOL,PROXI_abCheckEOL_Data, copiedbytes);
      @sysvar::SysVar_PROXI::PROXI_bCheckEOLRqst = 0;
      PROXI_vUpdateEOL_Data(); 
    }
    else if(@sysvar::SysVar_PROXI::PROXI_bReadRqst)
    {
      sysSetVariableString(sysvar::SysVar_PROXI::DIAG_ePROXI_StatusBar, "");
      sysSetVariableString(sysvar::SysVar_PROXI::DIAG_ePROXI_StatusBar, "Reading PROXI Successful");
      sysGetVariableData(sysvar::SysVar_PROXI::DIAG_eProxiDataBuffer,PROXI_bDataBuffer, copiedbytes);
      @sysvar::SysVar_PROXI::PROXI_bReadRqst = 0;
      PROXI_vUpdateProxiPanel();          
    }
    else if(@sysvar::SysVar_PROXI::PROXI_bProxiWriteCounterRqst)
    {
      sysSetVariableString(sysvar::SysVar_PROXI::DIAG_ePROXI_StatusBar, "");
      sysSetVariableString(sysvar::SysVar_PROXI::DIAG_ePROXI_StatusBar, "Reading PROXI Write Counter Successful");
      sysGetVariableData(sysvar::SysVar_PROXI::TPL_eRxDataBuffer,PROXI_bDataBuffer, copiedbytes);
      @sysvar::SysVar_PROXI::PROXI_bProxiWriteCounterRqst = 0;
      PROXI_vUpdateProxiWriteCounterPanel();          
    }
  }
}

void PROXI_vUpdateEOL_Data (void)
{
  int i;
  int isValid;
  isValid = TRUE;
  for(i = 0; i < __PROXIDataRead_size; i++)
  {
    if(i == 0)
    {
       if((DIAG__abCheckEOLConfig[i] + 0x40) != PROXI_abCheckEOL_Data[i])
       {
          isValid = FALSE;
       }
    }
    else
    {
      if(DIAG__abCheckEOLConfig[i] != PROXI_abCheckEOL_Data[i]) isValid = FALSE;
    }
  }
  if(isValid == TRUE)
  {
    sysSetVariableString(sysvar::SysVar_PROXI::DIAG_ePROXI_StatusBar, "Check EOL Configuration - Read Successful");
        
    @sysvar::SysVar_PROXI::DIAG_eError_1 = PROXI_abCheckEOL_Data[3];
    @sysvar::SysVar_PROXI::DIAG_eError_2 = PROXI_abCheckEOL_Data[6];
    @sysvar::SysVar_PROXI::DIAG_eError_3 = PROXI_abCheckEOL_Data[9];
        
    @sysvar::SysVar_PROXI::DIAG_eError_Byte1 = PROXI_abCheckEOL_Data[4];
    @sysvar::SysVar_PROXI::DIAG_eError_Byte2 = PROXI_abCheckEOL_Data[7];
    @sysvar::SysVar_PROXI::DIAG_eError_Byte3 = PROXI_abCheckEOL_Data[10];
        
    @sysvar::SysVar_PROXI::DIAG_eError_BitMask1 = PROXI_abCheckEOL_Data[5];
    @sysvar::SysVar_PROXI::DIAG_eError_BitMask2 = PROXI_abCheckEOL_Data[8];
    @sysvar::SysVar_PROXI::DIAG_eError_BitMask3 = PROXI_abCheckEOL_Data[11];      
  }
  else
  {
     sysSetVariableString(sysvar::SysVar_PROXI::DIAG_eCheckEOL_StatusBar, "Read Failed");
  }
}

on SysVar sysvar::SysVar_PROXI::DIAG_eCalculate_CRC
{
  int i;
  if(@this == 0)
  {
    crc_kermit = 0;
    sysGetVariableData(sysvar::SysVar_PROXI::DIAG_eProxiDataBuffer,PROXI_bDataBuffer,copiedbytes);
    ProxiFileLenght = sysGetVariableInt(sysvar::SysVar_PROXI::pByte106);
    for(i = FIRST_BYTE_TO_CRC; i < ProxiFileLenght; i++)
    {
      crc_kermit = PROXI_wUpdate_crc_kermit(crc_kermit, PROXI_bDataBuffer[i]);
    }
    PROXI_vConvertCRC(crc_kermit);
    PROXI_bDataBuffer[6] = crc_array[0];
    PROXI_bDataBuffer[7] = crc_array[1];
    PROXI_bDataBuffer[8] = crc_array[2];
    PROXI_bDataBuffer[9] = crc_array[3];
    PROXI_bDataBuffer[10] = crc_array[4];
    sysSetVariableData(sysvar::SysVar_PROXI::DIAG_eProxiDataBuffer, PROXI_bDataBuffer,copiedbytes);
  }
  sysSetVariableString(sysvar::SysVar_PROXI::DIAG_ePROXI_StatusBar, "");
  sysSetVariableString(sysvar::SysVar_PROXI::DIAG_ePROXI_StatusBar, "Update CRC");
}

void PROXI_vInit_crckermit_tab (void)
{
  int i, j;
  word crc, c;
  for (i=0; i< (255 + 1) ; i++) 
  {
      crc = 0;
      c   = (word) i;

      for (j=0; j<8; j++) 
      {
          if ( (crc ^ c) & 0x0001 ) 
          {
              crc = ( crc >> 1 ) ^ P_KERMIT;
          }
          else
          {
              crc = crc >> 1;
          }
          c = c >> 1;
      }
      crc_tabkermit[i] = crc;
  }
  crc_tabkermit_init = TRUE;
}

word PROXI_wUpdate_crc_kermit (word crc, byte c)
{
  word tmp, short_c;
  byte pos;
  short_c = 0x00ff & (word) c;
  tmp =  crc ^ short_c;
  pos = (byte)(tmp & 0xff);
  crc = (crc >> 8) ^ crc_tabkermit[pos];
  return crc;
}

void PROXI_vCalculate_CRC (byte a[], int size)
{
  int i;
  i = 0;
  crc_kermit = 0;
  while(i < size)
  {
      crc_kermit = PROXI_wUpdate_crc_kermit(crc_kermit, a[i]);
      i++;
  }
}

void PROXI_vConvertCRC (word crc)
{
  long   decUnid, decDez, decCent, decMil;
  long  iNumDecimal;
  int   i;
  /******************************************************
  *         Convert CRC from HEX to DEC format          *
  ******************************************************/
  decUnid = (crc & 0x000F);
  decDez  = ((crc & 0x00F0) >> 4) * 16;
  decCent = ((crc & 0x0F00) >> 8) * 16 * 16;
  decMil  = ((crc & 0xF000) >> 12) * 16 * 16 * 16;
  iNumDecimal = decUnid + decDez + decCent + decMil;
  /******************************************************/
  /******************************************************
  *         Convert CRC from DEC to ASCII format        *
  ******************************************************/
  i = 0;
  PROXI_vClearCRC();
  while(iNumDecimal > 9999)
  {
      crc_array[i] = crc_array[i] + 1;
      iNumDecimal -= 10000;
  }
  i++;
  while(iNumDecimal > 999)
  {
      crc_array[i] = crc_array[i] + 1;
      iNumDecimal -= 1000;
  }
  i++;
  while(iNumDecimal > 99)
  {
      crc_array[i] = crc_array[i] + 1;
      iNumDecimal -= 100;
  }
  i++;
  while(iNumDecimal > 9)
  {
      crc_array[i] = crc_array[i] + 1;
      iNumDecimal -= 10;
  }
  i++;
  crc_array[i] = crc_array[i] + iNumDecimal;
  /******************************************************/
}

void PROXI_vClearCRC (void)
{
  int i;
  for(i = 0; i < CRC_SIZE_IN_BYTES; i++)
  {
    crc_array[i] = 0x30;
  }
}

on timer PROXI_tNoResponse
{
  PROXI_boIsTimeout = 1;
  if(@sysvar::SysVar_PROXI::PROXI_bCheckEOLRqst)
  {
    sysSetVariableString(sysvar::SysVar_PROXI::DIAG_eCheckEOL_StatusBar, "Request Failed");
    @sysvar::SysVar_PROXI::PROXI_bCheckEOLRqst = 0;
  }
   
  if(@sysvar::SysVar_PROXI::PROXI_bReadRqst)
  {
    sysSetVariableString(sysvar::SysVar_PROXI::DIAG_ePROXI_StatusBar, "Request PROXI Failed");
    @sysvar::SysVar_PROXI::PROXI_bReadRqst = 0;
  }
  if(@sysvar::SysVar_PROXI::PROXI_bProxiWriteCounterRqst)
  {
    sysSetVariableString(sysvar::SysVar_PROXI::DIAG_ePROXI_StatusBar, "Request PROXI Write Counter Failed");
    @sysvar::SysVar_PROXI::PROXI_bProxiWriteCounterRqst = 0;
  }
}

on timer PROXI__tTimeoutFC
{
  PROXI_boIsTimeout = 1;
  cancelTimer(PROXI__tIPCResponse);
  @sysvar::SysVar_PROXI::PROXI_eWriteRqst = 0;
  sysSetVariableString(sysvar::SysVar_PROXI::DIAG_ePROXI_StatusBar, "Sending PROXI Failed");
}

on timer PROXI__tIPCResponse
{
  PROXI_boIsTimeout = 1;
  @sysvar::SysVar_PROXI::PROXI_eWriteRqst = 0;
  sysSetVariableString(sysvar::SysVar_PROXI::DIAG_ePROXI_StatusBar, "Sending PROXI Successful - IPC refused PROXI");
}

void PROXI__vClearBuffer(void)
{
  int i;
  for(i = 0; i < 255; i++)
  {
    PROXI_bDataBuffer[i] = 0;
  }
}

void PROXI__vClear_abCheckEOL_Data(void)
{
  int i;
  for(i = 0; i < __PROXI_CheckEOL_DataRead; i++)
  {
    PROXI_abCheckEOL_Data[i] = 0;
  }
}

on SysVar sysvar::SysVar_PROXI::DIAG_eRead_CheckEOL
{
  if(@this)
  {
    PROXI_boIsTimeout = 0;
    PROXI__vClear_abCheckEOL_Data();
    @sysvar::SysVar_PROXI::PROXI_bCheckEOLRqst = 1;
    sysSetVariableString(sysvar::SysVar_PROXI::DIAG_ePROXI_StatusBar, "Check EOL Configuration - Data Request"); 
    sysSetVariableData(sysvar::SysVar_PROXI::TPL_eTxDataBuffer, DIAG__abCheckEOLConfig, __PROXIDataRead_size);
    @sysvar::SysVar_PROXI::TPL_eTxNrOfBytes = __PROXIDataRead_size;
    @sysvar::SysVar_PROXI::TPL_eTxRequest = 0;
    @sysvar::SysVar_PROXI::TPL_eTxRequest = 1;
    setTimer(PROXI_tNoResponse, PROXI_iNoResponse);
  }
}

on SysVar sysvar::SysVar_PROXI::DIAG_ProxiLesen
{ 
  byte DIAG__abPROXIDataRead[__PROXIDataRead_size] = {0x22, 0x20, 0x23};
  if(@this)
  {
    PROXI_boIsTimeout = 0;
    @sysvar::SysVar_PROXI::PROXI_bReadRqst = 1;
    sysSetVariableString(sysvar::SysVar_PROXI::DIAG_ePROXI_StatusBar, "Request PROXI");
    PROXI__vClearBuffer(); 
    sysSetVariableData(sysvar::SysVar_PROXI::TPL_eTxDataBuffer, DIAG__abPROXIDataRead, __PROXIDataRead_size);
    //write("__PROXIDataRead_size %d",__PROXIDataRead_size);
    @sysvar::SysVar_PROXI::TPL_eTxNrOfBytes = __PROXIDataRead_size;
    @sysvar::SysVar_PROXI::TPL_eTxRequest = 0;
    @sysvar::SysVar_PROXI::TPL_eTxRequest = 1;
    setTimer(PROXI_tNoResponse, PROXI_iNoResponse);
  }
}

on SysVar sysvar::SysVar_PROXI::DIAG_ProxiRaus
{
  int i;
  if(@this == 0)
  {
    PROXI_boIsTimeout = 0;
    PROXI__bIsPositiveResponse = 0;   //Reset flag that indicates IPC response for writing PROXI
    // Update Buffer: 2E 20 23 + 255 bytes of PROXI
    sysGetVariableData(sysvar::SysVar_PROXI::DIAG_eProxiDataBuffer,PROXI_bDataBuffer,copiedbytes);
    PROXI_bWriteDataBuffer[0] = 0x2E;
    PROXI_bWriteDataBuffer[1] = 0x20;
    PROXI_bWriteDataBuffer[2] = 0x23; 
    for(i = 0; i < LAST_BYTE_TO_CRC; i++)
    {
      PROXI_bWriteDataBuffer[i + 3] = PROXI_bDataBuffer[i];
    }
    DIAG__iTxNumberOfBytes = (258);        
    @sysvar::SysVar_PROXI::PROXI_eWriteRqst = 1;
    PROXI_vSendData();
    }
}

void PROXI_vSendData (void)
{
  Message DIAGNOSTIC_REQUEST_IPC msg;
  int i;
  if(DIAG__iTxNumberOfBytes > 0x07)
  {
  //  msg.id=0x18DA60F4x; /*F1=520 and F4=327*/
    msg.dlc = 8;
    /* Multiple Frame */
    DIAG_bCFRequest = 0;
    DIAG__iNextByteToSend = 0;
    ProxiFileLenght = @sysvar::SysVar_PROXI::pByte106;
    if(ProxiFileLenght < 253)
    {
      msg.byte(0) = 0x10;
      msg.byte(1) = ProxiFileLenght + 3;
    }
    if(ProxiFileLenght > 252)
    {
      if(ProxiFileLenght == 253)
      {
        msg.byte(0) = 0x11;
        msg.byte(1) = 0x00;
      }
      if(ProxiFileLenght == 254)
      {
        msg.byte(0) = 0x11;
        msg.byte(1) = 0x01;
      }
      if(ProxiFileLenght == 255)
      {
        msg.byte(0) = 0x11;
        msg.byte(1) = 0x02;
      }
    }
    //DIAG__iMissingBytes = DIAG__iTxNumberOfBytes;
    DIAG__iMissingBytes = ProxiFileLenght + 3;
    DIAG__iSendNextCF = 0x01;
    for (i = 2; i < 8; i++)
    {
      msg.byte(i) = PROXI_bWriteDataBuffer[DIAG__iNextByteToSend];
      DIAG__iMissingBytes--;
      DIAG__iNextByteToSend++;
    }
    output(msg);
    SetTimer(PROXI__tTimeoutFC, PROXI__iTimeoutFC);
  }
}

on message DIAGNOSTIC_RESPONSE_IPC
{ 
  int i, j;
	int iFirstByte;
	int iLastByte;
  if(@sysvar::SysVar_PROXI::PROXI_eWriteRqst == 0)
  {
    if(@sysvar::SysVar_PROXI::PROXI_bReadRqst == 1)
    {
      /* Addressed to tester */
     	if((this.byte(0) & 0xf0) == 0x10 /* TPCI */)
      {
        if(this.byte(2) == 0x62)
        {
          if(this.byte(3) == 0x20)
          {
            if(this.byte(4) == 0x23)
            {
              TPL__vClearRxBuffer();
              PBL1 = this.byte(0);
              PBL2 = this.byte(1);
              //write("PBL1 %d",PBL1);
              //write("PBL2 %d",PBL2);
              if(PBL1 == 0x10)
              {
                ProxiFileLenght = PBL2 - 3;
                //write("ProxiFileLenght %d",ProxiFileLenght);
              }
              if(PBL1 == 0x11)
              {
                if(PBL2 == 0)
                {
                  ProxiFileLenght = 256;
                }
                if(PBL2 == 1)
                {
                  ProxiFileLenght = 257;
                }  
                if(PBL2 == 2)
                {
                  ProxiFileLenght = 258;
                }  
              }
              @sysvar::SysVar_PROXI::pByte106 = ProxiFileLenght;
              i=0;
              TPL__pbRxDataBuffer[i++] = this.byte(5);  
              TPL__pbRxDataBuffer[i++] = this.byte(6);
              TPL__pbRxDataBuffer[i++] = this.byte(7);
              TPL__iReceivedBytes = 3;
              TPL__iReceivedFrames = 1;
    	        setTimer(TPL__tDelayFC,TPL__iDelayFC);
              TPL__NumberOfByteEOL = this.byte(1);
              TPL__NumberOfByteEOL2 = this.byte(1);
              if(TPL__NumberOfByteEOL2 < 0x03)
              {
                TPL__NumberOfByteEOL2 = 0xFF;
              }
            }
          }
        }
      }
      if((this.byte(0) & 0xf0) == 0x20 /* TPCI */)
    	{
        for(j=1; j<=7; j++)
        {
          TPL__pbRxDataBuffer[i++] = this.byte(j);
          TPL__iReceivedBytes++;
        }
        TPL__iReceivedFrames++;
        if(TPL__iReceivedFrames == (( (TPL__NumberOfByteEOL2) / 7) + 1))
        {
          if(TPL__NumberOfByteEOL > 25)
          {
            TPL__iReceivedBytes = TPL__NumberOfByteEOL - 3;
            TPL__vDataInd(TPL__iReceivedBytes);
          }
          else  
          {
            if(TPL__NumberOfByteEOL == 00)
            {
              TPL__iReceivedBytes = 253;
              TPL__vDataInd(TPL__iReceivedBytes);
            } 
            if(TPL__NumberOfByteEOL == 01)
            {
              TPL__iReceivedBytes = 254;
              TPL__vDataInd(TPL__iReceivedBytes);
            }
            if(TPL__NumberOfByteEOL == 02)
            {
              TPL__iReceivedBytes = 255;
              TPL__vDataInd(TPL__iReceivedBytes);
            }
          }  
        }
      }
    }
    else
    {
      /* Addressed to tester */
      if((this.byte(0) & 0xf0) == 0x10 /* TPCI */)
      {
        /* First Frame */
        TPL__vClearRxBuffer();
        TPL__iMissingBytes = this.byte(1); /* DL */
        TPL__iSendNumberOfCF = ((TPL__iMissingBytes - 6) / 7) ;
        if (((TPL__iMissingBytes - 6) % 7) != 0)
        {
        	TPL__iSendNumberOfCF += 1;
        }
        TPL__iSendNextCF = 0x01; // SN-Number starts with 1 not 0
        TPL__iReceivedBytes = 0x00;
        TPL__iMissingBytes = this.byte(1); /* DL */
        for(i=2; i<8; i++)
        {
        	TPL__pbRxDataBuffer[i-2] = this.byte(i);
        	TPL__iMissingBytes--;
        	TPL__iReceivedBytes++;
        }
        //TPL__vSendFlowControl(); //send FC immediately
        if(this.byte(3) == 0x20)
          {
        setTimer(TPL__tDelayFC,TPL__iDelayFC);
          }
      }
      if((this.byte(0) & 0xf0) == 0x20 /* TPCI */)
      {
        write ("CF Received %d",(this.byte(0) & 0x0f));
        /* Consecutive Frame */
        if(TPL__iMissingBytes > 0)
        {
        if((this.byte(0) & 0x0f) == TPL__iSendNextCF)
        {
        	TPL__iSendNextCF++;
        	if(TPL__iMissingBytes > 7)
        	{
        		iFirstByte = TPL__iReceivedBytes;
        		iLastByte = iFirstByte + 7;
        		for(i = iFirstByte; i < iLastByte; i++)
        		{
        			TPL__pbRxDataBuffer[i] = this.byte(i + 1 - iFirstByte);
        			TPL__iMissingBytes--;
        			TPL__iReceivedBytes++;
        		}
        	}
        	else
        	{
        		iFirstByte = TPL__iReceivedBytes;
        		iLastByte = iFirstByte + TPL__iMissingBytes;
        		for(i= iFirstByte; i < iLastByte; i++)
        		{
        			TPL__pbRxDataBuffer[i] = this.byte(i + 1 - iFirstByte);
        			TPL__iMissingBytes--;
        			TPL__iReceivedBytes++;
        		}
        		TPL__vDataInd(TPL__iReceivedBytes);
        	}
        }
        else
        {
        	/* CF ERROR */
        	if(DEBUG) {write ("ERROR: CF Received %d Expected: %d",(this.byte(1) & 0x0f),TPL__iSendNextCF);}
        }
        }
      }
      if((this.byte(0) & 0xf0) == 0x30 /* TPCI */)
      {
        /* Flow Control */
        cancelTimer(TPL__tTimeoutFC);
        TPL__vTransmitNextCF();
      }
      if((this.byte(0) & 0xf0) == 0x00 /* TPCI */)
      {
        /* Single Frame */
        TPL__vClearRxBuffer();
        TPL__iReceivedBytes = 0x00;
        for(i=1; i < ((this.byte(0) & 0x0f) + 1); i++)
        {
        	TPL__pbRxDataBuffer[i - 1] = this.byte(i);
        	TPL__iReceivedBytes++;
        }
        TPL__vDataInd(TPL__iReceivedBytes);
      }
    }
  }
  if(@sysvar::SysVar_PROXI::PROXI_eWriteRqst == 1)
  {
    //Check if Flow Control was received
    if((this.byte(0) & 0xf0) == 0x30 /* TPCI */)
    {
      /* Flow Control */
      cancelTimer(PROXI__tTimeoutFC);
      PROXI__vTransmitNextCF();
    }
    //Check if IPC sent a response to writing PROXI: [03] 6E 20 23
    if(this.byte(0) == 0x03)
    {
      if(this.byte(1) == PROXI__abWriteProxiPosResp[0])
      {
        if(this.byte(2) == PROXI__abWriteProxiPosResp[1])
        {
          if(this.byte(3) == PROXI__abWriteProxiPosResp[2])
          {
            PROXI__bIsPositiveResponse = 1;
            cancelTimer(PROXI__tIPCResponse);
            sysSetVariableString(sysvar::SysVar_PROXI::DIAG_ePROXI_StatusBar, "Sending PROXI Successful - IPC accepted PROXI");
            @sysvar::SysVar_PROXI::PROXI_eWriteRqst = 0;
          }
        }
      }
    }
  }  
}

void PROXI__vTransmitNextCF(void)
{
  message DIAGNOSTIC_REQUEST_IPC msg;
  int i;
  if(DIAG__iMissingBytes > 7)
  {
  //  msg.id=0x18DA60F4x; /*F1=520 and F4=327*/
    msg.dlc = 8;
    if(DIAG__iSendNextCF > 0x0F)
    {
    	DIAG__iSendNextCF = 0x00;
    }
    msg.byte(0) = (0x20 | ((byte)DIAG__iSendNextCF));
    for (i = 1; i < 8; i++)
    {
      msg.byte(i) = PROXI_bWriteDataBuffer[DIAG__iNextByteToSend];
      DIAG__iMissingBytes--;
      DIAG__iNextByteToSend++;
    }
    output(msg);
    DIAG__iSendNextCF++;
    DIAG_bCFRequest = 1;
    cancelTimer(PROXI__tTxNextCF);
    setTimer(PROXI__tTxNextCF, PROXI__iTxNextCF);
  }
  else
  {
  //  msg.id=0x18DA60F4x; /*F1=520 and F4=327*/
    msg.dlc = 1 + DIAG__iMissingBytes;
    msg.byte(0) = (0x20 | ((byte)DIAG__iSendNextCF));
    for (i = 1; i < (1 + DIAG__iMissingBytes); i++)
    {
      msg.byte(i) = PROXI_bWriteDataBuffer[DIAG__iNextByteToSend];
      DIAG__iNextByteToSend++;
    }
    output(msg);
    DIAG__iMissingBytes = 0;
    DIAG_bCFRequest = 0;
    cancelTimer(PROXI__tTxNextCF);
    SetTimer(PROXI__tIPCResponse, PROXI__iIPCResponse);
  }
}

on timer PROXI__tTxNextCF
{
  //write("Write by Timer, next byte %d",DIAG__iNextByteToSend);
  //getLocalTime(timeArray);
  //write("Time: %d:%d:%d",timeArray[2],timeArray[1],timeArray[0]);
	PROXI__vTransmitNextCF();
}

on SysVar sysvar::SysVar_PROXI::DIAG_eConfigCode_load
{
  byte bBuffer[255];
  int i;
  if(@this == 0)
  {
    sysGetVariableData(sysvar::SysVar_PROXI::DIAG_eConfigCode,bBuffer,copiedbytes);
    sysGetVariableData(sysvar::SysVar_PROXI::DIAG_eProxiDataBuffer,PROXI_bDataBuffer,copiedbytes);
    for(i = 0; i < PROXI_CFG_CODE_SIZE; i++)
    {
//      if(bBuffer[i] == 0)
//      {
//        break;
//      }
      PROXI_bDataBuffer[i] = (byte)bBuffer[i]; 
    }
     sysSetVariableData(sysvar::SysVar_PROXI::DIAG_eProxiDataBuffer, PROXI_bDataBuffer,copiedbytes);
  } 
  sysSetVariableString(sysvar::SysVar_PROXI::DIAG_ePROXI_StatusBar, "");
  sysSetVariableString(sysvar::SysVar_PROXI::DIAG_ePROXI_StatusBar, "Loading PROXI Successful - Configuration Code");
}

on SysVar sysvar::SysVar_PROXI::DIAG_eConfigCode_clear
{
  int i;
  if(@this == 0)
  {
    sysGetVariableData(sysvar::SysVar_PROXI::DIAG_eProxiDataBuffer,PROXI_bDataBuffer,copiedbytes); 
    for(i = 0; i < PROXI_CFG_CODE_SIZE; i++)
    {
      PROXI_bDataBuffer[i] = 0;      
    }
    sysSetVariableData(sysvar::SysVar_PROXI::DIAG_eProxiDataBuffer, PROXI_bDataBuffer,copiedbytes);   
  }
}

on SysVar sysvar::SysVar_PROXI::DIAG_eTesterCode_load
{
  byte bBuffer[255];
  int i;
  if(@this == 0)
  {
    sysGetVariableData(sysvar::SysVar_PROXI::DIAG_eTesterCode, bBuffer,copiedbytes);
    sysGetVariableData(sysvar::SysVar_PROXI::DIAG_eProxiDataBuffer,PROXI_bDataBuffer,copiedbytes);
    for(i = 0; i < PROXI_TST_CODE_SIZE; i++)
    {
//      if(bBuffer[i] == 0)
//      {
//        break;
//      }
      PROXI_bDataBuffer[i+PROXI_TST_CODE_OFFSET] = (byte)bBuffer[i];      
    }
    sysSetVariableData(sysvar::SysVar_PROXI::DIAG_eProxiDataBuffer, PROXI_bDataBuffer,copiedbytes);
  } 
  sysSetVariableString(sysvar::SysVar_PROXI::DIAG_ePROXI_StatusBar, "");
  sysSetVariableString(sysvar::SysVar_PROXI::DIAG_ePROXI_StatusBar, "Loading PROXI Successful - Tester Code");
}

on SysVar sysvar::SysVar_PROXI::DIAG_eTesterCode_clear
{
  int i;
  if(@this == 0)
  {
    sysGetVariableData(sysvar::SysVar_PROXI::DIAG_eProxiDataBuffer,PROXI_bDataBuffer,copiedbytes);
    for(i = 0; i < PROXI_TST_CODE_SIZE; i++)
    {
      PROXI_bDataBuffer[i+PROXI_TST_CODE_OFFSET] = 0;      
    }
      sysSetVariableData(sysvar::SysVar_PROXI::DIAG_eProxiDataBuffer, PROXI_bDataBuffer,copiedbytes);   
  }
}

on SysVar sysvar::SysVar_PROXI::DIAG_ProductionDate_load
{
  byte bBuffer[255];
  int i;
  if(@this == 0)
  {
    sysGetVariableData(sysvar::SysVar_PROXI::DIAG_ProductionDate, bBuffer,copiedbytes);
    sysGetVariableData(sysvar::SysVar_PROXI::DIAG_eProxiDataBuffer,PROXI_bDataBuffer,copiedbytes);
    for(i = 0; i < PROXI_PROD_DATE_SIZE; i++)
    {
//      if(bBuffer[i] == 0)
//      {
//        break;
//      }
      PROXI_bDataBuffer[i+PROXI_PROD_DATE_OFFSET] = (byte)bBuffer[i];      
    }
    sysSetVariableData(sysvar::SysVar_PROXI::DIAG_eProxiDataBuffer, PROXI_bDataBuffer,copiedbytes);
  } 
  sysSetVariableString(sysvar::SysVar_PROXI::DIAG_ePROXI_StatusBar, "");
  sysSetVariableString(sysvar::SysVar_PROXI::DIAG_ePROXI_StatusBar, "Loading PROXI Successful - Production Date");
}

on SysVar sysvar::SysVar_PROXI::DIAG_eCANnode_clear
{
  if(@this)
  {
    @sysvar::SysVar_PROXI::pByte26Bit0 = 0;
    @sysvar::SysVar_PROXI::pByte26Bit1 = 0;
    @sysvar::SysVar_PROXI::pByte26Bit2 = 0;
    @sysvar::SysVar_PROXI::pByte26Bit3 = 0;
    @sysvar::SysVar_PROXI::pByte26Bit4 = 0;
    @sysvar::SysVar_PROXI::pByte26Bit5 = 0;
    @sysvar::SysVar_PROXI::pByte26Bit6 = 0;
    @sysvar::SysVar_PROXI::pByte26Bit7 = 0;
      
    @sysvar::SysVar_PROXI::pByte27Bit0 = 0;
    @sysvar::SysVar_PROXI::pByte27Bit1 = 0;
    @sysvar::SysVar_PROXI::pByte27Bit2 = 0;
    @sysvar::SysVar_PROXI::pByte27Bit3 = 0;
    @sysvar::SysVar_PROXI::pByte27Bit4 = 0;
    @sysvar::SysVar_PROXI::pByte27Bit5 = 0;
    @sysvar::SysVar_PROXI::pByte27Bit6 = 0;
    @sysvar::SysVar_PROXI::pByte27Bit7 = 0;
      
    @sysvar::SysVar_PROXI::pByte28Bit0 = 0;
    @sysvar::SysVar_PROXI::pByte28Bit1 = 0;
    @sysvar::SysVar_PROXI::pByte28Bit2 = 0;
    @sysvar::SysVar_PROXI::pByte28Bit3 = 0;
    @sysvar::SysVar_PROXI::pByte28Bit4 = 0;
    @sysvar::SysVar_PROXI::pByte28Bit5 = 0;
    @sysvar::SysVar_PROXI::pByte28Bit6 = 0;
    @sysvar::SysVar_PROXI::pByte28Bit7 = 0;
      
    @sysvar::SysVar_PROXI::pByte29Bit0 = 0;
    @sysvar::SysVar_PROXI::pByte29Bit1 = 0;
    @sysvar::SysVar_PROXI::pByte29Bit2 = 0;
    @sysvar::SysVar_PROXI::pByte29Bit3 = 0;
    @sysvar::SysVar_PROXI::pByte29Bit4 = 0;
    @sysvar::SysVar_PROXI::pByte29Bit5 = 0;
    @sysvar::SysVar_PROXI::pByte29Bit6 = 0;
    @sysvar::SysVar_PROXI::pByte29Bit7 = 0;
      
    @sysvar::SysVar_PROXI::pByte30Bit0 = 0;
    @sysvar::SysVar_PROXI::pByte30Bit1 = 0;
    @sysvar::SysVar_PROXI::pByte30Bit2 = 0;
    @sysvar::SysVar_PROXI::pByte30Bit3 = 0;
    @sysvar::SysVar_PROXI::pByte30Bit4 = 0;
    @sysvar::SysVar_PROXI::pByte30Bit5 = 0;
    @sysvar::SysVar_PROXI::pByte30Bit6 = 0;
    @sysvar::SysVar_PROXI::pByte30Bit7 = 0;
      
    @sysvar::SysVar_PROXI::pByte31Bit0 = 0;
    @sysvar::SysVar_PROXI::pByte31Bit1 = 0;
    @sysvar::SysVar_PROXI::pByte31Bit2 = 0;
    @sysvar::SysVar_PROXI::pByte31Bit3 = 0;
    @sysvar::SysVar_PROXI::pByte31Bit4 = 0;
    @sysvar::SysVar_PROXI::pByte31Bit5 = 0;
    @sysvar::SysVar_PROXI::pByte31Bit6 = 0;
    @sysvar::SysVar_PROXI::pByte31Bit7 = 0;
      
    @sysvar::SysVar_PROXI::pByte32Bit0 = 0;
    @sysvar::SysVar_PROXI::pByte32Bit1 = 0;
    @sysvar::SysVar_PROXI::pByte32Bit2 = 0;
    @sysvar::SysVar_PROXI::pByte32Bit3 = 0;
    @sysvar::SysVar_PROXI::pByte32Bit4 = 0;
    @sysvar::SysVar_PROXI::pByte32Bit5 = 0;
    @sysvar::SysVar_PROXI::pByte32Bit6 = 0;
    @sysvar::SysVar_PROXI::pByte32Bit7 = 0;
      
    @sysvar::SysVar_PROXI::pByte33Bit0 = 0;
    @sysvar::SysVar_PROXI::pByte33Bit1 = 0;
    @sysvar::SysVar_PROXI::pByte33Bit2 = 0;
    @sysvar::SysVar_PROXI::pByte33Bit3 = 0;
    @sysvar::SysVar_PROXI::pByte33Bit4 = 0;
    @sysvar::SysVar_PROXI::pByte33Bit5 = 0;
    @sysvar::SysVar_PROXI::pByte33Bit6 = 0;
    @sysvar::SysVar_PROXI::pByte33Bit7 = 0;
      
    @sysvar::SysVar_PROXI::pByte34Bit0 = 0;
    @sysvar::SysVar_PROXI::pByte34Bit1 = 0;
    @sysvar::SysVar_PROXI::pByte34Bit2 = 0;
    @sysvar::SysVar_PROXI::pByte34Bit3 = 0;
    @sysvar::SysVar_PROXI::pByte34Bit4 = 0;
    @sysvar::SysVar_PROXI::pByte34Bit5 = 0;
    @sysvar::SysVar_PROXI::pByte34Bit6 = 0;
    @sysvar::SysVar_PROXI::pByte34Bit7 = 0;
      
    @sysvar::SysVar_PROXI::pByte34Bit0 = 0;
    @sysvar::SysVar_PROXI::pByte34Bit1 = 0;
    @sysvar::SysVar_PROXI::pByte34Bit2 = 0;
    @sysvar::SysVar_PROXI::pByte34Bit3 = 0;
    @sysvar::SysVar_PROXI::pByte34Bit4 = 0;
    @sysvar::SysVar_PROXI::pByte34Bit5 = 0;
    @sysvar::SysVar_PROXI::pByte34Bit6 = 0;
    @sysvar::SysVar_PROXI::pByte34Bit7 = 0;
      
    @sysvar::SysVar_PROXI::pByte35Bit0 = 0;
    @sysvar::SysVar_PROXI::pByte35Bit1 = 0;
    @sysvar::SysVar_PROXI::pByte35Bit2 = 0;
    @sysvar::SysVar_PROXI::pByte35Bit3 = 0;
    @sysvar::SysVar_PROXI::pByte35Bit4 = 0;
    @sysvar::SysVar_PROXI::pByte35Bit5 = 0;
    @sysvar::SysVar_PROXI::pByte35Bit6 = 0;
    @sysvar::SysVar_PROXI::pByte35Bit7 = 0;
      
    @sysvar::SysVar_PROXI::pByte36Bit0 = 0;
    @sysvar::SysVar_PROXI::pByte36Bit1 = 0;
    @sysvar::SysVar_PROXI::pByte36Bit2 = 0;
    @sysvar::SysVar_PROXI::pByte36Bit3 = 0;
    @sysvar::SysVar_PROXI::pByte36Bit4 = 0;
    @sysvar::SysVar_PROXI::pByte36Bit5 = 0;
    @sysvar::SysVar_PROXI::pByte36Bit6 = 0;
    @sysvar::SysVar_PROXI::pByte36Bit7 = 0;
      
    @sysvar::SysVar_PROXI::pByte37Bit0 = 0;
    @sysvar::SysVar_PROXI::pByte37Bit1 = 0;
    @sysvar::SysVar_PROXI::pByte37Bit2 = 0;
    @sysvar::SysVar_PROXI::pByte37Bit3 = 0;
    @sysvar::SysVar_PROXI::pByte37Bit4 = 0;
    @sysvar::SysVar_PROXI::pByte37Bit5 = 0;
    @sysvar::SysVar_PROXI::pByte37Bit6 = 0;
    @sysvar::SysVar_PROXI::pByte37Bit7 = 0;
      
    @sysvar::SysVar_PROXI::pByte38Bit0 = 0;
    @sysvar::SysVar_PROXI::pByte38Bit1 = 0;
    @sysvar::SysVar_PROXI::pByte38Bit2 = 0;
    @sysvar::SysVar_PROXI::pByte38Bit3 = 0;
    @sysvar::SysVar_PROXI::pByte38Bit4 = 0;
    @sysvar::SysVar_PROXI::pByte38Bit5 = 0;
    @sysvar::SysVar_PROXI::pByte38Bit6 = 0;
    @sysvar::SysVar_PROXI::pByte38Bit7 = 0;
      
    @sysvar::SysVar_PROXI::pByte38Bit0 = 0;
    @sysvar::SysVar_PROXI::pByte38Bit1 = 0;
    @sysvar::SysVar_PROXI::pByte38Bit2 = 0;
    @sysvar::SysVar_PROXI::pByte38Bit3 = 0;
    @sysvar::SysVar_PROXI::pByte38Bit4 = 0;
    @sysvar::SysVar_PROXI::pByte38Bit5 = 0;
    @sysvar::SysVar_PROXI::pByte38Bit6 = 0;
    @sysvar::SysVar_PROXI::pByte38Bit7 = 0;
      
    @sysvar::SysVar_PROXI::pByte39Bit0 = 0;
    @sysvar::SysVar_PROXI::pByte39Bit1 = 0;
    @sysvar::SysVar_PROXI::pByte39Bit2 = 0;
    @sysvar::SysVar_PROXI::pByte39Bit3 = 0;
    @sysvar::SysVar_PROXI::pByte39Bit4 = 0;
    @sysvar::SysVar_PROXI::pByte39Bit5 = 0;
    @sysvar::SysVar_PROXI::pByte39Bit6 = 0;
    @sysvar::SysVar_PROXI::pByte39Bit7 = 0;
      
    @sysvar::SysVar_PROXI::pByte40Bit0 = 0;
    @sysvar::SysVar_PROXI::pByte40Bit1 = 0;
    @sysvar::SysVar_PROXI::pByte40Bit2 = 0;
    @sysvar::SysVar_PROXI::pByte40Bit3 = 0;
    @sysvar::SysVar_PROXI::pByte40Bit4 = 0;
    @sysvar::SysVar_PROXI::pByte40Bit5 = 0;
    @sysvar::SysVar_PROXI::pByte40Bit6 = 0;
    @sysvar::SysVar_PROXI::pByte40Bit7 = 0;
      
    @sysvar::SysVar_PROXI::pByte41Bit0 = 0;
    @sysvar::SysVar_PROXI::pByte41Bit1 = 0;
    @sysvar::SysVar_PROXI::pByte41Bit2 = 0;
    @sysvar::SysVar_PROXI::pByte41Bit3 = 0;
    @sysvar::SysVar_PROXI::pByte41Bit4 = 0;
    @sysvar::SysVar_PROXI::pByte41Bit5 = 0;
    @sysvar::SysVar_PROXI::pByte41Bit6 = 0;
    @sysvar::SysVar_PROXI::pByte41Bit7 = 0;
  }
}

on SysVar sysvar::SysVar_PROXI::DIAG_eCANnode_set
{
  if(@this)
  {
    @sysvar::SysVar_PROXI::pByte26Bit0 = 1;
    @sysvar::SysVar_PROXI::pByte26Bit1 = 1;
    @sysvar::SysVar_PROXI::pByte26Bit2 = 1;
    @sysvar::SysVar_PROXI::pByte26Bit3 = 1;
    @sysvar::SysVar_PROXI::pByte26Bit4 = 1;
    @sysvar::SysVar_PROXI::pByte26Bit5 = 1;
    @sysvar::SysVar_PROXI::pByte26Bit6 = 1;
    @sysvar::SysVar_PROXI::pByte26Bit7 = 1;
      
    @sysvar::SysVar_PROXI::pByte27Bit0 = 1;
    @sysvar::SysVar_PROXI::pByte27Bit1 = 1;
    @sysvar::SysVar_PROXI::pByte27Bit2 = 1;
    @sysvar::SysVar_PROXI::pByte27Bit3 = 1;
    @sysvar::SysVar_PROXI::pByte27Bit4 = 1;
    @sysvar::SysVar_PROXI::pByte27Bit5 = 1;
    @sysvar::SysVar_PROXI::pByte27Bit6 = 1;
    @sysvar::SysVar_PROXI::pByte27Bit7 = 1;
      
    @sysvar::SysVar_PROXI::pByte28Bit0 = 1;
    @sysvar::SysVar_PROXI::pByte28Bit1 = 1;
    @sysvar::SysVar_PROXI::pByte28Bit2 = 1;
    @sysvar::SysVar_PROXI::pByte28Bit3 = 1;
    @sysvar::SysVar_PROXI::pByte28Bit4 = 1;
    @sysvar::SysVar_PROXI::pByte28Bit5 = 1;
    @sysvar::SysVar_PROXI::pByte28Bit6 = 1;
    @sysvar::SysVar_PROXI::pByte28Bit7 = 1;
      
    @sysvar::SysVar_PROXI::pByte29Bit0 = 1;
    @sysvar::SysVar_PROXI::pByte29Bit1 = 1;
    @sysvar::SysVar_PROXI::pByte29Bit2 = 1;
    @sysvar::SysVar_PROXI::pByte29Bit3 = 1;
    @sysvar::SysVar_PROXI::pByte29Bit4 = 1;
    @sysvar::SysVar_PROXI::pByte29Bit5 = 1;
    @sysvar::SysVar_PROXI::pByte29Bit6 = 1;
    @sysvar::SysVar_PROXI::pByte29Bit7 = 1;
      
    @sysvar::SysVar_PROXI::pByte30Bit0 = 1;
    @sysvar::SysVar_PROXI::pByte30Bit1 = 1;
    @sysvar::SysVar_PROXI::pByte30Bit2 = 1;
    @sysvar::SysVar_PROXI::pByte30Bit3 = 1;
    @sysvar::SysVar_PROXI::pByte30Bit4 = 1;
    @sysvar::SysVar_PROXI::pByte30Bit5 = 1;
    @sysvar::SysVar_PROXI::pByte30Bit6 = 1;
    @sysvar::SysVar_PROXI::pByte30Bit7 = 1;
      
    @sysvar::SysVar_PROXI::pByte31Bit0 = 1;
    @sysvar::SysVar_PROXI::pByte31Bit1 = 1;
    @sysvar::SysVar_PROXI::pByte31Bit2 = 1;
    @sysvar::SysVar_PROXI::pByte31Bit3 = 1;
    @sysvar::SysVar_PROXI::pByte31Bit4 = 1;
    @sysvar::SysVar_PROXI::pByte31Bit5 = 1;
    @sysvar::SysVar_PROXI::pByte31Bit6 = 1;
    @sysvar::SysVar_PROXI::pByte31Bit7 = 1;
      
    @sysvar::SysVar_PROXI::pByte32Bit0 = 1;
    @sysvar::SysVar_PROXI::pByte32Bit1 = 1;
    @sysvar::SysVar_PROXI::pByte32Bit2 = 1;
    @sysvar::SysVar_PROXI::pByte32Bit3 = 1;
    @sysvar::SysVar_PROXI::pByte32Bit4 = 1;
    @sysvar::SysVar_PROXI::pByte32Bit5 = 1;
    @sysvar::SysVar_PROXI::pByte32Bit6 = 1;
    @sysvar::SysVar_PROXI::pByte32Bit7 = 1;
      
    @sysvar::SysVar_PROXI::pByte33Bit0 = 1;
    @sysvar::SysVar_PROXI::pByte33Bit1 = 1;
    @sysvar::SysVar_PROXI::pByte33Bit2 = 1;
    @sysvar::SysVar_PROXI::pByte33Bit3 = 1;
    @sysvar::SysVar_PROXI::pByte33Bit4 = 1;
    @sysvar::SysVar_PROXI::pByte33Bit5 = 1;
    @sysvar::SysVar_PROXI::pByte33Bit6 = 1;
    @sysvar::SysVar_PROXI::pByte33Bit7 = 1;
      
    @sysvar::SysVar_PROXI::pByte34Bit0 = 1;
    @sysvar::SysVar_PROXI::pByte34Bit1 = 1;
    @sysvar::SysVar_PROXI::pByte34Bit2 = 1;
    @sysvar::SysVar_PROXI::pByte34Bit3 = 1;
    @sysvar::SysVar_PROXI::pByte34Bit4 = 1;
    @sysvar::SysVar_PROXI::pByte34Bit5 = 1;
    @sysvar::SysVar_PROXI::pByte34Bit6 = 1;
    @sysvar::SysVar_PROXI::pByte34Bit7 = 1;
      
    @sysvar::SysVar_PROXI::pByte34Bit0 = 1;
    @sysvar::SysVar_PROXI::pByte34Bit1 = 1;
    @sysvar::SysVar_PROXI::pByte34Bit2 = 1;
    @sysvar::SysVar_PROXI::pByte34Bit3 = 1;
    @sysvar::SysVar_PROXI::pByte34Bit4 = 1;
    @sysvar::SysVar_PROXI::pByte34Bit5 = 1;
    @sysvar::SysVar_PROXI::pByte34Bit6 = 1;
    @sysvar::SysVar_PROXI::pByte34Bit7 = 1;
      
    @sysvar::SysVar_PROXI::pByte35Bit0 = 1;
    @sysvar::SysVar_PROXI::pByte35Bit1 = 1;
    @sysvar::SysVar_PROXI::pByte35Bit2 = 1;
    @sysvar::SysVar_PROXI::pByte35Bit3 = 1;
    @sysvar::SysVar_PROXI::pByte35Bit4 = 1;
    @sysvar::SysVar_PROXI::pByte35Bit5 = 1;
    @sysvar::SysVar_PROXI::pByte35Bit6 = 1;
    @sysvar::SysVar_PROXI::pByte35Bit7 = 1;
      
    @sysvar::SysVar_PROXI::pByte36Bit0 = 1;
    @sysvar::SysVar_PROXI::pByte36Bit1 = 1;
    @sysvar::SysVar_PROXI::pByte36Bit2 = 1;
    @sysvar::SysVar_PROXI::pByte36Bit3 = 1;
    @sysvar::SysVar_PROXI::pByte36Bit4 = 1;
    @sysvar::SysVar_PROXI::pByte36Bit5 = 1;
    @sysvar::SysVar_PROXI::pByte36Bit6 = 1;
    @sysvar::SysVar_PROXI::pByte36Bit7 = 1;
      
    @sysvar::SysVar_PROXI::pByte37Bit0 = 1;
    @sysvar::SysVar_PROXI::pByte37Bit1 = 1;
    @sysvar::SysVar_PROXI::pByte37Bit2 = 1;
    @sysvar::SysVar_PROXI::pByte37Bit3 = 1;
    @sysvar::SysVar_PROXI::pByte37Bit4 = 1;
    @sysvar::SysVar_PROXI::pByte37Bit5 = 1;
    @sysvar::SysVar_PROXI::pByte37Bit6 = 1;
    @sysvar::SysVar_PROXI::pByte37Bit7 = 1;
      
    @sysvar::SysVar_PROXI::pByte38Bit0 = 1;
    @sysvar::SysVar_PROXI::pByte38Bit1 = 1;
    @sysvar::SysVar_PROXI::pByte38Bit2 = 1;
    @sysvar::SysVar_PROXI::pByte38Bit3 = 1;
    @sysvar::SysVar_PROXI::pByte38Bit4 = 1;
    @sysvar::SysVar_PROXI::pByte38Bit5 = 1;
    @sysvar::SysVar_PROXI::pByte38Bit6 = 1;
    @sysvar::SysVar_PROXI::pByte38Bit7 = 1;
      
    @sysvar::SysVar_PROXI::pByte38Bit0 = 1;
    @sysvar::SysVar_PROXI::pByte38Bit1 = 1;
    @sysvar::SysVar_PROXI::pByte38Bit2 = 1;
    @sysvar::SysVar_PROXI::pByte38Bit3 = 1;
    @sysvar::SysVar_PROXI::pByte38Bit4 = 1;
    @sysvar::SysVar_PROXI::pByte38Bit5 = 1;
    @sysvar::SysVar_PROXI::pByte38Bit6 = 1;
    @sysvar::SysVar_PROXI::pByte38Bit7 = 1;
      
    @sysvar::SysVar_PROXI::pByte39Bit0 = 1;
    @sysvar::SysVar_PROXI::pByte39Bit1 = 1;
    @sysvar::SysVar_PROXI::pByte39Bit2 = 1;
    @sysvar::SysVar_PROXI::pByte39Bit3 = 1;
    @sysvar::SysVar_PROXI::pByte39Bit4 = 1;
    @sysvar::SysVar_PROXI::pByte39Bit5 = 1;
    @sysvar::SysVar_PROXI::pByte39Bit6 = 1;
    @sysvar::SysVar_PROXI::pByte39Bit7 = 1;
      
    @sysvar::SysVar_PROXI::pByte40Bit0 = 1;
    @sysvar::SysVar_PROXI::pByte40Bit1 = 1;
    @sysvar::SysVar_PROXI::pByte40Bit2 = 1;
    @sysvar::SysVar_PROXI::pByte40Bit3 = 1;
    @sysvar::SysVar_PROXI::pByte40Bit4 = 1;
    @sysvar::SysVar_PROXI::pByte40Bit5 = 1;
    @sysvar::SysVar_PROXI::pByte40Bit6 = 1;
    @sysvar::SysVar_PROXI::pByte40Bit7 = 1;
      
    @sysvar::SysVar_PROXI::pByte41Bit0 = 1;
    @sysvar::SysVar_PROXI::pByte41Bit1 = 1;
    @sysvar::SysVar_PROXI::pByte41Bit2 = 1;
    @sysvar::SysVar_PROXI::pByte41Bit3 = 1;
    @sysvar::SysVar_PROXI::pByte41Bit4 = 1;
    @sysvar::SysVar_PROXI::pByte41Bit5 = 1;
    @sysvar::SysVar_PROXI::pByte41Bit6 = 1;
    @sysvar::SysVar_PROXI::pByte41Bit7 = 1;
  }  
}

on SysVar sysvar::SysVar_PROXI::DIAG_eEOLnode_clear
{
  if(@this)
  {
    @sysvar::SysVar_PROXI::pByte42Bit0 = 0;
    @sysvar::SysVar_PROXI::pByte42Bit1 = 0;
    @sysvar::SysVar_PROXI::pByte42Bit2 = 0;
    @sysvar::SysVar_PROXI::pByte42Bit3 = 0;
    @sysvar::SysVar_PROXI::pByte42Bit4 = 0;
    @sysvar::SysVar_PROXI::pByte42Bit5 = 0;
    @sysvar::SysVar_PROXI::pByte42Bit6 = 0;
    @sysvar::SysVar_PROXI::pByte42Bit7 = 0;
      
    @sysvar::SysVar_PROXI::pByte43Bit0 = 0;
    @sysvar::SysVar_PROXI::pByte43Bit1 = 0;
    @sysvar::SysVar_PROXI::pByte43Bit2 = 0;
    @sysvar::SysVar_PROXI::pByte43Bit3 = 0;
    @sysvar::SysVar_PROXI::pByte43Bit4 = 0;
    @sysvar::SysVar_PROXI::pByte43Bit5 = 0;
    @sysvar::SysVar_PROXI::pByte43Bit6 = 0;
    @sysvar::SysVar_PROXI::pByte43Bit7 = 0;
              
    @sysvar::SysVar_PROXI::pByte44Bit0 = 0;
    @sysvar::SysVar_PROXI::pByte44Bit1 = 0;
    @sysvar::SysVar_PROXI::pByte44Bit2 = 0;
    @sysvar::SysVar_PROXI::pByte44Bit3 = 0;
    @sysvar::SysVar_PROXI::pByte44Bit4 = 0;
    @sysvar::SysVar_PROXI::pByte44Bit5 = 0;
    @sysvar::SysVar_PROXI::pByte44Bit6 = 0;
    @sysvar::SysVar_PROXI::pByte44Bit7 = 0;
              
    @sysvar::SysVar_PROXI::pByte45Bit0 = 0;
    @sysvar::SysVar_PROXI::pByte45Bit1 = 0;
    @sysvar::SysVar_PROXI::pByte45Bit2 = 0;
    @sysvar::SysVar_PROXI::pByte45Bit3 = 0;
    @sysvar::SysVar_PROXI::pByte45Bit4 = 0;
    @sysvar::SysVar_PROXI::pByte45Bit5 = 0;
    @sysvar::SysVar_PROXI::pByte45Bit6 = 0;
    @sysvar::SysVar_PROXI::pByte45Bit7 = 0;
      
    @sysvar::SysVar_PROXI::pByte46Bit0 = 0;
    @sysvar::SysVar_PROXI::pByte46Bit1 = 0;
    @sysvar::SysVar_PROXI::pByte46Bit2 = 0;
    @sysvar::SysVar_PROXI::pByte46Bit3 = 0;
    @sysvar::SysVar_PROXI::pByte46Bit4 = 0;
    @sysvar::SysVar_PROXI::pByte46Bit5 = 0;
    @sysvar::SysVar_PROXI::pByte46Bit6 = 0;
    @sysvar::SysVar_PROXI::pByte46Bit7 = 0;
              
    @sysvar::SysVar_PROXI::pByte47Bit0 = 0;
    @sysvar::SysVar_PROXI::pByte47Bit1 = 0;
    @sysvar::SysVar_PROXI::pByte47Bit2 = 0;
    @sysvar::SysVar_PROXI::pByte47Bit3 = 0;
    @sysvar::SysVar_PROXI::pByte47Bit4 = 0;
    @sysvar::SysVar_PROXI::pByte47Bit5 = 0;
    @sysvar::SysVar_PROXI::pByte47Bit6 = 0;
    @sysvar::SysVar_PROXI::pByte47Bit7 = 0;
      
    @sysvar::SysVar_PROXI::pByte48Bit0 = 0;
    @sysvar::SysVar_PROXI::pByte48Bit1 = 0;
    @sysvar::SysVar_PROXI::pByte48Bit2 = 0;
    @sysvar::SysVar_PROXI::pByte48Bit3 = 0;
    @sysvar::SysVar_PROXI::pByte48Bit4 = 0;
    @sysvar::SysVar_PROXI::pByte48Bit5 = 0;
    @sysvar::SysVar_PROXI::pByte48Bit6 = 0;
    @sysvar::SysVar_PROXI::pByte48Bit7 = 0;
      
    @sysvar::SysVar_PROXI::pByte49Bit0 = 0;
    @sysvar::SysVar_PROXI::pByte49Bit1 = 0;
    @sysvar::SysVar_PROXI::pByte49Bit2 = 0;
    @sysvar::SysVar_PROXI::pByte49Bit3 = 0;
    @sysvar::SysVar_PROXI::pByte49Bit4 = 0;
    @sysvar::SysVar_PROXI::pByte49Bit5 = 0;
    @sysvar::SysVar_PROXI::pByte49Bit6 = 0;
    @sysvar::SysVar_PROXI::pByte49Bit7 = 0;
              
    @sysvar::SysVar_PROXI::pByte50Bit0 = 0;
    @sysvar::SysVar_PROXI::pByte50Bit1 = 0;
    @sysvar::SysVar_PROXI::pByte50Bit2 = 0;
    @sysvar::SysVar_PROXI::pByte50Bit3 = 0;
    @sysvar::SysVar_PROXI::pByte50Bit4 = 0;
    @sysvar::SysVar_PROXI::pByte50Bit5 = 0;
    @sysvar::SysVar_PROXI::pByte50Bit6 = 0;
    @sysvar::SysVar_PROXI::pByte50Bit7 = 0;
              
    @sysvar::SysVar_PROXI::pByte51Bit0 = 0;
    @sysvar::SysVar_PROXI::pByte51Bit1 = 0;
    @sysvar::SysVar_PROXI::pByte51Bit2 = 0;
    @sysvar::SysVar_PROXI::pByte51Bit3 = 0;
    @sysvar::SysVar_PROXI::pByte51Bit4 = 0;
    @sysvar::SysVar_PROXI::pByte51Bit5 = 0;
    @sysvar::SysVar_PROXI::pByte51Bit6 = 0;
    @sysvar::SysVar_PROXI::pByte51Bit7 = 0;
      
    @sysvar::SysVar_PROXI::pByte52Bit0 = 0;
    @sysvar::SysVar_PROXI::pByte52Bit1 = 0;
    @sysvar::SysVar_PROXI::pByte52Bit2 = 0;
    @sysvar::SysVar_PROXI::pByte52Bit3 = 0;
    @sysvar::SysVar_PROXI::pByte52Bit4 = 0;
    @sysvar::SysVar_PROXI::pByte52Bit5 = 0;
    @sysvar::SysVar_PROXI::pByte52Bit6 = 0;
    @sysvar::SysVar_PROXI::pByte52Bit7 = 0;
              
    @sysvar::SysVar_PROXI::pByte53Bit0 = 0;
    @sysvar::SysVar_PROXI::pByte53Bit1 = 0;
    @sysvar::SysVar_PROXI::pByte53Bit2 = 0;
    @sysvar::SysVar_PROXI::pByte53Bit3 = 0;
    @sysvar::SysVar_PROXI::pByte53Bit4 = 0;
    @sysvar::SysVar_PROXI::pByte53Bit5 = 0;
    @sysvar::SysVar_PROXI::pByte53Bit6 = 0;
    @sysvar::SysVar_PROXI::pByte53Bit7 = 0;
                    
    @sysvar::SysVar_PROXI::pByte54Bit0 = 0;
    @sysvar::SysVar_PROXI::pByte54Bit1 = 0;
    @sysvar::SysVar_PROXI::pByte54Bit2 = 0;
    @sysvar::SysVar_PROXI::pByte54Bit3 = 0;
    @sysvar::SysVar_PROXI::pByte54Bit4 = 0;
    @sysvar::SysVar_PROXI::pByte54Bit5 = 0;
    @sysvar::SysVar_PROXI::pByte54Bit6 = 0;
    @sysvar::SysVar_PROXI::pByte54Bit7 = 0;
      
    @sysvar::SysVar_PROXI::pByte55Bit0 = 0;
    @sysvar::SysVar_PROXI::pByte55Bit1 = 0;
    @sysvar::SysVar_PROXI::pByte55Bit2 = 0;
    @sysvar::SysVar_PROXI::pByte55Bit3 = 0;
    @sysvar::SysVar_PROXI::pByte55Bit4 = 0;
    @sysvar::SysVar_PROXI::pByte55Bit5 = 0;
    @sysvar::SysVar_PROXI::pByte55Bit6 = 0;
    @sysvar::SysVar_PROXI::pByte55Bit7 = 0;
      
    @sysvar::SysVar_PROXI::pByte56Bit0 = 0;
    @sysvar::SysVar_PROXI::pByte56Bit1 = 0;
    @sysvar::SysVar_PROXI::pByte56Bit2 = 0;
    @sysvar::SysVar_PROXI::pByte56Bit3 = 0;
    @sysvar::SysVar_PROXI::pByte56Bit4 = 0;
    @sysvar::SysVar_PROXI::pByte56Bit5 = 0;
    @sysvar::SysVar_PROXI::pByte56Bit6 = 0;
    @sysvar::SysVar_PROXI::pByte56Bit7 = 0;
      
    @sysvar::SysVar_PROXI::pByte57Bit0 = 0;
    @sysvar::SysVar_PROXI::pByte57Bit1 = 0;
    @sysvar::SysVar_PROXI::pByte57Bit2 = 0;
    @sysvar::SysVar_PROXI::pByte57Bit3 = 0;
    @sysvar::SysVar_PROXI::pByte57Bit4 = 0;
    @sysvar::SysVar_PROXI::pByte57Bit5 = 0;
    @sysvar::SysVar_PROXI::pByte57Bit6 = 0;
    @sysvar::SysVar_PROXI::pByte57Bit7 = 0;
  }
}

on SysVar sysvar::SysVar_PROXI::DIAG_eEOLnode_set
{
  if(@this)
  {
    @sysvar::SysVar_PROXI::pByte42Bit0 = 1;
    @sysvar::SysVar_PROXI::pByte42Bit1 = 1;
    @sysvar::SysVar_PROXI::pByte42Bit2 = 1;
    @sysvar::SysVar_PROXI::pByte42Bit3 = 1;
    @sysvar::SysVar_PROXI::pByte42Bit4 = 1;
    @sysvar::SysVar_PROXI::pByte42Bit5 = 1;
    @sysvar::SysVar_PROXI::pByte42Bit6 = 1;
    @sysvar::SysVar_PROXI::pByte42Bit7 = 1;
      
    @sysvar::SysVar_PROXI::pByte43Bit0 = 1;
    @sysvar::SysVar_PROXI::pByte43Bit1 = 1;
    @sysvar::SysVar_PROXI::pByte43Bit2 = 1;
    @sysvar::SysVar_PROXI::pByte43Bit3 = 1;
    @sysvar::SysVar_PROXI::pByte43Bit4 = 1;
    @sysvar::SysVar_PROXI::pByte43Bit5 = 1;
    @sysvar::SysVar_PROXI::pByte43Bit6 = 1;
    @sysvar::SysVar_PROXI::pByte43Bit7 = 1;
              
    @sysvar::SysVar_PROXI::pByte44Bit0 = 1;
    @sysvar::SysVar_PROXI::pByte44Bit1 = 1;
    @sysvar::SysVar_PROXI::pByte44Bit2 = 1;
    @sysvar::SysVar_PROXI::pByte44Bit3 = 1;
    @sysvar::SysVar_PROXI::pByte44Bit4 = 1;
    @sysvar::SysVar_PROXI::pByte44Bit5 = 1;
    @sysvar::SysVar_PROXI::pByte44Bit6 = 1;
    @sysvar::SysVar_PROXI::pByte44Bit7 = 1;
              
    @sysvar::SysVar_PROXI::pByte45Bit0 = 1;
    @sysvar::SysVar_PROXI::pByte45Bit1 = 1;
    @sysvar::SysVar_PROXI::pByte45Bit2 = 1;
    @sysvar::SysVar_PROXI::pByte45Bit3 = 1;
    @sysvar::SysVar_PROXI::pByte45Bit4 = 1;
    @sysvar::SysVar_PROXI::pByte45Bit5 = 1;
    @sysvar::SysVar_PROXI::pByte45Bit6 = 1;
    @sysvar::SysVar_PROXI::pByte45Bit7 = 1;
      
    @sysvar::SysVar_PROXI::pByte46Bit0 = 1;
    @sysvar::SysVar_PROXI::pByte46Bit1 = 1;
    @sysvar::SysVar_PROXI::pByte46Bit2 = 1;
    @sysvar::SysVar_PROXI::pByte46Bit3 = 1;
    @sysvar::SysVar_PROXI::pByte46Bit4 = 1;
    @sysvar::SysVar_PROXI::pByte46Bit5 = 1;
    @sysvar::SysVar_PROXI::pByte46Bit6 = 1;
    @sysvar::SysVar_PROXI::pByte46Bit7 = 1;
              
    @sysvar::SysVar_PROXI::pByte47Bit0 = 1;
    @sysvar::SysVar_PROXI::pByte47Bit1 = 1;
    @sysvar::SysVar_PROXI::pByte47Bit2 = 1;
    @sysvar::SysVar_PROXI::pByte47Bit3 = 1;
    @sysvar::SysVar_PROXI::pByte47Bit4 = 1;
    @sysvar::SysVar_PROXI::pByte47Bit5 = 1;
    @sysvar::SysVar_PROXI::pByte47Bit6 = 1;
    @sysvar::SysVar_PROXI::pByte47Bit7 = 1;
      
    @sysvar::SysVar_PROXI::pByte48Bit0 = 1;
    @sysvar::SysVar_PROXI::pByte48Bit1 = 1;
    @sysvar::SysVar_PROXI::pByte48Bit2 = 1;
    @sysvar::SysVar_PROXI::pByte48Bit3 = 1;
    @sysvar::SysVar_PROXI::pByte48Bit4 = 1;
    @sysvar::SysVar_PROXI::pByte48Bit5 = 1;
    @sysvar::SysVar_PROXI::pByte48Bit6 = 1;
    @sysvar::SysVar_PROXI::pByte48Bit7 = 1;
      
    @sysvar::SysVar_PROXI::pByte49Bit0 = 1;
    @sysvar::SysVar_PROXI::pByte49Bit1 = 1;
    @sysvar::SysVar_PROXI::pByte49Bit2 = 1;
    @sysvar::SysVar_PROXI::pByte49Bit3 = 1;
    @sysvar::SysVar_PROXI::pByte49Bit4 = 1;
    @sysvar::SysVar_PROXI::pByte49Bit5 = 1;
    @sysvar::SysVar_PROXI::pByte49Bit6 = 1;
    @sysvar::SysVar_PROXI::pByte49Bit7 = 1;
              
    @sysvar::SysVar_PROXI::pByte50Bit0 = 1;
    @sysvar::SysVar_PROXI::pByte50Bit1 = 1;
    @sysvar::SysVar_PROXI::pByte50Bit2 = 1;
    @sysvar::SysVar_PROXI::pByte50Bit3 = 1;
    @sysvar::SysVar_PROXI::pByte50Bit4 = 1;
    @sysvar::SysVar_PROXI::pByte50Bit5 = 1;
    @sysvar::SysVar_PROXI::pByte50Bit6 = 1;
    @sysvar::SysVar_PROXI::pByte50Bit7 = 1;
              
    @sysvar::SysVar_PROXI::pByte51Bit0 = 1;
    @sysvar::SysVar_PROXI::pByte51Bit1 = 1;
    @sysvar::SysVar_PROXI::pByte51Bit2 = 1;
    @sysvar::SysVar_PROXI::pByte51Bit3 = 1;
    @sysvar::SysVar_PROXI::pByte51Bit4 = 1;
    @sysvar::SysVar_PROXI::pByte51Bit5 = 1;
    @sysvar::SysVar_PROXI::pByte51Bit6 = 1;
    @sysvar::SysVar_PROXI::pByte51Bit7 = 1;
      
    @sysvar::SysVar_PROXI::pByte52Bit0 = 1;
    @sysvar::SysVar_PROXI::pByte52Bit1 = 1;
    @sysvar::SysVar_PROXI::pByte52Bit2 = 1;
    @sysvar::SysVar_PROXI::pByte52Bit3 = 1;
    @sysvar::SysVar_PROXI::pByte52Bit4 = 1;
    @sysvar::SysVar_PROXI::pByte52Bit5 = 1;
    @sysvar::SysVar_PROXI::pByte52Bit6 = 1;
    @sysvar::SysVar_PROXI::pByte52Bit7 = 1;
              
    @sysvar::SysVar_PROXI::pByte53Bit0 = 1;
    @sysvar::SysVar_PROXI::pByte53Bit1 = 1;
    @sysvar::SysVar_PROXI::pByte53Bit2 = 1;
    @sysvar::SysVar_PROXI::pByte53Bit3 = 1;
    @sysvar::SysVar_PROXI::pByte53Bit4 = 1;
    @sysvar::SysVar_PROXI::pByte53Bit5 = 1;
    @sysvar::SysVar_PROXI::pByte53Bit6 = 1;
    @sysvar::SysVar_PROXI::pByte53Bit7 = 1;
                    
    @sysvar::SysVar_PROXI::pByte54Bit0 = 1;
    @sysvar::SysVar_PROXI::pByte54Bit1 = 1;
    @sysvar::SysVar_PROXI::pByte54Bit2 = 1;
    @sysvar::SysVar_PROXI::pByte54Bit3 = 1;
    @sysvar::SysVar_PROXI::pByte54Bit4 = 1;
    @sysvar::SysVar_PROXI::pByte54Bit5 = 1;
    @sysvar::SysVar_PROXI::pByte54Bit6 = 1;
    @sysvar::SysVar_PROXI::pByte54Bit7 = 1;
      
    @sysvar::SysVar_PROXI::pByte55Bit0 = 1;
    @sysvar::SysVar_PROXI::pByte55Bit1 = 1;
    @sysvar::SysVar_PROXI::pByte55Bit2 = 1;
    @sysvar::SysVar_PROXI::pByte55Bit3 = 1;
    @sysvar::SysVar_PROXI::pByte55Bit4 = 1;
    @sysvar::SysVar_PROXI::pByte55Bit5 = 1;
    @sysvar::SysVar_PROXI::pByte55Bit6 = 1;
    @sysvar::SysVar_PROXI::pByte55Bit7 = 1;
      
    @sysvar::SysVar_PROXI::pByte56Bit0 = 1;
    @sysvar::SysVar_PROXI::pByte56Bit1 = 1;
    @sysvar::SysVar_PROXI::pByte56Bit2 = 1;
    @sysvar::SysVar_PROXI::pByte56Bit3 = 1;
    @sysvar::SysVar_PROXI::pByte56Bit4 = 1;
    @sysvar::SysVar_PROXI::pByte56Bit5 = 1;
    @sysvar::SysVar_PROXI::pByte56Bit6 = 1;
    @sysvar::SysVar_PROXI::pByte56Bit7 = 1;
      
    @sysvar::SysVar_PROXI::pByte57Bit0 = 1;
    @sysvar::SysVar_PROXI::pByte57Bit1 = 1;
    @sysvar::SysVar_PROXI::pByte57Bit2 = 1;
    @sysvar::SysVar_PROXI::pByte57Bit3 = 1;
    @sysvar::SysVar_PROXI::pByte57Bit4 = 1;
    @sysvar::SysVar_PROXI::pByte57Bit5 = 1;
    @sysvar::SysVar_PROXI::pByte57Bit6 = 1;
    @sysvar::SysVar_PROXI::pByte57Bit7 = 1;   
  }
}

on SysVar sysvar::SysVar_PROXI::DIAG_eCANnode_load
{
  byte temp;
  int i;
  if(@this == 0)
  {
    sysGetVariableData(sysvar::SysVar_PROXI::DIAG_eProxiDataBuffer,PROXI_bDataBuffer,copiedbytes);

    temp = 0;
    temp |=  @sysvar::SysVar_PROXI::pByte26Bit0      ;
    temp |= (@sysvar::SysVar_PROXI::pByte26Bit1 << 1);
    temp |= (@sysvar::SysVar_PROXI::pByte26Bit2 << 2);
    temp |= (@sysvar::SysVar_PROXI::pByte26Bit3 << 3);
    temp |= (@sysvar::SysVar_PROXI::pByte26Bit4 << 4);
    temp |= (@sysvar::SysVar_PROXI::pByte26Bit5 << 5);
    temp |= (@sysvar::SysVar_PROXI::pByte26Bit6 << 6);
    temp |= (@sysvar::SysVar_PROXI::pByte26Bit7 << 7);
    PROXI_bDataBuffer[25] = temp;
    
    temp = 0;
    temp |=  @sysvar::SysVar_PROXI::pByte27Bit0      ;
    temp |= (@sysvar::SysVar_PROXI::pByte27Bit1 << 1);
    temp |= (@sysvar::SysVar_PROXI::pByte27Bit2 << 2);
    temp |= (@sysvar::SysVar_PROXI::pByte27Bit3 << 3);
    temp |= (@sysvar::SysVar_PROXI::pByte27Bit4 << 4);
    temp |= (@sysvar::SysVar_PROXI::pByte27Bit5 << 5);
    temp |= (@sysvar::SysVar_PROXI::pByte27Bit6 << 6);
    temp |= (@sysvar::SysVar_PROXI::pByte27Bit7 << 7);
    PROXI_bDataBuffer[26] = temp;
    
    temp = 0;
    temp |=  @sysvar::SysVar_PROXI::pByte28Bit0      ;
    temp |= (@sysvar::SysVar_PROXI::pByte28Bit1 << 1);
    temp |= (@sysvar::SysVar_PROXI::pByte28Bit2 << 2);
    temp |= (@sysvar::SysVar_PROXI::pByte28Bit3 << 3);
    temp |= (@sysvar::SysVar_PROXI::pByte28Bit4 << 4);
    temp |= (@sysvar::SysVar_PROXI::pByte28Bit5 << 5);
    temp |= (@sysvar::SysVar_PROXI::pByte28Bit6 << 6);
    temp |= (@sysvar::SysVar_PROXI::pByte28Bit7 << 7);
    PROXI_bDataBuffer[27] = temp;
    
    temp = 0;
    temp |=  @sysvar::SysVar_PROXI::pByte29Bit0      ;
    temp |= (@sysvar::SysVar_PROXI::pByte29Bit1 << 1);
    temp |= (@sysvar::SysVar_PROXI::pByte29Bit2 << 2);
    temp |= (@sysvar::SysVar_PROXI::pByte29Bit3 << 3);
    temp |= (@sysvar::SysVar_PROXI::pByte29Bit4 << 4);
    temp |= (@sysvar::SysVar_PROXI::pByte29Bit5 << 5);
    temp |= (@sysvar::SysVar_PROXI::pByte29Bit6 << 6);
    temp |= (@sysvar::SysVar_PROXI::pByte29Bit7 << 7);
    PROXI_bDataBuffer[28] = temp;
    
    temp = 0;
    temp |=  @sysvar::SysVar_PROXI::pByte30Bit0      ;
    temp |= (@sysvar::SysVar_PROXI::pByte30Bit1 << 1);
    temp |= (@sysvar::SysVar_PROXI::pByte30Bit2 << 2);
    temp |= (@sysvar::SysVar_PROXI::pByte30Bit3 << 3);
    temp |= (@sysvar::SysVar_PROXI::pByte30Bit4 << 4);
    temp |= (@sysvar::SysVar_PROXI::pByte30Bit5 << 5);
    temp |= (@sysvar::SysVar_PROXI::pByte30Bit6 << 6);
    temp |= (@sysvar::SysVar_PROXI::pByte30Bit7 << 7);
    PROXI_bDataBuffer[29] = temp;
    
    temp = 0;
    temp |=  @sysvar::SysVar_PROXI::pByte31Bit0      ;
    temp |= (@sysvar::SysVar_PROXI::pByte31Bit1 << 1);
    temp |= (@sysvar::SysVar_PROXI::pByte31Bit2 << 2);
    temp |= (@sysvar::SysVar_PROXI::pByte31Bit3 << 3);
    temp |= (@sysvar::SysVar_PROXI::pByte31Bit4 << 4);
    temp |= (@sysvar::SysVar_PROXI::pByte31Bit5 << 5);
    temp |= (@sysvar::SysVar_PROXI::pByte31Bit6 << 6);
    temp |= (@sysvar::SysVar_PROXI::pByte31Bit7 << 7);
    PROXI_bDataBuffer[30] = temp;
    
    temp = 0;
    temp |=  @sysvar::SysVar_PROXI::pByte32Bit0      ;
    temp |= (@sysvar::SysVar_PROXI::pByte32Bit1 << 1);
    temp |= (@sysvar::SysVar_PROXI::pByte32Bit2 << 2);
    temp |= (@sysvar::SysVar_PROXI::pByte32Bit3 << 3);
    temp |= (@sysvar::SysVar_PROXI::pByte32Bit4 << 4);
    temp |= (@sysvar::SysVar_PROXI::pByte32Bit5 << 5);
    temp |= (@sysvar::SysVar_PROXI::pByte32Bit6 << 6);
    temp |= (@sysvar::SysVar_PROXI::pByte32Bit7 << 7);
    PROXI_bDataBuffer[31] = temp;
              
    temp = 0;
    temp |=  @sysvar::SysVar_PROXI::pByte33Bit0      ;
    temp |= (@sysvar::SysVar_PROXI::pByte33Bit1 << 1);
    temp |= (@sysvar::SysVar_PROXI::pByte33Bit2 << 2);
    temp |= (@sysvar::SysVar_PROXI::pByte33Bit3 << 3);
    temp |= (@sysvar::SysVar_PROXI::pByte33Bit4 << 4);
    temp |= (@sysvar::SysVar_PROXI::pByte33Bit5 << 5);
    temp |= (@sysvar::SysVar_PROXI::pByte33Bit6 << 6);
    temp |= (@sysvar::SysVar_PROXI::pByte33Bit7 << 7);
    PROXI_bDataBuffer[32] = temp;
      
    temp = 0;
    temp |=  @sysvar::SysVar_PROXI::pByte34Bit0      ;
    temp |= (@sysvar::SysVar_PROXI::pByte34Bit1 << 1);
    temp |= (@sysvar::SysVar_PROXI::pByte34Bit2 << 2);
    temp |= (@sysvar::SysVar_PROXI::pByte34Bit3 << 3);
    temp |= (@sysvar::SysVar_PROXI::pByte34Bit4 << 4);
    temp |= (@sysvar::SysVar_PROXI::pByte34Bit5 << 5);
    temp |= (@sysvar::SysVar_PROXI::pByte34Bit6 << 6);
    temp |= (@sysvar::SysVar_PROXI::pByte34Bit7 << 7);
    PROXI_bDataBuffer[33] = temp;
    
    sysSetVariableData(sysvar::SysVar_PROXI::DIAG_eProxiDataBuffer, PROXI_bDataBuffer,copiedbytes);
  }
  sysSetVariableString(sysvar::SysVar_PROXI::DIAG_ePROXI_StatusBar, "");
  sysSetVariableString(sysvar::SysVar_PROXI::DIAG_ePROXI_StatusBar, "Loading PROXI Successful - CAN Configuration");
}

on SysVar sysvar::SysVar_PROXI::DIAG_eEOLnode_load
{
  byte temp;
  int i;
  if(@this == 0)
  {
    sysGetVariableData(sysvar::SysVar_PROXI::DIAG_eProxiDataBuffer,PROXI_bDataBuffer,copiedbytes);
        
    temp = 0;
    temp |=  @sysvar::SysVar_PROXI::pByte42Bit0      ;
    temp |= (@sysvar::SysVar_PROXI::pByte42Bit1 << 1);
    temp |= (@sysvar::SysVar_PROXI::pByte42Bit2 << 2);
    temp |= (@sysvar::SysVar_PROXI::pByte42Bit3 << 3);
    temp |= (@sysvar::SysVar_PROXI::pByte42Bit4 << 4);
    temp |= (@sysvar::SysVar_PROXI::pByte42Bit5 << 5);
    temp |= (@sysvar::SysVar_PROXI::pByte42Bit6 << 6);
    temp |= (@sysvar::SysVar_PROXI::pByte42Bit7 << 7);
    PROXI_bDataBuffer[41] = temp;
    
    temp = 0;
    temp |=  @sysvar::SysVar_PROXI::pByte43Bit0      ;
    temp |= (@sysvar::SysVar_PROXI::pByte43Bit1 << 1);
    temp |= (@sysvar::SysVar_PROXI::pByte43Bit2 << 2);
    temp |= (@sysvar::SysVar_PROXI::pByte43Bit3 << 3);
    temp |= (@sysvar::SysVar_PROXI::pByte43Bit4 << 4);
    temp |= (@sysvar::SysVar_PROXI::pByte43Bit5 << 5);
    temp |= (@sysvar::SysVar_PROXI::pByte43Bit6 << 6);
    temp |= (@sysvar::SysVar_PROXI::pByte43Bit7 << 7);
    PROXI_bDataBuffer[42] = temp;
    
    temp = 0;
    temp |=  @sysvar::SysVar_PROXI::pByte44Bit0      ;
    temp |= (@sysvar::SysVar_PROXI::pByte44Bit1 << 1);
    temp |= (@sysvar::SysVar_PROXI::pByte44Bit2 << 2);
    temp |= (@sysvar::SysVar_PROXI::pByte44Bit3 << 3);
    temp |= (@sysvar::SysVar_PROXI::pByte44Bit4 << 4);
    temp |= (@sysvar::SysVar_PROXI::pByte44Bit5 << 5);
    temp |= (@sysvar::SysVar_PROXI::pByte44Bit6 << 6);
    temp |= (@sysvar::SysVar_PROXI::pByte44Bit7 << 7);
    PROXI_bDataBuffer[43] = temp;
    
    temp = 0;
    temp |=  @sysvar::SysVar_PROXI::pByte45Bit0      ;
    temp |= (@sysvar::SysVar_PROXI::pByte45Bit1 << 1);
    temp |= (@sysvar::SysVar_PROXI::pByte45Bit2 << 2);
    temp |= (@sysvar::SysVar_PROXI::pByte45Bit3 << 3);
    temp |= (@sysvar::SysVar_PROXI::pByte45Bit4 << 4);
    temp |= (@sysvar::SysVar_PROXI::pByte45Bit5 << 5);
    temp |= (@sysvar::SysVar_PROXI::pByte45Bit6 << 6);
    temp |= (@sysvar::SysVar_PROXI::pByte45Bit7 << 7);
    PROXI_bDataBuffer[44] = temp;
    
    temp = 0;
    temp |=  @sysvar::SysVar_PROXI::pByte46Bit0      ;
    temp |= (@sysvar::SysVar_PROXI::pByte46Bit1 << 1);
    temp |= (@sysvar::SysVar_PROXI::pByte46Bit2 << 2);
    temp |= (@sysvar::SysVar_PROXI::pByte46Bit3 << 3);
    temp |= (@sysvar::SysVar_PROXI::pByte46Bit4 << 4);
    temp |= (@sysvar::SysVar_PROXI::pByte46Bit5 << 5);
    temp |= (@sysvar::SysVar_PROXI::pByte46Bit6 << 6);
    temp |= (@sysvar::SysVar_PROXI::pByte46Bit7 << 7);
    PROXI_bDataBuffer[45] = temp;
    
    temp = 0;
    temp |=  @sysvar::SysVar_PROXI::pByte47Bit0      ;
    temp |= (@sysvar::SysVar_PROXI::pByte47Bit1 << 1);
    temp |= (@sysvar::SysVar_PROXI::pByte47Bit2 << 2);
    temp |= (@sysvar::SysVar_PROXI::pByte47Bit3 << 3);
    temp |= (@sysvar::SysVar_PROXI::pByte47Bit4 << 4);
    temp |= (@sysvar::SysVar_PROXI::pByte47Bit5 << 5);
    temp |= (@sysvar::SysVar_PROXI::pByte47Bit6 << 6);
    temp |= (@sysvar::SysVar_PROXI::pByte47Bit7 << 7);
    PROXI_bDataBuffer[46] = temp;
    
    temp = 0;
    temp |=  @sysvar::SysVar_PROXI::pByte48Bit0      ;
    temp |= (@sysvar::SysVar_PROXI::pByte48Bit1 << 1);
    temp |= (@sysvar::SysVar_PROXI::pByte48Bit2 << 2);
    temp |= (@sysvar::SysVar_PROXI::pByte48Bit3 << 3);
    temp |= (@sysvar::SysVar_PROXI::pByte48Bit4 << 4);
    temp |= (@sysvar::SysVar_PROXI::pByte48Bit5 << 5);
    temp |= (@sysvar::SysVar_PROXI::pByte48Bit6 << 6);
    temp |= (@sysvar::SysVar_PROXI::pByte48Bit7 << 7);
    PROXI_bDataBuffer[47] = temp;
      
    temp = 0;
    temp |=  @sysvar::SysVar_PROXI::pByte49Bit0      ;
    temp |= (@sysvar::SysVar_PROXI::pByte49Bit1 << 1);
    temp |= (@sysvar::SysVar_PROXI::pByte49Bit2 << 2);
    temp |= (@sysvar::SysVar_PROXI::pByte49Bit3 << 3);
    temp |= (@sysvar::SysVar_PROXI::pByte49Bit4 << 4);
    temp |= (@sysvar::SysVar_PROXI::pByte49Bit5 << 5);
    temp |= (@sysvar::SysVar_PROXI::pByte49Bit6 << 6);
    temp |= (@sysvar::SysVar_PROXI::pByte49Bit7 << 7);
    PROXI_bDataBuffer[48] = temp;
    
    temp = 0;
    temp |=  @sysvar::SysVar_PROXI::pByte50Bit0      ;
    temp |= (@sysvar::SysVar_PROXI::pByte50Bit1 << 1);
    temp |= (@sysvar::SysVar_PROXI::pByte50Bit2 << 2);
    temp |= (@sysvar::SysVar_PROXI::pByte50Bit3 << 3);
    temp |= (@sysvar::SysVar_PROXI::pByte50Bit4 << 4);
    temp |= (@sysvar::SysVar_PROXI::pByte50Bit5 << 5);
    temp |= (@sysvar::SysVar_PROXI::pByte50Bit6 << 6);
    temp |= (@sysvar::SysVar_PROXI::pByte50Bit7 << 7);
    PROXI_bDataBuffer[49] = temp;
    
    sysSetVariableData(sysvar::SysVar_PROXI::DIAG_eProxiDataBuffer, PROXI_bDataBuffer,copiedbytes);
  }
  sysSetVariableString(sysvar::SysVar_PROXI::DIAG_ePROXI_StatusBar, "");
  sysSetVariableString(sysvar::SysVar_PROXI::DIAG_ePROXI_StatusBar, "Loading PROXI Successful - EOL Configuration");
}

on SysVar sysvar::SysVar_PROXI::DIAG_eIPC_panel_load
{
  sysSetVariableInt(sysvar::SysVar_PROXI::DIAG_eIPC_load,1);
  sysSetVariableInt(sysvar::SysVar_PROXI::DIAG_eIPC_load,0);
  sysSetVariableString(sysvar::SysVar_PROXI::DIAG_ePROXI_StatusBar, "");
  sysSetVariableString(sysvar::SysVar_PROXI::DIAG_ePROXI_StatusBar, "Loading PROXI Successful - Byte 58...");
}

on SysVar sysvar::SysVar_PROXI::DIAG_eIPC_load
{
  byte temp;
  int i;
  if(@this == 0)
  {
    sysGetVariableData(sysvar::SysVar_PROXI::DIAG_eProxiDataBuffer,PROXI_bDataBuffer,copiedbytes);
    
    temp = 0;
    temp  =  @sysvar::SysVar_PROXI::pByte58Bit0      ;
    temp |= (@sysvar::SysVar_PROXI::pByte58Bit1 << 1);
    temp |= (@sysvar::SysVar_PROXI::pByte58Bit2 << 2);
    temp |= (@sysvar::SysVar_PROXI::pByte58Bit3 << 3);
    temp |= (@sysvar::SysVar_PROXI::pByte58Bit4 << 4);
    temp |= (@sysvar::SysVar_PROXI::pByte58Bit5 << 5);
    temp |= (@sysvar::SysVar_PROXI::pByte58Bit6 << 6);
    temp |= (@sysvar::SysVar_PROXI::pByte58Bit7 << 7);
    PROXI_bDataBuffer[57] = temp;
    
    temp = 0;
    temp  =  @sysvar::SysVar_PROXI::pByte59Bit0      ;
    temp |= (@sysvar::SysVar_PROXI::pByte59Bit1 << 1);
    temp |= (@sysvar::SysVar_PROXI::pByte59Bit2 << 2);
    temp |= (@sysvar::SysVar_PROXI::pByte59Bit3 << 3);
    temp |= (@sysvar::SysVar_PROXI::pByte59Bit4 << 4);
    temp |= (@sysvar::SysVar_PROXI::pByte59Bit5 << 5);
    temp |= (@sysvar::SysVar_PROXI::pByte59Bit6 << 6);
    temp |= (@sysvar::SysVar_PROXI::pByte59Bit7 << 7);
    PROXI_bDataBuffer[58] = temp;
    
    temp = 0;
    temp  =  @sysvar::SysVar_PROXI::pByte60Bit0      ;
    temp |= (@sysvar::SysVar_PROXI::pByte60Bit1 << 1);
    temp |= (@sysvar::SysVar_PROXI::pByte60Bit2 << 2);
    temp |= (@sysvar::SysVar_PROXI::pByte60Bit3 << 3);
    temp |= (@sysvar::SysVar_PROXI::pByte60Bit4 << 4);
    temp |= (@sysvar::SysVar_PROXI::pByte60Bit5 << 5);
    temp |= (@sysvar::SysVar_PROXI::pByte60Bit6 << 6);
    temp |= (@sysvar::SysVar_PROXI::pByte60Bit7 << 7);
    PROXI_bDataBuffer[59] = temp;
    
    temp = 0;
//    temp  =  @sysvar::SysVar_PROXI::pByte61Bit0      ;
//    temp |= (@sysvar::SysVar_PROXI::pByte61Bit1 << 1);
//    temp |= (@sysvar::SysVar_PROXI::pByte61Bit2 << 2);
    temp  =  @sysvar::SysVar_PROXI::pByte61Bit012;
    temp |= (@sysvar::SysVar_PROXI::pByte61Bit3 << 3);
    temp |= (@sysvar::SysVar_PROXI::pByte61Bit4 << 4);
    temp |= (@sysvar::SysVar_PROXI::pByte61Bit5 << 5);
    temp |= (@sysvar::SysVar_PROXI::pByte61Bit6 << 6);
    temp |= (@sysvar::SysVar_PROXI::pByte61Bit7 << 7);
    PROXI_bDataBuffer[60] = temp;
    
    temp = 0;
    temp  =  @sysvar::SysVar_PROXI::pByte62Bit0      ;
    temp |= (@sysvar::SysVar_PROXI::pByte62Bit1 << 1);
    temp |= (@sysvar::SysVar_PROXI::pByte62Bit2 << 2);
    temp |= (@sysvar::SysVar_PROXI::pByte62Bit3 << 3);
    temp |= (@sysvar::SysVar_PROXI::pByte62Bit4 << 4);
    temp |= (@sysvar::SysVar_PROXI::pByte62Bit5 << 5);
    temp |= (@sysvar::SysVar_PROXI::pByte62Bit6 << 6);
    temp |= (@sysvar::SysVar_PROXI::pByte62Bit7 << 7);
    PROXI_bDataBuffer[61] = temp;
    
    temp = 0;
    temp  =  @sysvar::SysVar_PROXI::pByte63Bit0      ;
    temp |= (@sysvar::SysVar_PROXI::pByte63Bit1 << 1);
    temp |= (@sysvar::SysVar_PROXI::pByte63Bit2 << 2);
    temp |= (@sysvar::SysVar_PROXI::pByte63Bit3 << 3);
//    temp |= (@sysvar::SysVar_PROXI::pByte63Bit4 << 4);
//    temp |= (@sysvar::SysVar_PROXI::pByte63Bit5 << 5);
//    temp |= (@sysvar::SysVar_PROXI::pByte63Bit6 << 6);
    temp |= (@sysvar::SysVar_PROXI::pByte63bit456 << 4);
    temp |= (@sysvar::SysVar_PROXI::pByte63Bit7 << 7);
    PROXI_bDataBuffer[62] = temp;
      
    temp = 0;
    temp  =  @sysvar::SysVar_PROXI::pByte64Bit0      ;
    temp |= (@sysvar::SysVar_PROXI::pByte64Bit1 << 1);
    temp |= (@sysvar::SysVar_PROXI::pByte64Bit2 << 2);
    temp |= (@sysvar::SysVar_PROXI::pByte64Bit3 << 3);
    temp |= (@sysvar::SysVar_PROXI::pByte64Bit4 << 4);
    temp |= (@sysvar::SysVar_PROXI::pByte64Bit5 << 5);
    temp |= (@sysvar::SysVar_PROXI::pByte64Bit6 << 6);
    temp |= (@sysvar::SysVar_PROXI::pByte64Bit7 << 7);
    PROXI_bDataBuffer[63] = temp;
    
    temp = 0;
    temp  =  @sysvar::SysVar_PROXI::pByte65Bit0      ;
    temp |= (@sysvar::SysVar_PROXI::pByte65Bit1 << 1);
    temp |= (@sysvar::SysVar_PROXI::pByte65Bit2 << 2);
    temp |= (@sysvar::SysVar_PROXI::pByte65Bit3 << 3);
    temp |= (@sysvar::SysVar_PROXI::pByte65Bit4 << 4);
    temp |= (@sysvar::SysVar_PROXI::pByte65Bit5 << 5);
    temp |= (@sysvar::SysVar_PROXI::pByte65Bit6 << 6);
    temp |= (@sysvar::SysVar_PROXI::pByte65Bit7 << 7);
    PROXI_bDataBuffer[64] = temp;
      
    temp = 0;
    temp  =  @sysvar::SysVar_PROXI::pByte66Bit0      ;
    temp |= (@sysvar::SysVar_PROXI::pByte66Bit1 << 1);
    temp |= (@sysvar::SysVar_PROXI::pByte66Bit2 << 2);
    temp |= (@sysvar::SysVar_PROXI::pByte66Bit3 << 3);
//    temp |= (@sysvar::SysVar_PROXI::pByte66Bit4 << 4);
//    temp |= (@sysvar::SysVar_PROXI::pByte66Bit5 << 5);
//    temp |= (@sysvar::SysVar_PROXI::pByte66Bit6 << 6);
//    temp |= (@sysvar::SysVar_PROXI::pByte66Bit7 << 7);
    temp |= (@sysvar::SysVar_PROXI::pByte66Bit4567 << 4);
    PROXI_bDataBuffer[65] = temp;
    
    temp = 0;
//    temp  =  @sysvar::SysVar_PROXI::pByte67Bit0      ;
//    temp |= (@sysvar::SysVar_PROXI::pByte67Bit1 << 1);
//    temp |= (@sysvar::SysVar_PROXI::pByte67Bit2 << 2);
//    temp |= (@sysvar::SysVar_PROXI::pByte67Bit3 << 3);
//    temp |= (@sysvar::SysVar_PROXI::pByte67Bit4 << 4);
//    temp |= (@sysvar::SysVar_PROXI::pByte67Bit5 << 5);
//    temp |= (@sysvar::SysVar_PROXI::pByte67Bit6 << 6);
//    temp |= (@sysvar::SysVar_PROXI::pByte67Bit7 << 7);
    @sysvar::SysVar_PROXI::pByte67 = @sysvar::SysVar_PROXI::pByte67A - 9;
    temp = @sysvar::SysVar_PROXI::pByte67;
    PROXI_bDataBuffer[66] = temp;
    
    temp = 0;
//    temp  =  @sysvar::SysVar_PROXI::pByte68Bit0      ;
//    temp |= (@sysvar::SysVar_PROXI::pByte68Bit1 << 1);
//    temp |= (@sysvar::SysVar_PROXI::pByte68Bit2 << 2);
//    temp |= (@sysvar::SysVar_PROXI::pByte68Bit3 << 3);
//    temp |= (@sysvar::SysVar_PROXI::pByte68Bit4 << 4);
    temp |=  @sysvar::SysVar_PROXI::pByte68Bit01234  ;
    temp |= (@sysvar::SysVar_PROXI::pByte68Bit5 << 5);
    temp |= (@sysvar::SysVar_PROXI::pByte68Bit6 << 6);
    temp |= (@sysvar::SysVar_PROXI::pByte68Bit7 << 7);
    PROXI_bDataBuffer[67] = temp;
      
    temp = 0;
//  temp  =  @sysvar::SysVar_PROXI::pByte69Bit0       ;
//  temp |= (@sysvar::SysVar_PROXI::pByte69Bit1  << 1);
    temp  = @sysvar::SysVar_PROXI::pByte69Bit01       ;
    temp |= (@sysvar::SysVar_PROXI::pByte69Bit2  << 2);
//  temp |= (@sysvar::SysVar_PROXI::pByte69Bit3  << 3);
//  temp |= (@sysvar::SysVar_PROXI::pByte69Bit4  << 4);
    temp |= (@sysvar::SysVar_PROXI::pByte69Bit34 << 3);
    temp |= (@sysvar::SysVar_PROXI::pByte69Bit5  << 5);
    temp |= (@sysvar::SysVar_PROXI::pByte69Bit6  << 6);
    temp |= (@sysvar::SysVar_PROXI::pByte69Bit7  << 7);
    PROXI_bDataBuffer[68] = temp;
    
    temp = 0;
    temp  =  @sysvar::SysVar_PROXI::pByte70Bit0      ;
    temp |= (@sysvar::SysVar_PROXI::pByte70Bit1 << 1);
//    temp |= (@sysvar::SysVar_PROXI::pByte70Bit2 << 2);
//    temp |= (@sysvar::SysVar_PROXI::pByte70Bit3 << 3);
    temp |= (@sysvar::SysVar_PROXI::pByte70Bit23 << 2);
    temp |= (@sysvar::SysVar_PROXI::pByte70Bit4 << 4);
    temp |= (@sysvar::SysVar_PROXI::pByte70Bit5 << 5);
    temp |= (@sysvar::SysVar_PROXI::pByte70Bit6 << 6);
    temp |= (@sysvar::SysVar_PROXI::pByte70Bit7 << 7);
    PROXI_bDataBuffer[69] = temp;
    
    temp = 0;
    temp  =  @sysvar::SysVar_PROXI::pByte71Bit0      ;
    temp |= (@sysvar::SysVar_PROXI::pByte71Bit1 << 1);
    temp |= (@sysvar::SysVar_PROXI::pByte71Bit2 << 2);
    temp |= (@sysvar::SysVar_PROXI::pByte71Bit3 << 3);
    temp |= (@sysvar::SysVar_PROXI::pByte71Bit4 << 4);
    temp |= (@sysvar::SysVar_PROXI::pByte71Bit5 << 5);
    temp |= (@sysvar::SysVar_PROXI::pByte71Bit6 << 6);
    temp |= (@sysvar::SysVar_PROXI::pByte71Bit7 << 7);
    PROXI_bDataBuffer[70] = temp;
    
    temp = 0;
    temp  =  @sysvar::SysVar_PROXI::pByte72Bit0      ;
    temp |= (@sysvar::SysVar_PROXI::pByte72Bit1 << 1);
    temp |= (@sysvar::SysVar_PROXI::pByte72Bit2 << 2);
    temp |= (@sysvar::SysVar_PROXI::pByte72Bit3 << 3);
    temp |= (@sysvar::SysVar_PROXI::pByte72Bit4 << 4);
    temp |= (@sysvar::SysVar_PROXI::pByte72Bit5 << 5);
    temp |= (@sysvar::SysVar_PROXI::pByte72Bit6 << 6);
    temp |= (@sysvar::SysVar_PROXI::pByte72Bit7 << 7);
    PROXI_bDataBuffer[71] = temp;
    
    temp = 0;
//    temp  =  @sysvar::SysVar_PROXI::pByte73Bit0      ;
//    temp |= (@sysvar::SysVar_PROXI::pByte73Bit1 << 1);
//    temp |= (@sysvar::SysVar_PROXI::pByte73Bit2 << 2);
//    temp |= (@sysvar::SysVar_PROXI::pByte73Bit3 << 3);
//    temp |= (@sysvar::SysVar_PROXI::pByte73Bit4 << 4);
//    temp |= (@sysvar::SysVar_PROXI::pByte73Bit5 << 5);
//    temp |= (@sysvar::SysVar_PROXI::pByte73Bit6 << 6);
//    temp |= (@sysvar::SysVar_PROXI::pByte73Bit7 << 7);
    temp = @sysvar::SysVar_PROXI::pByte73;
    PROXI_bDataBuffer[72] = temp;
    
    temp = 0;
    temp  =  @sysvar::SysVar_PROXI::pByte74Bit0      ;
    temp |= (@sysvar::SysVar_PROXI::pByte74Bit1 << 1);
    temp |= (@sysvar::SysVar_PROXI::pByte74Bit2 << 2);
    temp |= (@sysvar::SysVar_PROXI::pByte74Bit3 << 3);
//    temp |= (@sysvar::SysVar_PROXI::pByte74Bit4 << 4);
//    temp |= (@sysvar::SysVar_PROXI::pByte74Bit5 << 5);
//    temp |= (@sysvar::SysVar_PROXI::pByte74Bit6 << 6);
//    temp |= (@sysvar::SysVar_PROXI::pByte74Bit7 << 7);
    temp |= (@sysvar::SysVar_PROXI::pByte74Bit4567 << 4);
    PROXI_bDataBuffer[73] = temp;
          
    temp = 0;
//    temp  =  @sysvar::SysVar_PROXI::pByte75Bit0      ;
//    temp |= (@sysvar::SysVar_PROXI::pByte75Bit1 << 1);
//    temp |= (@sysvar::SysVar_PROXI::pByte75Bit2 << 2);
//    temp |= (@sysvar::SysVar_PROXI::pByte75Bit3 << 3);
//    temp |= (@sysvar::SysVar_PROXI::pByte75Bit4 << 4);
//    temp |= (@sysvar::SysVar_PROXI::pByte75Bit5 << 5);
//    temp |= (@sysvar::SysVar_PROXI::pByte75Bit6 << 6);
//    temp |= (@sysvar::SysVar_PROXI::pByte75Bit7 << 7);
    temp = @sysvar::SysVar_PROXI::pByte75;
    PROXI_bDataBuffer[74] = temp;
      
    temp = 0;
    temp  =  @sysvar::SysVar_PROXI::pByte76Bit0      ;
    temp |= (@sysvar::SysVar_PROXI::pByte76Bit1 << 1);
    temp |= (@sysvar::SysVar_PROXI::pByte76Bit2 << 2);
    temp |= (@sysvar::SysVar_PROXI::pByte76Bit3 << 3);
//    temp |= (@sysvar::SysVar_PROXI::pByte76Bit4 << 4);
//    temp |= (@sysvar::SysVar_PROXI::pByte76Bit5 << 5);
//    temp |= (@sysvar::SysVar_PROXI::pByte76Bit6 << 6);
//    temp |= (@sysvar::SysVar_PROXI::pByte76Bit7 << 7);
    temp |= (@sysvar::SysVar_PROXI::pByte76Bit4567 << 4);
    PROXI_bDataBuffer[75] = temp;
      
    temp = 0;
    temp  =  @sysvar::SysVar_PROXI::pByte77Bit0      ;
    temp |= (@sysvar::SysVar_PROXI::pByte77Bit1 << 1);
    temp |= (@sysvar::SysVar_PROXI::pByte77Bit2 << 2);
    temp |= (@sysvar::SysVar_PROXI::pByte77Bit3 << 3);
    temp |= (@sysvar::SysVar_PROXI::pByte77Bit4 << 4);
    temp |= (@sysvar::SysVar_PROXI::pByte77Bit5 << 5);
    temp |= (@sysvar::SysVar_PROXI::pByte77Bit6 << 6);
    temp |= (@sysvar::SysVar_PROXI::pByte77Bit7 << 7);
    PROXI_bDataBuffer[76] = temp;
    
    temp = 0;
    temp  =  @sysvar::SysVar_PROXI::pByte78Bit0      ;
    temp |= (@sysvar::SysVar_PROXI::pByte78Bit1 << 1);
    temp |= (@sysvar::SysVar_PROXI::pByte78Bit2 << 2);
//    temp |= (@sysvar::SysVar_PROXI::pByte78Bit3 << 3);
//    temp |= (@sysvar::SysVar_PROXI::pByte78Bit4 << 4);
    temp |= (@sysvar::SysVar_PROXI::pByte78Bit34 << 3);
    temp |= (@sysvar::SysVar_PROXI::pByte78Bit5 << 5);
    temp |= (@sysvar::SysVar_PROXI::pByte78Bit6 << 6);
    temp |= (@sysvar::SysVar_PROXI::pByte78Bit7 << 7);
    PROXI_bDataBuffer[77] = temp;
      
    temp = 0;
    temp  =  @sysvar::SysVar_PROXI::pByte79Bit0      ;
    temp |= (@sysvar::SysVar_PROXI::pByte79Bit1 << 1);
//    temp |= (@sysvar::SysVar_PROXI::pByte79Bit2 << 2);
//    temp |= (@sysvar::SysVar_PROXI::pByte79Bit3 << 3);
    temp |= (@sysvar::SysVar_PROXI::pByte79Bit23 << 2);
    temp |= (@sysvar::SysVar_PROXI::pByte79Bit4 << 4);
    temp |= (@sysvar::SysVar_PROXI::pByte79Bit5 << 5);
    temp |= (@sysvar::SysVar_PROXI::pByte79Bit6 << 6);
    temp |= (@sysvar::SysVar_PROXI::pByte79Bit7 << 7);
    PROXI_bDataBuffer[78] = temp;
      
       temp = 0;
    temp  =  @sysvar::SysVar_PROXI::pByte80Bit0      ;
    temp |= (@sysvar::SysVar_PROXI::pByte80Bit1 << 1);
    temp |= (@sysvar::SysVar_PROXI::pByte80Bit2 << 2);
    temp |= (@sysvar::SysVar_PROXI::pByte80Bit3 << 3);
    temp |= (@sysvar::SysVar_PROXI::pByte80Bit4 << 4);
    temp |= (@sysvar::SysVar_PROXI::pByte80Bit5 << 5);
    temp |= (@sysvar::SysVar_PROXI::pByte80Bit6 << 6);
    temp |= (@sysvar::SysVar_PROXI::pByte80Bit7 << 7);
    PROXI_bDataBuffer[79] = temp;
      
    temp = 0;
    temp  =  @sysvar::SysVar_PROXI::pByte81Bit0      ;
    temp |= (@sysvar::SysVar_PROXI::pByte81Bit1 << 1);
    temp |= (@sysvar::SysVar_PROXI::pByte81Bit2 << 2);
    temp |= (@sysvar::SysVar_PROXI::pByte81Bit3 << 3);
    temp |= (@sysvar::SysVar_PROXI::pByte81Bit4 << 4);
    temp |= (@sysvar::SysVar_PROXI::pByte81Bit5 << 5);
    temp |= (@sysvar::SysVar_PROXI::pByte81Bit6 << 6);
    temp |= (@sysvar::SysVar_PROXI::pByte81Bit7 << 7);
    PROXI_bDataBuffer[80] = temp;
      
    temp = 0;
    temp  =  @sysvar::SysVar_PROXI::pByte82Bit0      ;
    temp |= (@sysvar::SysVar_PROXI::pByte82Bit1 << 1);
    temp |= (@sysvar::SysVar_PROXI::pByte82Bit2 << 2);
    temp |= (@sysvar::SysVar_PROXI::pByte82Bit3 << 3);
    temp |= (@sysvar::SysVar_PROXI::pByte82Bit4 << 4);
    temp |= (@sysvar::SysVar_PROXI::pByte82Bit5 << 5);
    temp |= (@sysvar::SysVar_PROXI::pByte82Bit6 << 6);
    temp |= (@sysvar::SysVar_PROXI::pByte82Bit7 << 7);
    PROXI_bDataBuffer[81] = temp;
      
    temp = 0;
    temp  =  @sysvar::SysVar_PROXI::pByte83Bit0      ;
    temp |= (@sysvar::SysVar_PROXI::pByte83Bit1 << 1);
    temp |= (@sysvar::SysVar_PROXI::pByte83Bit2 << 2);
    temp |= (@sysvar::SysVar_PROXI::pByte83Bit3 << 3);
    temp |= (@sysvar::SysVar_PROXI::pByte83Bit4 << 4);
    temp |= (@sysvar::SysVar_PROXI::pByte83Bit5 << 5);
    temp |= (@sysvar::SysVar_PROXI::pByte83Bit6 << 6);
    temp |= (@sysvar::SysVar_PROXI::pByte83Bit7 << 7);
    PROXI_bDataBuffer[82] = temp;
      
    temp = 0;
    temp  =  @sysvar::SysVar_PROXI::pByte84Bit0      ;
    temp |= (@sysvar::SysVar_PROXI::pByte84Bit1 << 1);
    temp |= (@sysvar::SysVar_PROXI::pByte84Bit2 << 2);
    temp |= (@sysvar::SysVar_PROXI::pByte84Bit3 << 3);
    temp |= (@sysvar::SysVar_PROXI::pByte84Bit4 << 4);
    temp |= (@sysvar::SysVar_PROXI::pByte84Bit5 << 5);
    temp |= (@sysvar::SysVar_PROXI::pByte84Bit6 << 6);
    temp |= (@sysvar::SysVar_PROXI::pByte84Bit7 << 7);
    PROXI_bDataBuffer[83] = temp;
    
    temp = 0;
    temp  =  @sysvar::SysVar_PROXI::pByte85Bit0      ;
    temp |= (@sysvar::SysVar_PROXI::pByte85Bit1 << 1);
    temp |= (@sysvar::SysVar_PROXI::pByte85Bit2 << 2);
    temp |= (@sysvar::SysVar_PROXI::pByte85Bit3 << 3);
    temp |= (@sysvar::SysVar_PROXI::pByte85Bit4 << 4);
    temp |= (@sysvar::SysVar_PROXI::pByte85Bit5 << 5);
    temp |= (@sysvar::SysVar_PROXI::pByte85Bit6 << 6);
    temp |= (@sysvar::SysVar_PROXI::pByte85Bit7 << 7);
    PROXI_bDataBuffer[84] = temp;
      
    temp = 0;
    temp  =  @sysvar::SysVar_PROXI::pByte86Bit0      ;
//    temp |= (@sysvar::SysVar_PROXI::pByte86Bit1 << 1);
//    temp |= (@sysvar::SysVar_PROXI::pByte86Bit2 << 2);
    temp |= @sysvar::SysVar_PROXI::pByte86Bit12 << 1;
//    temp |= (@sysvar::SysVar_PROXI::pByte86Bit3 << 3);
//    temp |= (@sysvar::SysVar_PROXI::pByte86Bit4 << 4);
    temp |= @sysvar::SysVar_PROXI::pByte86Bit34 << 3;
    temp |= (@sysvar::SysVar_PROXI::pByte86Bit5 << 5);
    temp |= (@sysvar::SysVar_PROXI::pByte86Bit6 << 6);
    temp |= (@sysvar::SysVar_PROXI::pByte86Bit7 << 7);
    PROXI_bDataBuffer[85] = temp;
      
    temp = 0;
//    temp  =  @sysvar::SysVar_PROXI::pByte87Bit0      ;
//    temp |= (@sysvar::SysVar_PROXI::pByte87Bit1 << 1);
//    temp |= (@sysvar::SysVar_PROXI::pByte87Bit2 << 2);
    temp |= @sysvar::SysVar_PROXI::pByte87Bit012     ;
    temp |= (@sysvar::SysVar_PROXI::pByte87Bit3 << 3);
    temp |= (@sysvar::SysVar_PROXI::pByte87Bit4 << 4);
    temp |= (@sysvar::SysVar_PROXI::pByte87Bit5 << 5);
    temp |= (@sysvar::SysVar_PROXI::pByte87Bit6 << 6);
    temp |= (@sysvar::SysVar_PROXI::pByte87Bit7 << 7);
    PROXI_bDataBuffer[86] = temp;
      
    temp = 0;
//    temp  =  @sysvar::SysVar_PROXI::pByte88Bit0      ;
//    temp |= (@sysvar::SysVar_PROXI::pByte88Bit1 << 1);
    temp |= @sysvar::SysVar_PROXI::pByte88Bit01      ;
    temp |= (@sysvar::SysVar_PROXI::pByte88Bit2 << 2);
    temp |= (@sysvar::SysVar_PROXI::pByte88Bit3 << 3);
    temp |= (@sysvar::SysVar_PROXI::pByte88Bit4 << 4);
//    temp |= (@sysvar::SysVar_PROXI::pByte88Bit5 << 5);
//    temp |= (@sysvar::SysVar_PROXI::pByte88Bit6 << 6);
    temp |= @sysvar::SysVar_PROXI::pByte88Bit56 << 5;
    temp |= (@sysvar::SysVar_PROXI::pByte88Bit7 << 7);
    PROXI_bDataBuffer[87] = temp;
      
    temp = 0;
    temp  =  @sysvar::SysVar_PROXI::pByte89Bit0      ;
    temp |= (@sysvar::SysVar_PROXI::pByte89Bit1 << 1);
    temp |= (@sysvar::SysVar_PROXI::pByte89Bit2 << 2);
    temp |= (@sysvar::SysVar_PROXI::pByte89Bit3 << 3);
    temp |= (@sysvar::SysVar_PROXI::pByte89Bit4 << 4);
    temp |= (@sysvar::SysVar_PROXI::pByte89Bit5 << 5);
    temp |= (@sysvar::SysVar_PROXI::pByte89Bit6 << 6);
    temp |= (@sysvar::SysVar_PROXI::pByte89Bit7 << 7);
    PROXI_bDataBuffer[88] = temp;
      
    temp = 0;
    temp  =  @sysvar::SysVar_PROXI::pByte90Bit0      ;
    temp |= (@sysvar::SysVar_PROXI::pByte90Bit1 << 1);
    temp |= (@sysvar::SysVar_PROXI::pByte90Bit2 << 2);
    temp |= (@sysvar::SysVar_PROXI::pByte90Bit3 << 3);
    temp |= (@sysvar::SysVar_PROXI::pByte90Bit4 << 4);
    temp |= (@sysvar::SysVar_PROXI::pByte90Bit5 << 5);
    temp |= (@sysvar::SysVar_PROXI::pByte90Bit6 << 6);
    temp |= (@sysvar::SysVar_PROXI::pByte90Bit7 << 7);
    PROXI_bDataBuffer[89] = temp;
      
    temp = 0;
    temp  =  @sysvar::SysVar_PROXI::pByte91Bit0      ;
    temp |= (@sysvar::SysVar_PROXI::pByte91Bit1 << 1);
    temp |= (@sysvar::SysVar_PROXI::pByte91Bit2 << 2);
    temp |= (@sysvar::SysVar_PROXI::pByte91Bit3 << 3);
    temp |= (@sysvar::SysVar_PROXI::pByte91Bit4 << 4);
//    temp |= (@sysvar::SysVar_PROXI::pByte91Bit5 << 5);
//    temp |= (@sysvar::SysVar_PROXI::pByte91Bit6 << 6);
//    temp |= (@sysvar::SysVar_PROXI::pByte91Bit7 << 7);
    temp |= (@sysvar::SysVar_PROXI::pByte91Bit567 << 5);
    PROXI_bDataBuffer[90] = temp;
      
    temp = 0;
    temp  =  @sysvar::SysVar_PROXI::pByte92Bit0      ;
    temp |= (@sysvar::SysVar_PROXI::pByte92Bit1 << 1);
    temp |= (@sysvar::SysVar_PROXI::pByte92Bit2 << 2);
    temp |= (@sysvar::SysVar_PROXI::pByte92Bit3 << 3);
    temp |= (@sysvar::SysVar_PROXI::pByte92Bit4 << 4);
    temp |= (@sysvar::SysVar_PROXI::pByte92Bit5 << 5);
    temp |= (@sysvar::SysVar_PROXI::pByte92Bit6 << 6);
    temp |= (@sysvar::SysVar_PROXI::pByte92Bit7 << 7);
    PROXI_bDataBuffer[91] = temp;
      
    temp = 0;
    temp  =  @sysvar::SysVar_PROXI::pByte93Bit0      ;
    temp |= (@sysvar::SysVar_PROXI::pByte93Bit1 << 1);
    temp |= (@sysvar::SysVar_PROXI::pByte93Bit2 << 2);
    temp |= (@sysvar::SysVar_PROXI::pByte93Bit3 << 3);
    temp |= (@sysvar::SysVar_PROXI::pByte93Bit4 << 4);
    temp |= (@sysvar::SysVar_PROXI::pByte93Bit5 << 5);
    temp |= (@sysvar::SysVar_PROXI::pByte93Bit6 << 6);
    temp |= (@sysvar::SysVar_PROXI::pByte93Bit7 << 7);
    PROXI_bDataBuffer[92] = temp;
      
    temp = 0;
    temp  =  @sysvar::SysVar_PROXI::pByte94Bit0      ;
    temp |= (@sysvar::SysVar_PROXI::pByte94Bit1 << 1);
    temp |= (@sysvar::SysVar_PROXI::pByte94Bit2 << 2);
    temp |= (@sysvar::SysVar_PROXI::pByte94Bit3 << 3);
    temp |= (@sysvar::SysVar_PROXI::pByte94Bit4 << 4);
    temp |= (@sysvar::SysVar_PROXI::pByte94Bit5 << 5);
    temp |= (@sysvar::SysVar_PROXI::pByte94Bit6 << 6);
    temp |= (@sysvar::SysVar_PROXI::pByte94Bit7 << 7);
    PROXI_bDataBuffer[93] = temp;
      
    temp = 0;
//    temp  =  @sysvar::SysVar_PROXI::pByte95Bit0      ;
//    temp |= (@sysvar::SysVar_PROXI::pByte95Bit1 << 1);
//    temp |= (@sysvar::SysVar_PROXI::pByte95Bit2 << 2);
//    temp |= (@sysvar::SysVar_PROXI::pByte95Bit3 << 3);
//    temp |= (@sysvar::SysVar_PROXI::pByte95Bit4 << 4);
    temp |=  @sysvar::SysVar_PROXI::pByte95Bit01234  ;
    temp |= (@sysvar::SysVar_PROXI::pByte95Bit5 << 5);
    temp |= (@sysvar::SysVar_PROXI::pByte95Bit6 << 6);
    temp |= (@sysvar::SysVar_PROXI::pByte95Bit7 << 7);
    PROXI_bDataBuffer[94] = temp;
      
    temp = 0;
    temp  =  @sysvar::SysVar_PROXI::pByte96Bit0      ;
    temp |= (@sysvar::SysVar_PROXI::pByte96Bit1 << 1);
    temp |= (@sysvar::SysVar_PROXI::pByte96Bit2 << 2);
    temp |= (@sysvar::SysVar_PROXI::pByte96Bit3 << 3);
    temp |= (@sysvar::SysVar_PROXI::pByte96Bit4 << 4);
    temp |= (@sysvar::SysVar_PROXI::pByte96Bit5 << 5);
    temp |= (@sysvar::SysVar_PROXI::pByte96Bit6 << 6);
    temp |= (@sysvar::SysVar_PROXI::pByte96Bit7 << 7);
    PROXI_bDataBuffer[95] = temp;
      
    temp = 0;
    temp  =  @sysvar::SysVar_PROXI::pByte97Bit0      ;
    temp |= (@sysvar::SysVar_PROXI::pByte97Bit1 << 1);
    temp |= (@sysvar::SysVar_PROXI::pByte97Bit2 << 2);
    temp |= (@sysvar::SysVar_PROXI::pByte97Bit3 << 3);
    temp |= (@sysvar::SysVar_PROXI::pByte97Bit4 << 4);
    temp |= (@sysvar::SysVar_PROXI::pByte97Bit5 << 5);
    temp |= (@sysvar::SysVar_PROXI::pByte97Bit6 << 6);
    temp |= (@sysvar::SysVar_PROXI::pByte97Bit7 << 7);
    PROXI_bDataBuffer[96] = temp;
      
    temp = 0;
    temp  =  @sysvar::SysVar_PROXI::pByte98Bit0      ;
    temp |= (@sysvar::SysVar_PROXI::pByte98Bit1 << 1);
    temp |= (@sysvar::SysVar_PROXI::pByte98Bit2 << 2);
    temp |= (@sysvar::SysVar_PROXI::pByte98Bit3 << 3);
    temp |= (@sysvar::SysVar_PROXI::pByte98Bit4 << 4);
    temp |= (@sysvar::SysVar_PROXI::pByte98Bit5 << 5);
    temp |= (@sysvar::SysVar_PROXI::pByte98Bit6 << 6);
    temp |= (@sysvar::SysVar_PROXI::pByte98Bit7 << 7);
    PROXI_bDataBuffer[97] = temp;
       
    temp = 0;
    temp  =  @sysvar::SysVar_PROXI::pByte99Bit0      ;
    temp |= (@sysvar::SysVar_PROXI::pByte99Bit1 << 1);
    temp |= (@sysvar::SysVar_PROXI::pByte99Bit2 << 2);
    temp |= (@sysvar::SysVar_PROXI::pByte99Bit3 << 3);
    temp |= (@sysvar::SysVar_PROXI::pByte99Bit4 << 4);
    temp |= (@sysvar::SysVar_PROXI::pByte99Bit5 << 5);
    temp |= (@sysvar::SysVar_PROXI::pByte99Bit6 << 6);
    temp |= (@sysvar::SysVar_PROXI::pByte99Bit7 << 7);
    PROXI_bDataBuffer[98] = temp;
      
    temp = 0;
    temp  =  @sysvar::SysVar_PROXI::pByte100Bit0      ;
    temp |= (@sysvar::SysVar_PROXI::pByte100Bit1 << 1);
    temp |= (@sysvar::SysVar_PROXI::pByte100Bit2 << 2);
//    temp |= (@sysvar::SysVar_PROXI::pByte100Bit3 << 3);
//    temp |= (@sysvar::SysVar_PROXI::pByte100Bit4 << 4);
//    temp |= (@sysvar::SysVar_PROXI::pByte100Bit5 << 5);
//    temp |= (@sysvar::SysVar_PROXI::pByte100Bit6 << 6);
//    temp |= (@sysvar::SysVar_PROXI::pByte100Bit7 << 7);
    temp |= (@sysvar::SysVar_PROXI::pByte100Bit34567 << 3);
    PROXI_bDataBuffer[99] = temp;
      
    temp = 0;
//    temp  =  @sysvar::SysVar_PROXI::pByte101Bit0      ;
//    temp |= (@sysvar::SysVar_PROXI::pByte101Bit1 << 1);
//    temp |= (@sysvar::SysVar_PROXI::pByte101Bit2 << 2);
    temp = @sysvar::SysVar_PROXI::pByte101Bit012;
//    temp |= (@sysvar::SysVar_PROXI::pByte101Bit3 << 3);
//    temp |= (@sysvar::SysVar_PROXI::pByte101Bit4 << 4);
    temp |= (@sysvar::SysVar_PROXI::pByte101Bit34 << 3);
    temp |= (@sysvar::SysVar_PROXI::pByte101Bit5 << 5);
    temp |= (@sysvar::SysVar_PROXI::pByte101Bit6 << 6);
    temp |= (@sysvar::SysVar_PROXI::pByte101Bit7 << 7);
    PROXI_bDataBuffer[100] = temp;
      
    temp = 0;
    temp  =  @sysvar::SysVar_PROXI::pByte102Bit0      ;
    temp |= (@sysvar::SysVar_PROXI::pByte102Bit1 << 1);
    temp |= (@sysvar::SysVar_PROXI::pByte102Bit2 << 2);
    temp |= (@sysvar::SysVar_PROXI::pByte102Bit3 << 3);
    temp |= (@sysvar::SysVar_PROXI::pByte102Bit4 << 4);
    temp |= (@sysvar::SysVar_PROXI::pByte102Bit5 << 5);
    temp |= (@sysvar::SysVar_PROXI::pByte102Bit6 << 6);
    temp |= (@sysvar::SysVar_PROXI::pByte102Bit7 << 7);
    PROXI_bDataBuffer[101] = temp;
    
    temp = 0;
    temp  =  @sysvar::SysVar_PROXI::pByte103Bit0      ;
    temp |= (@sysvar::SysVar_PROXI::pByte103Bit1 << 1);
    temp |= (@sysvar::SysVar_PROXI::pByte103Bit2 << 2);
    temp |= (@sysvar::SysVar_PROXI::pByte103Bit3 << 3);
    temp |= (@sysvar::SysVar_PROXI::pByte103Bit4 << 4);
    temp |= (@sysvar::SysVar_PROXI::pByte103Bit5 << 5);
    temp |= (@sysvar::SysVar_PROXI::pByte103Bit6 << 6);
    temp |= (@sysvar::SysVar_PROXI::pByte103Bit7 << 7);
    PROXI_bDataBuffer[102] = temp;
      
    temp = 0;
    temp  =  @sysvar::SysVar_PROXI::pByte104Bit0      ;
    temp |= (@sysvar::SysVar_PROXI::pByte104Bit1 << 1);
    temp |= (@sysvar::SysVar_PROXI::pByte104Bit2 << 2);
    temp |= (@sysvar::SysVar_PROXI::pByte104Bit3 << 3);
    temp |= (@sysvar::SysVar_PROXI::pByte104Bit4 << 4);
    temp |= (@sysvar::SysVar_PROXI::pByte104Bit5 << 5);
    temp |= (@sysvar::SysVar_PROXI::pByte104Bit6 << 6);
    temp |= (@sysvar::SysVar_PROXI::pByte104Bit7 << 7);
    PROXI_bDataBuffer[103] = temp;
    
    temp = 0;
    temp  =  @sysvar::SysVar_PROXI::pByte105;
//    temp  =  @sysvar::SysVar_PROXI::pByte105Bit0      ;
//    temp |= (@sysvar::SysVar_PROXI::pByte105Bit1 << 1);
//    temp |= (@sysvar::SysVar_PROXI::pByte105Bit2 << 2);
//    temp |= (@sysvar::SysVar_PROXI::pByte105Bit3 << 3);
//    temp |= (@sysvar::SysVar_PROXI::pByte105Bit4 << 4);
//    temp |= (@sysvar::SysVar_PROXI::pByte105Bit5 << 5);
//    temp |= (@sysvar::SysVar_PROXI::pByte105Bit6 << 6);
//    temp |= (@sysvar::SysVar_PROXI::pByte105Bit7 << 7);
    PROXI_bDataBuffer[104] = temp;
    
    temp = 0;
    temp  =  @sysvar::SysVar_PROXI::pByte106;
//    temp  =  @sysvar::SysVar_PROXI::pByte106Bit0      ;
//    temp |= (@sysvar::SysVar_PROXI::pByte106Bit1 << 1);
//    temp |= (@sysvar::SysVar_PROXI::pByte106Bit2 << 2);
//    temp |= (@sysvar::SysVar_PROXI::pByte106Bit3 << 3);
//    temp |= (@sysvar::SysVar_PROXI::pByte106Bit4 << 4);
//    temp |= (@sysvar::SysVar_PROXI::pByte106Bit5 << 5);
//    temp |= (@sysvar::SysVar_PROXI::pByte106Bit6 << 6);
//    temp |= (@sysvar::SysVar_PROXI::pByte106Bit7 << 7);
    PROXI_bDataBuffer[105] = temp;
    
    temp = 0;
//    temp  =  @sysvar::SysVar_PROXI::pByte107Bit0      ;
//    temp |= (@sysvar::SysVar_PROXI::pByte107Bit1 << 1);
//    temp |= (@sysvar::SysVar_PROXI::pByte107Bit2 << 2);
//    temp |= (@sysvar::SysVar_PROXI::pByte107Bit3 << 3);
//    temp |= (@sysvar::SysVar_PROXI::pByte107Bit4 << 4);
//    temp |= (@sysvar::SysVar_PROXI::pByte107Bit5 << 5);
//    temp |= (@sysvar::SysVar_PROXI::pByte107Bit6 << 6);
//    temp |= (@sysvar::SysVar_PROXI::pByte107Bit7 << 7);
    temp = @sysvar::SysVar_PROXI::pByte107;
    PROXI_bDataBuffer[106] = temp;
    
    temp = 0;
    temp  =  @sysvar::SysVar_PROXI::pByte108Bit0      ;
    temp |= (@sysvar::SysVar_PROXI::pByte108Bit1 << 1);
    temp |= (@sysvar::SysVar_PROXI::pByte108Bit2 << 2);
    temp |= (@sysvar::SysVar_PROXI::pByte108Bit3 << 3);
    temp |= (@sysvar::SysVar_PROXI::pByte108Bit4 << 4);
    temp |= (@sysvar::SysVar_PROXI::pByte108Bit5 << 5);
    temp |= (@sysvar::SysVar_PROXI::pByte108Bit6 << 6);
    temp |= (@sysvar::SysVar_PROXI::pByte108Bit7 << 7);
    PROXI_bDataBuffer[107] = temp;
    
    temp = 0;
    temp  =  @sysvar::SysVar_PROXI::pByte109Bit0      ;
    temp |= (@sysvar::SysVar_PROXI::pByte109Bit1 << 1);
    temp |= (@sysvar::SysVar_PROXI::pByte109Bit2 << 2);
    temp |= (@sysvar::SysVar_PROXI::pByte109Bit3 << 3);
    temp |= (@sysvar::SysVar_PROXI::pByte109Bit4 << 4);
    temp |= (@sysvar::SysVar_PROXI::pByte109Bit5 << 5);
    temp |= (@sysvar::SysVar_PROXI::pByte109Bit6 << 6);
    temp |= (@sysvar::SysVar_PROXI::pByte109Bit7 << 7);
    PROXI_bDataBuffer[108] = temp;
      
    temp = 0;
    temp  =  @sysvar::SysVar_PROXI::pByte110Bit0      ;
    temp |= (@sysvar::SysVar_PROXI::pByte110Bit1 << 1);
    temp |= (@sysvar::SysVar_PROXI::pByte110Bit2 << 2);
    temp |= (@sysvar::SysVar_PROXI::pByte110Bit3 << 3);
    temp |= (@sysvar::SysVar_PROXI::pByte110Bit4 << 4);
    temp |= (@sysvar::SysVar_PROXI::pByte110Bit5 << 5);
    temp |= (@sysvar::SysVar_PROXI::pByte110Bit6 << 6);
    temp |= (@sysvar::SysVar_PROXI::pByte110Bit7 << 7);
    PROXI_bDataBuffer[109] = temp;
      
    temp = 0;
//    temp  =  @sysvar::SysVar_PROXI::pByte111Bit0      ;
//    temp |= (@sysvar::SysVar_PROXI::pByte111Bit1 << 1);
//    temp |= (@sysvar::SysVar_PROXI::pByte111Bit2 << 2);
//    temp |= (@sysvar::SysVar_PROXI::pByte111Bit3 << 3);
    temp  =  @sysvar::SysVar_PROXI::pByte111Bit0123;
//    temp |= (@sysvar::SysVar_PROXI::pByte111Bit4 << 4);
//    temp |= (@sysvar::SysVar_PROXI::pByte111Bit5 << 5);
//    temp |= (@sysvar::SysVar_PROXI::pByte111Bit6 << 6);
    temp |= (@sysvar::SysVar_PROXI::pByte111Bit456 << 4);
    temp |= (@sysvar::SysVar_PROXI::pByte111Bit7 << 7);
    PROXI_bDataBuffer[110] = temp;
      
    temp = 0;
    temp  =  @sysvar::SysVar_PROXI::pByte112Bit0      ;
    temp |= (@sysvar::SysVar_PROXI::pByte112Bit1 << 1);
    temp |= (@sysvar::SysVar_PROXI::pByte112Bit2 << 2);
    temp |= (@sysvar::SysVar_PROXI::pByte112Bit3 << 3);
//    temp |= (@sysvar::SysVar_PROXI::pByte112Bit4 << 4);
//    temp |= (@sysvar::SysVar_PROXI::pByte112Bit5 << 5);
//    temp |= (@sysvar::SysVar_PROXI::pByte112Bit6 << 6);
    temp |= (@sysvar::SysVar_PROXI::pByte112Bit456 << 4);
    temp |= (@sysvar::SysVar_PROXI::pByte112Bit7 << 7);
    PROXI_bDataBuffer[111] = temp;
      
    temp = 0;
    temp  =  @sysvar::SysVar_PROXI::pByte113Bit0      ;
    temp |= (@sysvar::SysVar_PROXI::pByte113Bit1 << 1);
    temp |= (@sysvar::SysVar_PROXI::pByte113Bit2 << 2);
    temp |= (@sysvar::SysVar_PROXI::pByte113Bit3 << 3);
    temp |= (@sysvar::SysVar_PROXI::pByte113Bit4 << 4);
    temp |= (@sysvar::SysVar_PROXI::pByte113Bit5 << 5);
    temp |= (@sysvar::SysVar_PROXI::pByte113Bit6 << 6);
    temp |= (@sysvar::SysVar_PROXI::pByte113Bit7 << 7);
    PROXI_bDataBuffer[112] = temp;
      
    temp = 0;
    temp  =  @sysvar::SysVar_PROXI::pByte114Bit0      ;
    temp |= (@sysvar::SysVar_PROXI::pByte114Bit1 << 1);
    temp |= (@sysvar::SysVar_PROXI::pByte114Bit2 << 2);
    temp |= (@sysvar::SysVar_PROXI::pByte114Bit3 << 3);
    temp |= (@sysvar::SysVar_PROXI::pByte114Bit4 << 4);
    temp |= (@sysvar::SysVar_PROXI::pByte114Bit5 << 5);
    temp |= (@sysvar::SysVar_PROXI::pByte114Bit6 << 6);
    temp |= (@sysvar::SysVar_PROXI::pByte114Bit7 << 7);
    PROXI_bDataBuffer[113] = temp;
           
    temp = 0;
    temp  =  @sysvar::SysVar_PROXI::pByte115Bit0      ;
    temp |= (@sysvar::SysVar_PROXI::pByte115Bit1 << 1);
    temp |= (@sysvar::SysVar_PROXI::pByte115Bit2 << 2);
    temp |= (@sysvar::SysVar_PROXI::pByte115Bit3 << 3);
    temp |= (@sysvar::SysVar_PROXI::pByte115Bit4 << 4);
    temp |= (@sysvar::SysVar_PROXI::pByte115Bit5 << 5);
    temp |= (@sysvar::SysVar_PROXI::pByte115Bit6 << 6);
    temp |= (@sysvar::SysVar_PROXI::pByte115Bit7 << 7);
    PROXI_bDataBuffer[114] = temp;
    
    temp = 0;
    temp  =  @sysvar::SysVar_PROXI::pByte116Bit0      ;
    temp |= (@sysvar::SysVar_PROXI::pByte116Bit1 << 1);
    temp |= (@sysvar::SysVar_PROXI::pByte116Bit2 << 2);
    temp |= (@sysvar::SysVar_PROXI::pByte116Bit3 << 3);
    temp |= (@sysvar::SysVar_PROXI::pByte116Bit4 << 4);
    temp |= (@sysvar::SysVar_PROXI::pByte116Bit5 << 5);
    temp |= (@sysvar::SysVar_PROXI::pByte116Bit6 << 6);
    temp |= (@sysvar::SysVar_PROXI::pByte116Bit7 << 7);
    PROXI_bDataBuffer[115] = temp;
    
    temp = 0;
    temp  =  @sysvar::SysVar_PROXI::pByte117Bit0      ;
    temp |= (@sysvar::SysVar_PROXI::pByte117Bit1 << 1);
    temp |= (@sysvar::SysVar_PROXI::pByte117Bit2 << 2);
    temp |= (@sysvar::SysVar_PROXI::pByte117Bit3 << 3);
//    temp |= (@sysvar::SysVar_PROXI::pByte117Bit4 << 4);
//    temp |= (@sysvar::SysVar_PROXI::pByte117Bit5 << 5);
//    temp |= (@sysvar::SysVar_PROXI::pByte117Bit6 << 6);
//    @sysvar::SysVar_PROXI::pByte117Bit456 = @sysvar::SysVar_PROXI::pByte117Bit456A;
    temp |= (@sysvar::SysVar_PROXI::pByte117Bit456 << 4);
    temp |= (@sysvar::SysVar_PROXI::pByte117Bit7 << 7);
    PROXI_bDataBuffer[116] = temp;
    
    temp = 0;
    temp  =  @sysvar::SysVar_PROXI::pByte118Bit0      ;
    temp |= (@sysvar::SysVar_PROXI::pByte118Bit1 << 1);
    temp |= (@sysvar::SysVar_PROXI::pByte118Bit2 << 2);
    temp |= (@sysvar::SysVar_PROXI::pByte118Bit3 << 3);
//    temp |= (@sysvar::SysVar_PROXI::pByte118Bit4 << 4);
//    temp |= (@sysvar::SysVar_PROXI::pByte118Bit5 << 5);
    temp |= (@sysvar::SysVar_PROXI::pByte118Bit45 << 4);
    temp |= (@sysvar::SysVar_PROXI::pByte118Bit6 << 6);
    temp |= (@sysvar::SysVar_PROXI::pByte118Bit7 << 7);
    PROXI_bDataBuffer[117] = temp;
    
    temp = 0;
    temp  =  @sysvar::SysVar_PROXI::pByte119Bit0      ;
    temp |= (@sysvar::SysVar_PROXI::pByte119Bit1 << 1);
    temp |= (@sysvar::SysVar_PROXI::pByte119Bit2 << 2);
    temp |= (@sysvar::SysVar_PROXI::pByte119Bit3 << 3);
    temp |= (@sysvar::SysVar_PROXI::pByte119Bit4 << 4);
    temp |= (@sysvar::SysVar_PROXI::pByte119Bit5 << 5);
    temp |= (@sysvar::SysVar_PROXI::pByte119Bit6 << 6);
    temp |= (@sysvar::SysVar_PROXI::pByte119Bit7 << 7);
    PROXI_bDataBuffer[118] = temp;
    
    temp = 0;
//    temp  =  @sysvar::SysVar_PROXI::pByte120Bit0      ;
//    temp |= (@sysvar::SysVar_PROXI::pByte120Bit1 << 1);
//    temp |= (@sysvar::SysVar_PROXI::pByte120Bit2 << 2);
//    temp |= (@sysvar::SysVar_PROXI::pByte120Bit3 << 3);
//    temp |= (@sysvar::SysVar_PROXI::pByte120Bit4 << 4);
//    temp |= (@sysvar::SysVar_PROXI::pByte120Bit5 << 5);
//    temp |= (@sysvar::SysVar_PROXI::pByte120Bit6 << 6);
//    temp |= (@sysvar::SysVar_PROXI::pByte120Bit7 << 7);
      temp = @sysvar::SysVar_PROXI::pByte120;
    PROXI_bDataBuffer[119] = temp;
    
    temp = 0;
//    temp  =  @sysvar::SysVar_PROXI::pByte121Bit0      ;
//    temp |= (@sysvar::SysVar_PROXI::pByte121Bit1 << 1);
    temp  =  @sysvar::SysVar_PROXI::pByte121Bit01;
    temp |= (@sysvar::SysVar_PROXI::pByte121Bit2 << 2);
    temp |= (@sysvar::SysVar_PROXI::pByte121Bit3 << 3);
    temp |= (@sysvar::SysVar_PROXI::pByte121Bit4 << 4);
    temp |= (@sysvar::SysVar_PROXI::pByte121Bit5 << 5);
    temp |= (@sysvar::SysVar_PROXI::pByte121Bit6 << 6);
    temp |= (@sysvar::SysVar_PROXI::pByte121Bit7 << 7);
    PROXI_bDataBuffer[120] = temp;
          
    temp = 0;
    temp  =  @sysvar::SysVar_PROXI::pByte122Bit0      ;
    temp |= (@sysvar::SysVar_PROXI::pByte122Bit1 << 1);
    temp |= (@sysvar::SysVar_PROXI::pByte122Bit2 << 2);
    temp |= (@sysvar::SysVar_PROXI::pByte122Bit3 << 3);
    temp |= (@sysvar::SysVar_PROXI::pByte122Bit4 << 4);
    temp |= (@sysvar::SysVar_PROXI::pByte122Bit5 << 5);
    temp |= (@sysvar::SysVar_PROXI::pByte122Bit6 << 6);
    temp |= (@sysvar::SysVar_PROXI::pByte122Bit7 << 7);
    PROXI_bDataBuffer[121] = temp;
          
    temp = 0;
    temp  =  @sysvar::SysVar_PROXI::pByte123Bit0      ;
    temp |= (@sysvar::SysVar_PROXI::pByte123Bit1 << 1);
    temp |= (@sysvar::SysVar_PROXI::pByte123Bit2 << 2);
    temp |= (@sysvar::SysVar_PROXI::pByte123Bit3 << 3);
    temp |= (@sysvar::SysVar_PROXI::pByte123Bit4 << 4);
    temp |= (@sysvar::SysVar_PROXI::pByte123Bit5 << 5);
    temp |= (@sysvar::SysVar_PROXI::pByte123Bit6 << 6);
    temp |= (@sysvar::SysVar_PROXI::pByte123Bit7 << 7);
    PROXI_bDataBuffer[122] = temp;
          
    temp = 0;
    temp  =  @sysvar::SysVar_PROXI::pByte124Bit0      ;
    temp |= (@sysvar::SysVar_PROXI::pByte124Bit1 << 1);
    temp |= (@sysvar::SysVar_PROXI::pByte124Bit2 << 2);
    temp |= (@sysvar::SysVar_PROXI::pByte124Bit3 << 3);
    temp |= (@sysvar::SysVar_PROXI::pByte124Bit4 << 4);
    temp |= (@sysvar::SysVar_PROXI::pByte124Bit5 << 5);
    temp |= (@sysvar::SysVar_PROXI::pByte124Bit6 << 6);
    temp |= (@sysvar::SysVar_PROXI::pByte124Bit7 << 7);
    PROXI_bDataBuffer[123] = temp;
          
    temp = 0;
    temp = @sysvar::SysVar_PROXI::pByte125;
//    temp  =  @sysvar::SysVar_PROXI::pByte125Bit0      ;
//    temp |= (@sysvar::SysVar_PROXI::pByte125Bit1 << 1);
//    temp |= (@sysvar::SysVar_PROXI::pByte125Bit2 << 2);
//    temp |= (@sysvar::SysVar_PROXI::pByte125Bit3 << 3);
//    temp |= (@sysvar::SysVar_PROXI::pByte125Bit4 << 4);
//    temp |= (@sysvar::SysVar_PROXI::pByte125Bit5 << 5);
//    temp |= (@sysvar::SysVar_PROXI::pByte125Bit6 << 6);
//    temp |= (@sysvar::SysVar_PROXI::pByte125Bit7 << 7);
    PROXI_bDataBuffer[124] = temp;
      
    temp = 0;
    temp  =  @sysvar::SysVar_PROXI::pByte126Bit0      ;
//    temp |= (@sysvar::SysVar_PROXI::pByte126Bit1 << 1);
//    temp |= (@sysvar::SysVar_PROXI::pByte126Bit2 << 2);
    temp |= (@sysvar::SysVar_PROXI::pByte126Bit12 << 1);
//    temp |= (@sysvar::SysVar_PROXI::pByte126Bit3 << 3);
//    temp |= (@sysvar::SysVar_PROXI::pByte126Bit4 << 4);
    temp |= (@sysvar::SysVar_PROXI::pByte126Bit34 << 3);
    temp |= (@sysvar::SysVar_PROXI::pByte126Bit5 << 5);
    temp |= (@sysvar::SysVar_PROXI::pByte126Bit6 << 6);
    temp |= (@sysvar::SysVar_PROXI::pByte126Bit7 << 7);
    PROXI_bDataBuffer[125] = temp;
          
    temp = 0;
    temp  =  @sysvar::SysVar_PROXI::pByte127Bit0      ;
    temp |= (@sysvar::SysVar_PROXI::pByte127Bit1 << 1);
    temp |= (@sysvar::SysVar_PROXI::pByte127Bit2 << 2);
    temp |= (@sysvar::SysVar_PROXI::pByte127Bit3 << 3);
    temp |= (@sysvar::SysVar_PROXI::pByte127Bit4 << 4);
    temp |= (@sysvar::SysVar_PROXI::pByte127Bit5 << 5);
    temp |= (@sysvar::SysVar_PROXI::pByte127Bit6 << 6);
    temp |= (@sysvar::SysVar_PROXI::pByte127Bit7 << 7);
    PROXI_bDataBuffer[126] = temp;
      
    temp = 0;
//    temp  =  @sysvar::SysVar_PROXI::pByte128Bit0      ;
//    temp |= (@sysvar::SysVar_PROXI::pByte128Bit1 << 1);
//    temp |= (@sysvar::SysVar_PROXI::pByte128Bit2 << 2);
//    temp |= (@sysvar::SysVar_PROXI::pByte128Bit3 << 3);
//    temp |= (@sysvar::SysVar_PROXI::pByte128Bit4 << 4);
//    temp |= (@sysvar::SysVar_PROXI::pByte128Bit5 << 5);
//    temp |= (@sysvar::SysVar_PROXI::pByte128Bit6 << 6);
//    temp |= (@sysvar::SysVar_PROXI::pByte128Bit7 << 7);
    temp = @sysvar::SysVar_PROXI::pByte128;
    PROXI_bDataBuffer[127] = temp;
      
    temp = 0;
    temp  =  @sysvar::SysVar_PROXI::pByte129Bit0      ;
    temp |= (@sysvar::SysVar_PROXI::pByte129Bit1 << 1);
    temp |= (@sysvar::SysVar_PROXI::pByte129Bit2 << 2);
    temp |= (@sysvar::SysVar_PROXI::pByte129Bit3 << 3);
    temp |= (@sysvar::SysVar_PROXI::pByte129Bit4 << 4);
    temp |= (@sysvar::SysVar_PROXI::pByte129Bit5 << 5);
    temp |= (@sysvar::SysVar_PROXI::pByte129Bit6 << 6);
    temp |= (@sysvar::SysVar_PROXI::pByte129Bit7 << 7);
    PROXI_bDataBuffer[128] = temp;
      
    temp = 0;
    temp  =  @sysvar::SysVar_PROXI::pByte130Bit0      ;
    temp |= (@sysvar::SysVar_PROXI::pByte130Bit1 << 1);
    temp |= (@sysvar::SysVar_PROXI::pByte130Bit2 << 2);
    temp |= (@sysvar::SysVar_PROXI::pByte130Bit3 << 3);
    temp |= (@sysvar::SysVar_PROXI::pByte130Bit4 << 4);
    temp |= (@sysvar::SysVar_PROXI::pByte130Bit5 << 5);
  //  temp |= (@sysvar::SysVar_PROXI::pByte130Bit6 << 6);
  //  temp |= (@sysvar::SysVar_PROXI::pByte130Bit7 << 7);
    temp |= (@sysvar::SysVar_PROXI::pByte130Bit67 << 6);
    PROXI_bDataBuffer[129] = temp;
           
    temp = 0;
    temp  =  @sysvar::SysVar_PROXI::pByte131Bit0      ;
    temp |= (@sysvar::SysVar_PROXI::pByte131Bit1 << 1);
    temp |= (@sysvar::SysVar_PROXI::pByte131Bit2 << 2);
    temp |= (@sysvar::SysVar_PROXI::pByte131Bit3 << 3);
    temp |= (@sysvar::SysVar_PROXI::pByte131Bit4 << 4);
    temp |= (@sysvar::SysVar_PROXI::pByte131Bit5 << 5);
    temp |= (@sysvar::SysVar_PROXI::pByte131Bit6 << 6);
    temp |= (@sysvar::SysVar_PROXI::pByte131Bit7 << 7);
    PROXI_bDataBuffer[130] = temp;
    
    temp = 0;
    temp  =  @sysvar::SysVar_PROXI::pByte132Bit0      ;
    temp |= (@sysvar::SysVar_PROXI::pByte132Bit1 << 1);
    temp |= (@sysvar::SysVar_PROXI::pByte132Bit2 << 2);
    temp |= (@sysvar::SysVar_PROXI::pByte132Bit3 << 3);
    temp |= (@sysvar::SysVar_PROXI::pByte132Bit4 << 4);
    temp |= (@sysvar::SysVar_PROXI::pByte132Bit5 << 5);
    temp |= (@sysvar::SysVar_PROXI::pByte132Bit6 << 6);
    temp |= (@sysvar::SysVar_PROXI::pByte132Bit7 << 7);
    PROXI_bDataBuffer[131] = temp;
      
    temp = 0;
    temp  =  @sysvar::SysVar_PROXI::pByte133Bit0      ;
    temp |= (@sysvar::SysVar_PROXI::pByte133Bit1 << 1);
    temp |= (@sysvar::SysVar_PROXI::pByte133Bit2 << 2);
    temp |= (@sysvar::SysVar_PROXI::pByte133Bit3 << 3);
    temp |= (@sysvar::SysVar_PROXI::pByte133Bit4 << 4);
//    temp |= (@sysvar::SysVar_PROXI::pByte133Bit5 << 5);
//    temp |= (@sysvar::SysVar_PROXI::pByte133Bit6 << 6);
    temp |= (@sysvar::SysVar_PROXI::pByte133Bit56 << 5);
    temp |= (@sysvar::SysVar_PROXI::pByte133Bit7 << 7);
    PROXI_bDataBuffer[132] = temp;
      
    temp = 0;
//    temp  =  @sysvar::SysVar_PROXI::pByte134Bit0      ;
//    temp |= (@sysvar::SysVar_PROXI::pByte134Bit1 << 1);
    temp  =  @sysvar::SysVar_PROXI::pByte134Bit01;
    temp |= (@sysvar::SysVar_PROXI::pByte134Bit2 << 2);
    temp |= (@sysvar::SysVar_PROXI::pByte134Bit3 << 3);
    temp |= (@sysvar::SysVar_PROXI::pByte134Bit4 << 4);
    temp |= (@sysvar::SysVar_PROXI::pByte134Bit5 << 5);
    temp |= (@sysvar::SysVar_PROXI::pByte134Bit6 << 6);
    temp |= (@sysvar::SysVar_PROXI::pByte134Bit7 << 7);
    PROXI_bDataBuffer[133] = temp;
    
    temp = 0;
    temp  =  @sysvar::SysVar_PROXI::pByte135Bit0      ;
    temp |= (@sysvar::SysVar_PROXI::pByte135Bit1 << 1);
    temp |= (@sysvar::SysVar_PROXI::pByte135Bit2 << 2);
    temp |= (@sysvar::SysVar_PROXI::pByte135Bit3 << 3);
    temp |= (@sysvar::SysVar_PROXI::pByte135Bit4 << 4);
    temp |= (@sysvar::SysVar_PROXI::pByte135Bit5 << 5);
    temp |= (@sysvar::SysVar_PROXI::pByte135Bit6 << 6);
    temp |= (@sysvar::SysVar_PROXI::pByte135Bit7 << 7);
    PROXI_bDataBuffer[134] = temp;
      
    temp = 0;
    temp  =  @sysvar::SysVar_PROXI::pByte136Bit0      ;
    temp |= (@sysvar::SysVar_PROXI::pByte136Bit1 << 1);
    temp |= (@sysvar::SysVar_PROXI::pByte136Bit2 << 2);
    temp |= (@sysvar::SysVar_PROXI::pByte136Bit3 << 3);
    temp |= (@sysvar::SysVar_PROXI::pByte136Bit4 << 4);
    temp |= (@sysvar::SysVar_PROXI::pByte136Bit5 << 5);
    temp |= (@sysvar::SysVar_PROXI::pByte136Bit6 << 6);
    temp |= (@sysvar::SysVar_PROXI::pByte136Bit7 << 7);
    PROXI_bDataBuffer[135] = temp;
      
    temp = 0;
    temp  =  @sysvar::SysVar_PROXI::pByte137Bit0      ;
    temp |= (@sysvar::SysVar_PROXI::pByte137Bit1 << 1);
    temp |= (@sysvar::SysVar_PROXI::pByte137Bit2 << 2);
//    temp |= (@sysvar::SysVar_PROXI::pByte137Bit3 << 3);
//    temp |= (@sysvar::SysVar_PROXI::pByte137Bit4 << 4);
//    temp |= (@sysvar::SysVar_PROXI::pByte137Bit5 << 5);
//    temp |= (@sysvar::SysVar_PROXI::pByte137Bit6 << 6);
//    temp |= (@sysvar::SysVar_PROXI::pByte137Bit7 << 7);
//    temp = @sysvar::SysVar_PROXI::pByte137;
    temp |= (((@sysvar::SysVar_PROXI::pByte137Bit34567-700)/50) << 3);
    PROXI_bDataBuffer[136] = temp;
      
    temp = 0;
    temp  =  @sysvar::SysVar_PROXI::pByte138Bit0      ;
    temp |= (@sysvar::SysVar_PROXI::pByte138Bit1 << 1);
//    temp |= (@sysvar::SysVar_PROXI::pByte138Bit2 << 2);
//    temp |= (@sysvar::SysVar_PROXI::pByte138Bit3 << 3);
    temp |= (@sysvar::SysVar_PROXI::pByte138Bit23 << 2);
//    temp |= (@sysvar::SysVar_PROXI::pByte138Bit4 << 4);
//    temp |= (@sysvar::SysVar_PROXI::pByte138Bit5 << 5);
    temp |= (@sysvar::SysVar_PROXI::pByte138Bit45 << 4);
    temp |= (@sysvar::SysVar_PROXI::pByte138Bit6 << 6);
    temp |= (@sysvar::SysVar_PROXI::pByte138Bit7 << 7);
    PROXI_bDataBuffer[137] = temp;
    
    temp = 0;
//    temp  =  @sysvar::SysVar_PROXI::pByte139Bit0      ;
//    temp |= (@sysvar::SysVar_PROXI::pByte139Bit1 << 1);
//    temp |= (@sysvar::SysVar_PROXI::pByte139Bit2 << 2);
//    temp |= (@sysvar::SysVar_PROXI::pByte139Bit3 << 3);
//    temp |= (@sysvar::SysVar_PROXI::pByte139Bit4 << 4);
//    temp |= (@sysvar::SysVar_PROXI::pByte139Bit5 << 5);
//    temp |= (@sysvar::SysVar_PROXI::pByte139Bit6 << 6);
    temp = (@sysvar::SysVar_PROXI::pByte139Bit0123456)/10;
    temp |= (@sysvar::SysVar_PROXI::pByte139Bit7 << 7);
    PROXI_bDataBuffer[138] = temp;
    
    temp = 0;
    temp  =  @sysvar::SysVar_PROXI::pByte140Bit0      ;
    temp |= (@sysvar::SysVar_PROXI::pByte140Bit1 << 1);
    temp |= (@sysvar::SysVar_PROXI::pByte140Bit2 << 2);
    temp |= (@sysvar::SysVar_PROXI::pByte140Bit3 << 3);
    temp |= (@sysvar::SysVar_PROXI::pByte140Bit4 << 4);
    temp |= (@sysvar::SysVar_PROXI::pByte140Bit5 << 5);
    temp |= (@sysvar::SysVar_PROXI::pByte140Bit6 << 6);
    temp |= (@sysvar::SysVar_PROXI::pByte140Bit7 << 7);
    PROXI_bDataBuffer[139] = temp;
      
    temp = 0;
    temp  =  @sysvar::SysVar_PROXI::pByte141Bit0      ;
    temp |= (@sysvar::SysVar_PROXI::pByte141Bit1 << 1);
    temp |= (@sysvar::SysVar_PROXI::pByte141Bit2 << 2);
    temp |= (@sysvar::SysVar_PROXI::pByte141Bit3 << 3);
    temp |= (@sysvar::SysVar_PROXI::pByte141Bit4 << 4);
//    temp |= (@sysvar::SysVar_PROXI::pByte141Bit5 << 5);
//    temp |= (@sysvar::SysVar_PROXI::pByte141Bit6 << 6);
//    temp |= (@sysvar::SysVar_PROXI::pByte141Bit7 << 7);
    temp |= (@sysvar::SysVar_PROXI::pByte141Bit567 << 5);
    PROXI_bDataBuffer[140] = temp;
      
    temp = 0;
    temp  =  @sysvar::SysVar_PROXI::pByte142Bit0      ;
    temp |= (@sysvar::SysVar_PROXI::pByte142Bit1 << 1);
    temp |= (@sysvar::SysVar_PROXI::pByte142Bit2 << 2);
    temp |= (@sysvar::SysVar_PROXI::pByte142Bit3 << 3);
    temp |= (@sysvar::SysVar_PROXI::pByte142Bit4 << 4);
    temp |= (@sysvar::SysVar_PROXI::pByte142Bit5 << 5);
    temp |= (@sysvar::SysVar_PROXI::pByte142Bit6 << 6);
    temp |= (@sysvar::SysVar_PROXI::pByte142Bit7 << 7);
    PROXI_bDataBuffer[141] = temp;
      
    temp = 0;
    temp  =  @sysvar::SysVar_PROXI::pByte143Bit0      ;
    temp |= (@sysvar::SysVar_PROXI::pByte143Bit1 << 1);
    temp |= (@sysvar::SysVar_PROXI::pByte143Bit2 << 2);
    temp |= (@sysvar::SysVar_PROXI::pByte143Bit3 << 3);
    temp |= (@sysvar::SysVar_PROXI::pByte143Bit4 << 4);
    temp |= (@sysvar::SysVar_PROXI::pByte143Bit5 << 5);
    temp |= (@sysvar::SysVar_PROXI::pByte143Bit6 << 6);
    temp |= (@sysvar::SysVar_PROXI::pByte143Bit7 << 7);
    PROXI_bDataBuffer[142] = temp;
    
    temp = 0;
    temp  =  @sysvar::SysVar_PROXI::pByte144Bit0      ;
    temp |= (@sysvar::SysVar_PROXI::pByte144Bit1 << 1);
    temp |= (@sysvar::SysVar_PROXI::pByte144Bit2 << 2);
//    temp |= (@sysvar::SysVar_PROXI::pByte144Bit3 << 3);
//    temp |= (@sysvar::SysVar_PROXI::pByte144Bit4 << 4);
//    temp |= (@sysvar::SysVar_PROXI::pByte144Bit5 << 5);
    temp |= (@sysvar::SysVar_PROXI::pByte144Bit345 << 3);
    temp |= (@sysvar::SysVar_PROXI::pByte144Bit6 << 6);
    temp |= (@sysvar::SysVar_PROXI::pByte144Bit7 << 7);
    PROXI_bDataBuffer[143] = temp;
      
    temp = 0;
    temp  =  @sysvar::SysVar_PROXI::pByte145Bit012      ;
//    temp |= (@sysvar::SysVar_PROXI::pByte145Bit1 << 1);
//    temp |= (@sysvar::SysVar_PROXI::pByte145Bit2 << 2);
    temp |= (@sysvar::SysVar_PROXI::pByte145Bit3 << 3);
    temp |= (@sysvar::SysVar_PROXI::pByte145Bit4 << 4);
    temp |= (@sysvar::SysVar_PROXI::pByte145Bit5 << 5);
//    temp |= (@sysvar::SysVar_PROXI::pByte145Bit6 << 6);
//    temp |= (@sysvar::SysVar_PROXI::pByte145Bit7 << 7);
    temp |= (@sysvar::SysVar_PROXI::pByte145Bit67 << 6);
    PROXI_bDataBuffer[144] = temp;
      
    temp = 0;
    temp  =  @sysvar::SysVar_PROXI::pByte146Bit0      ;
    temp |= (@sysvar::SysVar_PROXI::pByte146Bit1 << 1);
    temp |= (@sysvar::SysVar_PROXI::pByte146Bit2 << 2);
    temp |= (@sysvar::SysVar_PROXI::pByte146Bit3 << 3);
    temp |= (@sysvar::SysVar_PROXI::pByte146Bit4 << 4);
    temp |= (@sysvar::SysVar_PROXI::pByte146Bit5 << 5);
    temp |= (@sysvar::SysVar_PROXI::pByte146Bit6 << 6);
    temp |= (@sysvar::SysVar_PROXI::pByte146Bit7 << 7);
    PROXI_bDataBuffer[145] = temp;
      
    temp = 0;
    temp  =  @sysvar::SysVar_PROXI::pByte147Bit0      ;
    temp |= (@sysvar::SysVar_PROXI::pByte147Bit1 << 1);
    temp |= (@sysvar::SysVar_PROXI::pByte147Bit2 << 2);
    temp |= (@sysvar::SysVar_PROXI::pByte147Bit3 << 3);
    temp |= (@sysvar::SysVar_PROXI::pByte147Bit4 << 4);
    temp |= (@sysvar::SysVar_PROXI::pByte147Bit5 << 5);
    temp |= (@sysvar::SysVar_PROXI::pByte147Bit6 << 6);
    temp |= (@sysvar::SysVar_PROXI::pByte147Bit7 << 7);
    PROXI_bDataBuffer[146] = temp;
      
    temp = 0;
    temp  =  @sysvar::SysVar_PROXI::pByte148Bit0      ;
    temp |= (@sysvar::SysVar_PROXI::pByte148Bit1 << 1);
    temp |= (@sysvar::SysVar_PROXI::pByte148Bit2 << 2);
    temp |= (@sysvar::SysVar_PROXI::pByte148Bit3 << 3);
    temp |= (@sysvar::SysVar_PROXI::pByte148Bit4 << 4);
    temp |= (@sysvar::SysVar_PROXI::pByte148Bit5 << 5);
    temp |= (@sysvar::SysVar_PROXI::pByte148Bit6 << 6);
    temp |= (@sysvar::SysVar_PROXI::pByte148Bit7 << 7);
    PROXI_bDataBuffer[147] = temp;
      
    temp = 0;
    temp  =  @sysvar::SysVar_PROXI::pByte149Bit0      ;
    temp |= (@sysvar::SysVar_PROXI::pByte149Bit1 << 1);
    temp |= (@sysvar::SysVar_PROXI::pByte149Bit2 << 2);
    temp |= (@sysvar::SysVar_PROXI::pByte149Bit3 << 3);
    temp |= (@sysvar::SysVar_PROXI::pByte149Bit4 << 4);
    temp |= (@sysvar::SysVar_PROXI::pByte149Bit5 << 5);
    temp |= (@sysvar::SysVar_PROXI::pByte149Bit6 << 6);
    temp |= (@sysvar::SysVar_PROXI::pByte149Bit7 << 7);
    PROXI_bDataBuffer[148] = temp;
      
    temp = 0;
    temp  =  @sysvar::SysVar_PROXI::pByte150Bit0      ;
    temp |= (@sysvar::SysVar_PROXI::pByte150Bit1 << 1);
    temp |= (@sysvar::SysVar_PROXI::pByte150Bit2 << 2);
    temp |= (@sysvar::SysVar_PROXI::pByte150Bit3 << 3);
    temp |= (@sysvar::SysVar_PROXI::pByte150Bit4 << 4);
    temp |= (@sysvar::SysVar_PROXI::pByte150Bit5 << 5);
    temp |= (@sysvar::SysVar_PROXI::pByte150Bit6 << 6);
    temp |= (@sysvar::SysVar_PROXI::pByte150Bit7 << 7);
    PROXI_bDataBuffer[149] = temp;
      
    temp = 0;
    temp  =  @sysvar::SysVar_PROXI::pByte151Bit0      ;
    temp |= (@sysvar::SysVar_PROXI::pByte151Bit1 << 1);
    temp |= (@sysvar::SysVar_PROXI::pByte151Bit2 << 2);
    temp |= (@sysvar::SysVar_PROXI::pByte151Bit3 << 3);
    temp |= (@sysvar::SysVar_PROXI::pByte151Bit4 << 4);
    temp |= (@sysvar::SysVar_PROXI::pByte151Bit5 << 5);
    temp |= (@sysvar::SysVar_PROXI::pByte151Bit6 << 6);
    temp |= (@sysvar::SysVar_PROXI::pByte151Bit7 << 7);
    PROXI_bDataBuffer[150] = temp;
      
    temp = 0;
    temp  =  @sysvar::SysVar_PROXI::pByte152Bit0      ;
    temp |= (@sysvar::SysVar_PROXI::pByte152Bit1 << 1);
    temp |= (@sysvar::SysVar_PROXI::pByte152Bit2 << 2);
    temp |= (@sysvar::SysVar_PROXI::pByte152Bit3 << 3);
    temp |= (@sysvar::SysVar_PROXI::pByte152Bit4 << 4);
    temp |= (@sysvar::SysVar_PROXI::pByte152Bit5 << 5);
    temp |= (@sysvar::SysVar_PROXI::pByte152Bit6 << 6);
    temp |= (@sysvar::SysVar_PROXI::pByte152Bit7 << 7);
    PROXI_bDataBuffer[151] = temp;
      
    temp = 0;
    temp  =  @sysvar::SysVar_PROXI::pByte153Bit0      ;
    temp |= (@sysvar::SysVar_PROXI::pByte153Bit1 << 1);
    temp |= (@sysvar::SysVar_PROXI::pByte153Bit2 << 2);
    temp |= (@sysvar::SysVar_PROXI::pByte153Bit3 << 3);
    temp |= (@sysvar::SysVar_PROXI::pByte153Bit4 << 4);
    temp |= (@sysvar::SysVar_PROXI::pByte153Bit5 << 5);
    temp |= (@sysvar::SysVar_PROXI::pByte153Bit6 << 6);
    temp |= (@sysvar::SysVar_PROXI::pByte153Bit7 << 7);
    PROXI_bDataBuffer[152] = temp;
    
    temp = 0;
    temp  =  @sysvar::SysVar_PROXI::pByte154Bit0      ;
    temp |= (@sysvar::SysVar_PROXI::pByte154Bit1 << 1);
    temp |= (@sysvar::SysVar_PROXI::pByte154Bit2 << 2);
    temp |= (@sysvar::SysVar_PROXI::pByte154Bit3 << 3);
    temp |= (@sysvar::SysVar_PROXI::pByte154Bit4 << 4);
    temp |= (@sysvar::SysVar_PROXI::pByte154Bit5 << 5);
    temp |= (@sysvar::SysVar_PROXI::pByte154Bit6 << 6);
    temp |= (@sysvar::SysVar_PROXI::pByte154Bit7 << 7);
    PROXI_bDataBuffer[153] = temp;
      
    temp = 0;
    temp  =  @sysvar::SysVar_PROXI::pByte155Bit0      ;
    temp |= (@sysvar::SysVar_PROXI::pByte155Bit1 << 1);
    temp |= (@sysvar::SysVar_PROXI::pByte155Bit2 << 2);
    temp |= (@sysvar::SysVar_PROXI::pByte155Bit3 << 3);
    temp |= (@sysvar::SysVar_PROXI::pByte155Bit4 << 4);
    temp |= (@sysvar::SysVar_PROXI::pByte155Bit5 << 5);
    temp |= (@sysvar::SysVar_PROXI::pByte155Bit6 << 6);
    temp |= (@sysvar::SysVar_PROXI::pByte155Bit7 << 7);
    PROXI_bDataBuffer[154] = temp;
      
    temp = 0;
    temp  =  @sysvar::SysVar_PROXI::pByte156Bit0      ;
    temp |= (@sysvar::SysVar_PROXI::pByte156Bit1 << 1);
    temp |= (@sysvar::SysVar_PROXI::pByte156Bit2 << 2);
    temp |= (@sysvar::SysVar_PROXI::pByte156Bit3 << 3);
    temp |= (@sysvar::SysVar_PROXI::pByte156Bit4 << 4);
    temp |= (@sysvar::SysVar_PROXI::pByte156Bit5 << 5);
    temp |= (@sysvar::SysVar_PROXI::pByte156Bit6 << 6);
    temp |= (@sysvar::SysVar_PROXI::pByte156Bit7 << 7);
    PROXI_bDataBuffer[155] = temp;
      
    temp = 0;
    temp  =  @sysvar::SysVar_PROXI::pByte157Bit0      ;
    temp |= (@sysvar::SysVar_PROXI::pByte157Bit1 << 1);
    temp |= (@sysvar::SysVar_PROXI::pByte157Bit2 << 2);
    temp |= (@sysvar::SysVar_PROXI::pByte157Bit3 << 3);
    temp |= (@sysvar::SysVar_PROXI::pByte157Bit4 << 4);
    temp |= (@sysvar::SysVar_PROXI::pByte157Bit5 << 5);
    temp |= (@sysvar::SysVar_PROXI::pByte157Bit6 << 6);
    temp |= (@sysvar::SysVar_PROXI::pByte157Bit7 << 7);
    PROXI_bDataBuffer[156] = temp;
      
    temp = 0;
    temp  =  @sysvar::SysVar_PROXI::pByte158Bit0      ;
    temp |= (@sysvar::SysVar_PROXI::pByte158Bit1 << 1);
    temp |= (@sysvar::SysVar_PROXI::pByte158Bit2 << 2);
    temp |= (@sysvar::SysVar_PROXI::pByte158Bit3 << 3);
    temp |= (@sysvar::SysVar_PROXI::pByte158Bit4 << 4);
    temp |= (@sysvar::SysVar_PROXI::pByte158Bit5 << 5);
    temp |= (@sysvar::SysVar_PROXI::pByte158Bit6 << 6);
    temp |= (@sysvar::SysVar_PROXI::pByte158Bit7 << 7);
    PROXI_bDataBuffer[157] = temp;
      
    temp = 0;
//    temp  =  @sysvar::SysVar_PROXI::pByte159Bit0      ;
//    temp |= (@sysvar::SysVar_PROXI::pByte159Bit1 << 1);
//    temp |= (@sysvar::SysVar_PROXI::pByte159Bit2 << 2);
//    temp |= (@sysvar::SysVar_PROXI::pByte159Bit3 << 3);
//    temp |= (@sysvar::SysVar_PROXI::pByte159Bit4 << 4);
    temp = @sysvar::SysVar_PROXI::pByte159Bit01234;
    temp |= (@sysvar::SysVar_PROXI::pByte159Bit5 << 5);
    temp |= (@sysvar::SysVar_PROXI::pByte159Bit6 << 6);
    temp |= (@sysvar::SysVar_PROXI::pByte159Bit7 << 7);
    PROXI_bDataBuffer[158] = temp;
      
    temp = 0;
//  temp  =  @sysvar::SysVar_PROXI::pByte160Bit0      ;
//  temp |= (@sysvar::SysVar_PROXI::pByte160Bit1 << 1);
//  temp |= (@sysvar::SysVar_PROXI::pByte160Bit2 << 2);
    temp  =  @sysvar::SysVar_PROXI::pByte160Bit012    ;
    temp |= (@sysvar::SysVar_PROXI::pByte160Bit3 << 3);
    temp |= (@sysvar::SysVar_PROXI::pByte160Bit4 << 4);
    temp |= (@sysvar::SysVar_PROXI::pByte160Bit5 << 5);
    temp |= (@sysvar::SysVar_PROXI::pByte160Bit6 << 6);
    temp |= (@sysvar::SysVar_PROXI::pByte160Bit7 << 7);
    PROXI_bDataBuffer[159] = temp;
      
    temp = 0;
    temp  =  @sysvar::SysVar_PROXI::pByte161Bit0      ;
    temp |= (@sysvar::SysVar_PROXI::pByte161Bit1 << 1);
    temp |= (@sysvar::SysVar_PROXI::pByte161Bit2 << 2);
    temp |= (@sysvar::SysVar_PROXI::pByte161Bit3 << 3);
    temp |= (@sysvar::SysVar_PROXI::pByte161Bit4 << 4);
    temp |= (@sysvar::SysVar_PROXI::pByte161Bit5 << 5);
    temp |= (@sysvar::SysVar_PROXI::pByte161Bit6 << 6);
    temp |= (@sysvar::SysVar_PROXI::pByte161Bit7 << 7);
    PROXI_bDataBuffer[160] = temp;
      
    temp = 0;
  //  temp  =  @sysvar::SysVar_PROXI::pByte162Bit0      ;
  //  temp |= (@sysvar::SysVar_PROXI::pByte162Bit1 << 1);
  //  temp |= (@sysvar::SysVar_PROXI::pByte162Bit2 << 2);
    temp = @sysvar::SysVar_PROXI::pByte162Bit012;
    temp |= (@sysvar::SysVar_PROXI::pByte162Bit3 << 3);
    temp |= (@sysvar::SysVar_PROXI::pByte162Bit4 << 4);
    temp |= (@sysvar::SysVar_PROXI::pByte162Bit5 << 5);
    temp |= (@sysvar::SysVar_PROXI::pByte162Bit6 << 6);
    temp |= (@sysvar::SysVar_PROXI::pByte162Bit7 << 7);
    PROXI_bDataBuffer[161] = temp;
      
    temp = 0;
    temp  =  @sysvar::SysVar_PROXI::pByte163Bit0      ;
    temp |= (@sysvar::SysVar_PROXI::pByte163Bit1 << 1);
    temp |= (@sysvar::SysVar_PROXI::pByte163Bit2 << 2);
    temp |= (@sysvar::SysVar_PROXI::pByte163Bit3 << 3);
    temp |= (@sysvar::SysVar_PROXI::pByte163Bit4 << 4);
    temp |= (@sysvar::SysVar_PROXI::pByte163Bit5 << 5);
    temp |= (@sysvar::SysVar_PROXI::pByte163Bit6 << 6);
    temp |= (@sysvar::SysVar_PROXI::pByte163Bit7 << 7);
    PROXI_bDataBuffer[162] = temp;
    
    temp = 0;
    temp  =  @sysvar::SysVar_PROXI::pByte164Bit0      ;
    temp |= (@sysvar::SysVar_PROXI::pByte164Bit1 << 1);
    temp |= (@sysvar::SysVar_PROXI::pByte164Bit2 << 2);
    temp |= (@sysvar::SysVar_PROXI::pByte164Bit3 << 3);
    temp |= (@sysvar::SysVar_PROXI::pByte164Bit4 << 4);
    temp |= (@sysvar::SysVar_PROXI::pByte164Bit5 << 5);
    temp |= (@sysvar::SysVar_PROXI::pByte164Bit6 << 6);
    temp |= (@sysvar::SysVar_PROXI::pByte164Bit7 << 7);
    PROXI_bDataBuffer[163] = temp;
      
    temp = 0;
    temp  =  @sysvar::SysVar_PROXI::pByte165Bit0      ;
    temp |= (@sysvar::SysVar_PROXI::pByte165Bit1 << 1);
    temp |= (@sysvar::SysVar_PROXI::pByte165Bit2 << 2);
    temp |= (@sysvar::SysVar_PROXI::pByte165Bit3 << 3);
    temp |= (@sysvar::SysVar_PROXI::pByte165Bit4 << 4);
    temp |= (@sysvar::SysVar_PROXI::pByte165Bit5 << 5);
    temp |= (@sysvar::SysVar_PROXI::pByte165Bit6 << 6);
    temp |= (@sysvar::SysVar_PROXI::pByte165Bit7 << 7);
    PROXI_bDataBuffer[164] = temp;
      
    temp = 0;
//  temp  =  @sysvar::SysVar_PROXI::pByte166Bit0       ;
//  temp |= (@sysvar::SysVar_PROXI::pByte166Bit1  << 1);
    temp  =  @sysvar::SysVar_PROXI::pByte166Bit01      ;
    temp |= (@sysvar::SysVar_PROXI::pByte166Bit2  << 2);
    temp |= (@sysvar::SysVar_PROXI::pByte166Bit3  << 3);
//  temp |= (@sysvar::SysVar_PROXI::pByte166Bit4  << 4);
//  temp |= (@sysvar::SysVar_PROXI::pByte166Bit5  << 5);
    temp |= (@sysvar::SysVar_PROXI::pByte166Bit45 << 4);
    temp |= (@sysvar::SysVar_PROXI::pByte166Bit6  << 6);
    temp |= (@sysvar::SysVar_PROXI::pByte166Bit7  << 7);
    PROXI_bDataBuffer[165] = temp;
      
    temp = 0;
//  temp  =  @sysvar::SysVar_PROXI::pByte167Bit0      ;
//  temp |= (@sysvar::SysVar_PROXI::pByte167Bit1 << 1);
    temp = @sysvar::SysVar_PROXI::pByte167Bit01;
    temp |= (@sysvar::SysVar_PROXI::pByte167Bit2 << 2);
    temp |= (@sysvar::SysVar_PROXI::pByte167Bit3 << 3);
    temp |= (@sysvar::SysVar_PROXI::pByte167Bit4 << 4);
    temp |= (@sysvar::SysVar_PROXI::pByte167Bit5 << 5);
    temp |= (@sysvar::SysVar_PROXI::pByte167Bit6 << 6);
    temp |= (@sysvar::SysVar_PROXI::pByte167Bit7 << 7);
    PROXI_bDataBuffer[166] = temp;
      
    temp = 0;
    temp  =  @sysvar::SysVar_PROXI::pByte168Bit0      ;
    temp |= (@sysvar::SysVar_PROXI::pByte168Bit1 << 1);
    temp |= (@sysvar::SysVar_PROXI::pByte168Bit2 << 2);
    temp |= (@sysvar::SysVar_PROXI::pByte168Bit3 << 3);
    temp |= (@sysvar::SysVar_PROXI::pByte168Bit4 << 4);
    temp |= (@sysvar::SysVar_PROXI::pByte168Bit5 << 5);
    temp |= (@sysvar::SysVar_PROXI::pByte168Bit6 << 6);
    temp |= (@sysvar::SysVar_PROXI::pByte168Bit7 << 7);
    PROXI_bDataBuffer[167] = temp;
      
    temp = 0;
    temp  =  @sysvar::SysVar_PROXI::pByte169Bit0      ;
    temp |= (@sysvar::SysVar_PROXI::pByte169Bit1 << 1);
    temp |= (@sysvar::SysVar_PROXI::pByte169Bit2 << 2);
    temp |= (@sysvar::SysVar_PROXI::pByte169Bit3 << 3);
    temp |= (@sysvar::SysVar_PROXI::pByte169Bit4 << 4);
    temp |= (@sysvar::SysVar_PROXI::pByte169Bit5 << 5);
    temp |= (@sysvar::SysVar_PROXI::pByte169Bit6 << 6);
    temp |= (@sysvar::SysVar_PROXI::pByte169Bit7 << 7);
    PROXI_bDataBuffer[168] = temp;
      
    temp = 0;
    temp  =  @sysvar::SysVar_PROXI::pByte170Bit0      ;
    temp |= (@sysvar::SysVar_PROXI::pByte170Bit1 << 1);
    temp |= (@sysvar::SysVar_PROXI::pByte170Bit2 << 2);
    temp |= (@sysvar::SysVar_PROXI::pByte170Bit3 << 3);
    temp |= (@sysvar::SysVar_PROXI::pByte170Bit4 << 4);
    temp |= (@sysvar::SysVar_PROXI::pByte170Bit5 << 5);
    temp |= (@sysvar::SysVar_PROXI::pByte170Bit6 << 6);
    temp |= (@sysvar::SysVar_PROXI::pByte170Bit7 << 7);
    PROXI_bDataBuffer[169] = temp;
    
    temp = 0;
    temp  =  @sysvar::SysVar_PROXI::pByte171Bit0      ;
    temp |= (@sysvar::SysVar_PROXI::pByte171Bit1 << 1);
    temp |= (@sysvar::SysVar_PROXI::pByte171Bit2 << 2);
    temp |= (@sysvar::SysVar_PROXI::pByte171Bit3 << 3);
    temp |= (@sysvar::SysVar_PROXI::pByte171Bit4 << 4);
    temp |= (@sysvar::SysVar_PROXI::pByte171Bit5 << 5);
    temp |= (@sysvar::SysVar_PROXI::pByte171Bit6 << 6);
    temp |= (@sysvar::SysVar_PROXI::pByte171Bit7 << 7);
    PROXI_bDataBuffer[170] = temp;
    
    temp = 0;
    temp  =  @sysvar::SysVar_PROXI::pByte172Bit0      ;
    temp |= (@sysvar::SysVar_PROXI::pByte172Bit1 << 1);
    temp |= (@sysvar::SysVar_PROXI::pByte172Bit2 << 2);
    temp |= (@sysvar::SysVar_PROXI::pByte172Bit3 << 3);
    temp |= (@sysvar::SysVar_PROXI::pByte172Bit4 << 4);
    temp |= (@sysvar::SysVar_PROXI::pByte172Bit5 << 5);
    temp |= (@sysvar::SysVar_PROXI::pByte172Bit6 << 6);
    temp |= (@sysvar::SysVar_PROXI::pByte172Bit7 << 7);
    PROXI_bDataBuffer[171] = temp;
    
    temp = 0;
    temp  =  @sysvar::SysVar_PROXI::pByte173Bit0      ;
    temp |= (@sysvar::SysVar_PROXI::pByte173Bit1 << 1);
    temp |= (@sysvar::SysVar_PROXI::pByte173Bit2 << 2);
    temp |= (@sysvar::SysVar_PROXI::pByte173Bit3 << 3);
    temp |= (@sysvar::SysVar_PROXI::pByte173Bit4 << 4);
    temp |= (@sysvar::SysVar_PROXI::pByte173Bit5 << 5);
    temp |= (@sysvar::SysVar_PROXI::pByte173Bit6 << 6);
    temp |= (@sysvar::SysVar_PROXI::pByte173Bit7 << 7);
    PROXI_bDataBuffer[172] = temp;
    
    temp = 0;
    temp  =  @sysvar::SysVar_PROXI::pByte174Bit0      ;
    temp |= (@sysvar::SysVar_PROXI::pByte174Bit1 << 1);
    temp |= (@sysvar::SysVar_PROXI::pByte174Bit2 << 2);
    temp |= (@sysvar::SysVar_PROXI::pByte174Bit3 << 3);
    temp |= (@sysvar::SysVar_PROXI::pByte174Bit4 << 4);
    temp |= (@sysvar::SysVar_PROXI::pByte174Bit5 << 5);
    temp |= (@sysvar::SysVar_PROXI::pByte174Bit6 << 6);
    temp |= (@sysvar::SysVar_PROXI::pByte174Bit7 << 7);
    PROXI_bDataBuffer[173] = temp;
    
    temp = 0;
    temp  =  @sysvar::SysVar_PROXI::pByte175Bit0      ;
    temp |= (@sysvar::SysVar_PROXI::pByte175Bit1 << 1);
    temp |= (@sysvar::SysVar_PROXI::pByte175Bit2 << 2);
    temp |= (@sysvar::SysVar_PROXI::pByte175Bit3 << 3);
    temp |= (@sysvar::SysVar_PROXI::pByte175Bit4 << 4);
    temp |= (@sysvar::SysVar_PROXI::pByte175Bit5 << 5);
    temp |= (@sysvar::SysVar_PROXI::pByte175Bit6 << 6);
    temp |= (@sysvar::SysVar_PROXI::pByte175Bit7 << 7);
    PROXI_bDataBuffer[174] = temp;
    
    temp = 0;
    temp  =  @sysvar::SysVar_PROXI::pByte176Bit0      ;
    temp |= (@sysvar::SysVar_PROXI::pByte176Bit1 << 1);
    temp |= (@sysvar::SysVar_PROXI::pByte176Bit2 << 2);
    temp |= (@sysvar::SysVar_PROXI::pByte176Bit3 << 3);
    temp |= (@sysvar::SysVar_PROXI::pByte176Bit4 << 4);
    temp |= (@sysvar::SysVar_PROXI::pByte176Bit5 << 5);
    temp |= (@sysvar::SysVar_PROXI::pByte176Bit6 << 6);
    temp |= (@sysvar::SysVar_PROXI::pByte176Bit7 << 7);
    PROXI_bDataBuffer[175] = temp;
    
    temp = 0;
    temp  =  @sysvar::SysVar_PROXI::pByte177Bit0        ;
    temp |= (@sysvar::SysVar_PROXI::pByte177Bit1   << 1);
//  temp |= (@sysvar::SysVar_PROXI::pByte177Bit2   << 2);
//  temp |= (@sysvar::SysVar_PROXI::pByte177Bit3   << 3);
//  temp |= (@sysvar::SysVar_PROXI::pByte177Bit4   << 4);
    temp |= (@sysvar::SysVar_PROXI::pByte177Bit234 << 2);
    temp |= (@sysvar::SysVar_PROXI::pByte177Bit5   << 5);
    temp |= (@sysvar::SysVar_PROXI::pByte177Bit6   << 6);
    temp |= (@sysvar::SysVar_PROXI::pByte177Bit7   << 7);
    PROXI_bDataBuffer[176] = temp;
    
    temp = 0;
    temp  =  @sysvar::SysVar_PROXI::pByte178Bit0      ;
    temp |= (@sysvar::SysVar_PROXI::pByte178Bit1 << 1);
    temp |= (@sysvar::SysVar_PROXI::pByte178Bit2 << 2);
    temp |= (@sysvar::SysVar_PROXI::pByte178Bit3 << 3);
    temp |= (@sysvar::SysVar_PROXI::pByte178Bit4 << 4);
    temp |= (@sysvar::SysVar_PROXI::pByte178Bit5 << 5);
    temp |= (@sysvar::SysVar_PROXI::pByte178Bit6 << 6);
    temp |= (@sysvar::SysVar_PROXI::pByte178Bit7 << 7);
    PROXI_bDataBuffer[177] = temp;
    
    temp = 0;
//  temp  =  @sysvar::SysVar_PROXI::pByte179Bit0      ;
//  temp |= (@sysvar::SysVar_PROXI::pByte179Bit1 << 1);
//  temp |= (@sysvar::SysVar_PROXI::pByte179Bit2 << 2);
    temp  =  @sysvar::SysVar_PROXI::pByte179Bit012    ;
    temp |= (@sysvar::SysVar_PROXI::pByte179Bit3 << 3);
    temp |= (@sysvar::SysVar_PROXI::pByte179Bit4 << 4);
    temp |= (@sysvar::SysVar_PROXI::pByte179Bit5 << 5);
    temp |= (@sysvar::SysVar_PROXI::pByte179Bit6 << 6);
    temp |= (@sysvar::SysVar_PROXI::pByte179Bit7 << 7);
    PROXI_bDataBuffer[178] = temp;
    
    temp = 0;
    temp  =  @sysvar::SysVar_PROXI::pByte180Bit0      ;
    temp |= (@sysvar::SysVar_PROXI::pByte180Bit1 << 1);
    temp |= (@sysvar::SysVar_PROXI::pByte180Bit2 << 2);
    temp |= (@sysvar::SysVar_PROXI::pByte180Bit3 << 3);
    temp |= (@sysvar::SysVar_PROXI::pByte180Bit4 << 4);
    temp |= (@sysvar::SysVar_PROXI::pByte180Bit5 << 5);
    temp |= (@sysvar::SysVar_PROXI::pByte180Bit6 << 6);
    temp |= (@sysvar::SysVar_PROXI::pByte180Bit7 << 7);
    PROXI_bDataBuffer[179] = temp;
    
    temp = 0;
    temp  =  @sysvar::SysVar_PROXI::pByte181Bit0      ;
    temp |= (@sysvar::SysVar_PROXI::pByte181Bit1 << 1);
    temp |= (@sysvar::SysVar_PROXI::pByte181Bit2 << 2);
    temp |= (@sysvar::SysVar_PROXI::pByte181Bit3 << 3);
    temp |= (@sysvar::SysVar_PROXI::pByte181Bit4 << 4);
    temp |= (@sysvar::SysVar_PROXI::pByte181Bit5 << 5);
    temp |= (@sysvar::SysVar_PROXI::pByte181Bit6 << 6);
    temp |= (@sysvar::SysVar_PROXI::pByte181Bit7 << 7);
    PROXI_bDataBuffer[180] = temp;
    
    temp = 0;
    temp  =  @sysvar::SysVar_PROXI::pByte182Bit0      ;
    temp |= (@sysvar::SysVar_PROXI::pByte182Bit1 << 1);
    temp |= (@sysvar::SysVar_PROXI::pByte182Bit2 << 2);
    temp |= (@sysvar::SysVar_PROXI::pByte182Bit3 << 3);
    temp |= (@sysvar::SysVar_PROXI::pByte182Bit4 << 4);
    temp |= (@sysvar::SysVar_PROXI::pByte182Bit5 << 5);
    temp |= (@sysvar::SysVar_PROXI::pByte182Bit6 << 6);
    temp |= (@sysvar::SysVar_PROXI::pByte182Bit7 << 7);
    PROXI_bDataBuffer[181] = temp;
    
    temp = 0;
    temp  =  @sysvar::SysVar_PROXI::pByte183Bit0      ;
    temp |= (@sysvar::SysVar_PROXI::pByte183Bit1 << 1);
    temp |= (@sysvar::SysVar_PROXI::pByte183Bit2 << 2);
    temp |= (@sysvar::SysVar_PROXI::pByte183Bit3 << 3);
    temp |= (@sysvar::SysVar_PROXI::pByte183Bit4 << 4);
    temp |= (@sysvar::SysVar_PROXI::pByte183Bit5 << 5);
    temp |= (@sysvar::SysVar_PROXI::pByte183Bit6 << 6);
    temp |= (@sysvar::SysVar_PROXI::pByte183Bit7 << 7);
    PROXI_bDataBuffer[182] = temp;
    
    temp = 0;
    temp  =  @sysvar::SysVar_PROXI::pByte184Bit0      ;
    temp |= (@sysvar::SysVar_PROXI::pByte184Bit1 << 1);
    temp |= (@sysvar::SysVar_PROXI::pByte184Bit2 << 2);
    temp |= (@sysvar::SysVar_PROXI::pByte184Bit3 << 3);
    temp |= (@sysvar::SysVar_PROXI::pByte184Bit4 << 4);
    temp |= (@sysvar::SysVar_PROXI::pByte184Bit5 << 5);
    temp |= (@sysvar::SysVar_PROXI::pByte184Bit6 << 6);
    temp |= (@sysvar::SysVar_PROXI::pByte184Bit7 << 7);
    PROXI_bDataBuffer[183] = temp;
    
    temp = 0;
    temp  =  @sysvar::SysVar_PROXI::pByte185Bit0      ;
    temp |= (@sysvar::SysVar_PROXI::pByte185Bit1 << 1);
    temp |= (@sysvar::SysVar_PROXI::pByte185Bit2 << 2);
    temp |= (@sysvar::SysVar_PROXI::pByte185Bit3 << 3);
    temp |= (@sysvar::SysVar_PROXI::pByte185Bit4 << 4);
    temp |= (@sysvar::SysVar_PROXI::pByte185Bit5 << 5);
    temp |= (@sysvar::SysVar_PROXI::pByte185Bit6 << 6);
    temp |= (@sysvar::SysVar_PROXI::pByte185Bit7 << 7);
    PROXI_bDataBuffer[184] = temp;
    
    temp = 0;
    temp  =  @sysvar::SysVar_PROXI::pByte186Bit0      ;
    temp |= (@sysvar::SysVar_PROXI::pByte186Bit1 << 1);
    temp |= (@sysvar::SysVar_PROXI::pByte186Bit2 << 2);
    temp |= (@sysvar::SysVar_PROXI::pByte186Bit3 << 3);
    temp |= (@sysvar::SysVar_PROXI::pByte186Bit4 << 4);
    temp |= (@sysvar::SysVar_PROXI::pByte186Bit5 << 5);
    temp |= (@sysvar::SysVar_PROXI::pByte186Bit6 << 6);
    temp |= (@sysvar::SysVar_PROXI::pByte186Bit7 << 7);
    PROXI_bDataBuffer[185] = temp;
    
    temp = 0;
    temp  =  @sysvar::SysVar_PROXI::pByte187Bit0      ;
    temp |= (@sysvar::SysVar_PROXI::pByte187Bit1 << 1);
    temp |= (@sysvar::SysVar_PROXI::pByte187Bit2 << 2);
    temp |= (@sysvar::SysVar_PROXI::pByte187Bit3 << 3);
    temp |= (@sysvar::SysVar_PROXI::pByte187Bit4 << 4);
    temp |= (@sysvar::SysVar_PROXI::pByte187Bit5 << 5);
    temp |= (@sysvar::SysVar_PROXI::pByte187Bit6 << 6);
    temp |= (@sysvar::SysVar_PROXI::pByte187Bit7 << 7);
    PROXI_bDataBuffer[186] = temp;
    
    temp = 0;
    temp  =  @sysvar::SysVar_PROXI::pByte188Bit0      ;
    temp |= (@sysvar::SysVar_PROXI::pByte188Bit1 << 1);
    temp |= (@sysvar::SysVar_PROXI::pByte188Bit2 << 2);
    temp |= (@sysvar::SysVar_PROXI::pByte188Bit3 << 3);
    temp |= (@sysvar::SysVar_PROXI::pByte188Bit4 << 4);
    temp |= (@sysvar::SysVar_PROXI::pByte188Bit5 << 5);
    temp |= (@sysvar::SysVar_PROXI::pByte188Bit6 << 6);
    temp |= (@sysvar::SysVar_PROXI::pByte188Bit7 << 7);
    PROXI_bDataBuffer[187] = temp;
    
    temp = 0;
    temp  =  @sysvar::SysVar_PROXI::pByte189Bit0      ;
    temp |= (@sysvar::SysVar_PROXI::pByte189Bit1 << 1);
    temp |= (@sysvar::SysVar_PROXI::pByte189Bit2 << 2);
    temp |= (@sysvar::SysVar_PROXI::pByte189Bit3 << 3);
    temp |= (@sysvar::SysVar_PROXI::pByte189Bit4 << 4);
    temp |= (@sysvar::SysVar_PROXI::pByte189Bit5 << 5);
    temp |= (@sysvar::SysVar_PROXI::pByte189Bit6 << 6);
    temp |= (@sysvar::SysVar_PROXI::pByte189Bit7 << 7);
    PROXI_bDataBuffer[188] = temp;
    
    temp = 0;
    temp  =  @sysvar::SysVar_PROXI::pByte190Bit0      ;
    temp |= (@sysvar::SysVar_PROXI::pByte190Bit1 << 1);
    temp |= (@sysvar::SysVar_PROXI::pByte190Bit2 << 2);
    temp |= (@sysvar::SysVar_PROXI::pByte190Bit3 << 3);
    temp |= (@sysvar::SysVar_PROXI::pByte190Bit4 << 4);
    temp |= (@sysvar::SysVar_PROXI::pByte190Bit5 << 5);
    temp |= (@sysvar::SysVar_PROXI::pByte190Bit6 << 6);
    temp |= (@sysvar::SysVar_PROXI::pByte190Bit7 << 7);
    PROXI_bDataBuffer[189] = temp;
    
    temp = 0;
    temp  =  @sysvar::SysVar_PROXI::pByte191Bit0      ;
    temp |= (@sysvar::SysVar_PROXI::pByte191Bit1 << 1);
    temp |= (@sysvar::SysVar_PROXI::pByte191Bit2 << 2);
    temp |= (@sysvar::SysVar_PROXI::pByte191Bit3 << 3);
    temp |= (@sysvar::SysVar_PROXI::pByte191Bit4 << 4);
    temp |= (@sysvar::SysVar_PROXI::pByte191Bit5 << 5);
    temp |= (@sysvar::SysVar_PROXI::pByte191Bit6 << 6);
    temp |= (@sysvar::SysVar_PROXI::pByte191Bit7 << 7);
    PROXI_bDataBuffer[190] = temp;
    
    temp = 0;
    temp  =  @sysvar::SysVar_PROXI::pByte192Bit0      ;
    temp |= (@sysvar::SysVar_PROXI::pByte192Bit1 << 1);
    temp |= (@sysvar::SysVar_PROXI::pByte192Bit2 << 2);
    temp |= (@sysvar::SysVar_PROXI::pByte192Bit3 << 3);
    temp |= (@sysvar::SysVar_PROXI::pByte192Bit4 << 4);
    temp |= (@sysvar::SysVar_PROXI::pByte192Bit5 << 5);
    temp |= (@sysvar::SysVar_PROXI::pByte192Bit6 << 6);
    temp |= (@sysvar::SysVar_PROXI::pByte192Bit7 << 7);
    PROXI_bDataBuffer[191] = temp;
    
    temp = 0;
    temp  =  @sysvar::SysVar_PROXI::pByte193Bit0      ;
    temp |= (@sysvar::SysVar_PROXI::pByte193Bit1 << 1);
    temp |= (@sysvar::SysVar_PROXI::pByte193Bit2 << 2);
    temp |= (@sysvar::SysVar_PROXI::pByte193Bit3 << 3);
    temp |= (@sysvar::SysVar_PROXI::pByte193Bit4 << 4);
    temp |= (@sysvar::SysVar_PROXI::pByte193Bit5 << 5);
    temp |= (@sysvar::SysVar_PROXI::pByte193Bit6 << 6);
    temp |= (@sysvar::SysVar_PROXI::pByte193Bit7 << 7);
    PROXI_bDataBuffer[192] = temp;
    
    temp = 0;
    temp  =  @sysvar::SysVar_PROXI::pByte194Bit0      ;
    temp |= (@sysvar::SysVar_PROXI::pByte194Bit1 << 1);
    temp |= (@sysvar::SysVar_PROXI::pByte194Bit2 << 2);
    temp |= (@sysvar::SysVar_PROXI::pByte194Bit3 << 3);
    temp |= (@sysvar::SysVar_PROXI::pByte194Bit4 << 4);
    temp |= (@sysvar::SysVar_PROXI::pByte194Bit5 << 5);
    temp |= (@sysvar::SysVar_PROXI::pByte194Bit6 << 6);
    temp |= (@sysvar::SysVar_PROXI::pByte194Bit7 << 7);
    PROXI_bDataBuffer[193] = temp;
    
    temp = 0;
    temp  =  @sysvar::SysVar_PROXI::pByte195Bit0      ;
    temp |= (@sysvar::SysVar_PROXI::pByte195Bit1 << 1);
    temp |= (@sysvar::SysVar_PROXI::pByte195Bit2 << 2);
    temp |= (@sysvar::SysVar_PROXI::pByte195Bit3 << 3);
    temp |= (@sysvar::SysVar_PROXI::pByte195Bit4 << 4);
    temp |= (@sysvar::SysVar_PROXI::pByte195Bit5 << 5);
    temp |= (@sysvar::SysVar_PROXI::pByte195Bit6 << 6);
    temp |= (@sysvar::SysVar_PROXI::pByte195Bit7 << 7);
    PROXI_bDataBuffer[194] = temp;
    
    temp = 0;
    temp  =  @sysvar::SysVar_PROXI::pByte196Bit0      ;
    temp |= (@sysvar::SysVar_PROXI::pByte196Bit1 << 1);
    temp |= (@sysvar::SysVar_PROXI::pByte196Bit2 << 2);
    temp |= (@sysvar::SysVar_PROXI::pByte196Bit3 << 3);
    temp |= (@sysvar::SysVar_PROXI::pByte196Bit4 << 4);
    temp |= (@sysvar::SysVar_PROXI::pByte196Bit5 << 5);
    temp |= (@sysvar::SysVar_PROXI::pByte196Bit6 << 6);
    temp |= (@sysvar::SysVar_PROXI::pByte196Bit7 << 7);
    PROXI_bDataBuffer[195] = temp;
    
    temp = 0;
    temp  =  @sysvar::SysVar_PROXI::pByte197Bit0      ;
    temp |= (@sysvar::SysVar_PROXI::pByte197Bit1 << 1);
    temp |= (@sysvar::SysVar_PROXI::pByte197Bit2 << 2);
    temp |= (@sysvar::SysVar_PROXI::pByte197Bit3 << 3);
    temp |= (@sysvar::SysVar_PROXI::pByte197Bit4 << 4);
    temp |= (@sysvar::SysVar_PROXI::pByte197Bit5 << 5);
    temp |= (@sysvar::SysVar_PROXI::pByte197Bit6 << 6);
    temp |= (@sysvar::SysVar_PROXI::pByte197Bit7 << 7);
    PROXI_bDataBuffer[196] = temp;
    
    temp = 0;
	temp  =  @sysvar::SysVar_PROXI::pByte198Bit01      ;
    //temp  =  @sysvar::SysVar_PROXI::pByte198Bit0      ;
    //temp |= (@sysvar::SysVar_PROXI::pByte198Bit1 << 1);
    temp |= (@sysvar::SysVar_PROXI::pByte198Bit2 << 2);
    temp |= (@sysvar::SysVar_PROXI::pByte198Bit3 << 3);
    temp |= (@sysvar::SysVar_PROXI::pByte198Bit4 << 4);
    temp |= (@sysvar::SysVar_PROXI::pByte198Bit5 << 5);
    temp |= (@sysvar::SysVar_PROXI::pByte198Bit6 << 6);
    temp |= (@sysvar::SysVar_PROXI::pByte198Bit7 << 7);
    PROXI_bDataBuffer[197] = temp;
    
    temp = 0;
    temp  =  @sysvar::SysVar_PROXI::pByte199Bit0      ;
    temp |= (@sysvar::SysVar_PROXI::pByte199Bit1 << 1);
    temp |= (@sysvar::SysVar_PROXI::pByte199Bit2 << 2);
    temp |= (@sysvar::SysVar_PROXI::pByte199Bit3 << 3);
    temp |= (@sysvar::SysVar_PROXI::pByte199Bit4 << 4);
    temp |= (@sysvar::SysVar_PROXI::pByte199Bit5 << 5);
    temp |= (@sysvar::SysVar_PROXI::pByte199Bit6 << 6);
    temp |= (@sysvar::SysVar_PROXI::pByte199Bit7 << 7);
    PROXI_bDataBuffer[198] = temp;
    
    temp = 0;
    temp  =  @sysvar::SysVar_PROXI::pByte200Bit0      ;
    temp |= (@sysvar::SysVar_PROXI::pByte200Bit1 << 1);
    temp |= (@sysvar::SysVar_PROXI::pByte200Bit2 << 2);
    temp |= (@sysvar::SysVar_PROXI::pByte200Bit3 << 3);
    temp |= (@sysvar::SysVar_PROXI::pByte200Bit4 << 4);
    temp |= (@sysvar::SysVar_PROXI::pByte200Bit5 << 5);
    temp |= (@sysvar::SysVar_PROXI::pByte200Bit6 << 6);
    temp |= (@sysvar::SysVar_PROXI::pByte200Bit7 << 7);
    PROXI_bDataBuffer[199] = temp;
    
    temp = 0;
    temp  =  @sysvar::SysVar_PROXI::pByte217Bit0      ;
    temp |= (@sysvar::SysVar_PROXI::pByte217Bit1 << 1);
    temp |= (@sysvar::SysVar_PROXI::pByte217Bit2 << 2);
//    temp |= (@sysvar::SysVar_PROXI::pByte217Bit3 << 3);
//    temp |= (@sysvar::SysVar_PROXI::pByte217Bit4 << 4);
//    temp |= (@sysvar::SysVar_PROXI::pByte217Bit5 << 5);
//    temp |= (@sysvar::SysVar_PROXI::pByte217Bit6 << 6);
    temp |= (@sysvar::SysVar_PROXI::pByte217Bit3456 << 3);
    temp |= (@sysvar::SysVar_PROXI::pByte217Bit7 << 7);
    PROXI_bDataBuffer[216] = temp;
          
    sysSetVariableData(sysvar::SysVar_PROXI::DIAG_eProxiDataBuffer, PROXI_bDataBuffer,copiedbytes);
  } 
}

void PROXI_vUpdateProxiPanel (void)
{
  byte temp;
  byte bBuffer[PROXI_CFG_CODE_SIZE];
  byte bBuffer2[PROXI_TST_CODE_SIZE];
  byte bBuffer3[PROXI_PROD_DATE_SIZE];
  byte bVoidBuffer[2] = {0,0};
  int i;    
  /******************************************************
  *                       CFG CODE                      *
  ******************************************************/
  for(i = 0; i < PROXI_CFG_CODE_SIZE; i++)
  {
    bBuffer[i] = PROXI_bDataBuffer[i];      
  }
  sysSetVariableData(sysvar::SysVar_PROXI::DIAG_eConfigCode, bVoidBuffer,copiedbytes);
  sysSetVariableData(sysvar::SysVar_PROXI::DIAG_eConfigCode, bBuffer,copiedbytes);
  /******************************************************
  *                       TST CODE                      *
  ******************************************************/
  for(i = 0; i < PROXI_TST_CODE_SIZE; i++)
  {
    bBuffer2[i] = PROXI_bDataBuffer[i+PROXI_TST_CODE_OFFSET];    
  }
  sysSetVariableData(sysvar::SysVar_PROXI::DIAG_eTesterCode, bBuffer2,copiedbytes);
  /******************************************************
  *                       PROD DATA                     *
  ******************************************************/
  for(i = 0; i < PROXI_PROD_DATE_SIZE; i++)
  {
    bBuffer3[i] = PROXI_bDataBuffer[i+PROXI_PROD_DATE_OFFSET];    
  }
  sysSetVariableData(sysvar::SysVar_PROXI::DIAG_ProductionDate, bBuffer3,copiedbytes); 
  /******************************************************
  *                 CAN Configuration                   *
  ******************************************************/
  temp = PROXI_bDataBuffer[25];
  @sysvar::SysVar_PROXI::pByte26Bit0 = temp & 0x01;
  @sysvar::SysVar_PROXI::pByte26Bit1 = (temp >> 1) & 0x01;
  @sysvar::SysVar_PROXI::pByte26Bit2 = (temp >> 2) & 0x01;
  @sysvar::SysVar_PROXI::pByte26Bit3 = (temp >> 3) & 0x01;
  @sysvar::SysVar_PROXI::pByte26Bit4 = (temp >> 4) & 0x01;
  @sysvar::SysVar_PROXI::pByte26Bit5 = (temp >> 5) & 0x01;
  @sysvar::SysVar_PROXI::pByte26Bit6 = (temp >> 6) & 0x01;
  @sysvar::SysVar_PROXI::pByte26Bit7 = (temp >> 7) & 0x01;
  
  temp = PROXI_bDataBuffer[26];
  @sysvar::SysVar_PROXI::pByte27Bit0 = temp & 0x01;
  @sysvar::SysVar_PROXI::pByte27Bit1 = (temp >> 1) & 0x01;
  @sysvar::SysVar_PROXI::pByte27Bit2 = (temp >> 2) & 0x01;
  @sysvar::SysVar_PROXI::pByte27Bit3 = (temp >> 3) & 0x01;
  @sysvar::SysVar_PROXI::pByte27Bit4 = (temp >> 4) & 0x01;
  @sysvar::SysVar_PROXI::pByte27Bit5 = (temp >> 5) & 0x01;
  @sysvar::SysVar_PROXI::pByte27Bit6 = (temp >> 6) & 0x01;
  @sysvar::SysVar_PROXI::pByte27Bit7 = (temp >> 7) & 0x01;
  
  temp = PROXI_bDataBuffer[27];
  @sysvar::SysVar_PROXI::pByte28Bit0 = temp & 0x01;
  @sysvar::SysVar_PROXI::pByte28Bit1 = (temp >> 1) & 0x01;
  @sysvar::SysVar_PROXI::pByte28Bit2 = (temp >> 2) & 0x01;
  @sysvar::SysVar_PROXI::pByte28Bit3 = (temp >> 3) & 0x01;
  @sysvar::SysVar_PROXI::pByte28Bit4 = (temp >> 4) & 0x01;
  @sysvar::SysVar_PROXI::pByte28Bit5 = (temp >> 5) & 0x01;
  @sysvar::SysVar_PROXI::pByte28Bit6 = (temp >> 6) & 0x01;
  @sysvar::SysVar_PROXI::pByte28Bit7 = (temp >> 7) & 0x01;
  
  temp = PROXI_bDataBuffer[28];
  @sysvar::SysVar_PROXI::pByte29Bit0 = temp & 0x01;
  @sysvar::SysVar_PROXI::pByte29Bit1 = (temp >> 1) & 0x01;
  @sysvar::SysVar_PROXI::pByte29Bit2 = (temp >> 2) & 0x01;
  @sysvar::SysVar_PROXI::pByte29Bit3 = (temp >> 3) & 0x01;
  @sysvar::SysVar_PROXI::pByte29Bit4 = (temp >> 4) & 0x01;
  @sysvar::SysVar_PROXI::pByte29Bit5 = (temp >> 5) & 0x01;
  @sysvar::SysVar_PROXI::pByte29Bit6 = (temp >> 6) & 0x01;
  @sysvar::SysVar_PROXI::pByte29Bit7 = (temp >> 7) & 0x01;
  
  temp = PROXI_bDataBuffer[29];
  @sysvar::SysVar_PROXI::pByte30Bit0 = temp & 0x01;
  @sysvar::SysVar_PROXI::pByte30Bit1 = (temp >> 1) & 0x01;
  @sysvar::SysVar_PROXI::pByte30Bit2 = (temp >> 2) & 0x01;
  @sysvar::SysVar_PROXI::pByte30Bit3 = (temp >> 3) & 0x01;
  @sysvar::SysVar_PROXI::pByte30Bit4 = (temp >> 4) & 0x01;
  @sysvar::SysVar_PROXI::pByte30Bit5 = (temp >> 5) & 0x01;
  @sysvar::SysVar_PROXI::pByte30Bit6 = (temp >> 6) & 0x01;
  @sysvar::SysVar_PROXI::pByte30Bit7 = (temp >> 7) & 0x01;
  
  temp = PROXI_bDataBuffer[30];
  @sysvar::SysVar_PROXI::pByte31Bit0 = temp & 0x01;
  @sysvar::SysVar_PROXI::pByte31Bit1 = (temp >> 1) & 0x01;
  @sysvar::SysVar_PROXI::pByte31Bit2 = (temp >> 2) & 0x01;
  @sysvar::SysVar_PROXI::pByte31Bit3 = (temp >> 3) & 0x01;
  @sysvar::SysVar_PROXI::pByte31Bit4 = (temp >> 4) & 0x01;
  @sysvar::SysVar_PROXI::pByte31Bit5 = (temp >> 5) & 0x01;
  @sysvar::SysVar_PROXI::pByte31Bit6 = (temp >> 6) & 0x01;
  @sysvar::SysVar_PROXI::pByte31Bit7 = (temp >> 7) & 0x01;
  
  temp = PROXI_bDataBuffer[31];
  @sysvar::SysVar_PROXI::pByte32Bit0 = temp & 0x01;
  @sysvar::SysVar_PROXI::pByte32Bit1 = (temp >> 1) & 0x01;
  @sysvar::SysVar_PROXI::pByte32Bit2 = (temp >> 2) & 0x01;
  @sysvar::SysVar_PROXI::pByte32Bit3 = (temp >> 3) & 0x01;
  @sysvar::SysVar_PROXI::pByte32Bit4 = (temp >> 4) & 0x01;
  @sysvar::SysVar_PROXI::pByte32Bit5 = (temp >> 5) & 0x01;
  @sysvar::SysVar_PROXI::pByte32Bit6 = (temp >> 6) & 0x01;
  @sysvar::SysVar_PROXI::pByte32Bit7 = (temp >> 7) & 0x01;
  
  temp = PROXI_bDataBuffer[32];
  @sysvar::SysVar_PROXI::pByte33Bit0 = temp & 0x01;
  @sysvar::SysVar_PROXI::pByte33Bit1 = (temp >> 1) & 0x01;
  @sysvar::SysVar_PROXI::pByte33Bit2 = (temp >> 2) & 0x01;
  @sysvar::SysVar_PROXI::pByte33Bit3 = (temp >> 3) & 0x01;
  @sysvar::SysVar_PROXI::pByte33Bit4 = (temp >> 4) & 0x01;
  @sysvar::SysVar_PROXI::pByte33Bit5 = (temp >> 5) & 0x01;
  @sysvar::SysVar_PROXI::pByte33Bit6 = (temp >> 6) & 0x01;
  @sysvar::SysVar_PROXI::pByte33Bit7 = (temp >> 7) & 0x01;
     
  temp = PROXI_bDataBuffer[33];
  @sysvar::SysVar_PROXI::pByte34Bit0 = temp & 0x01;
  @sysvar::SysVar_PROXI::pByte34Bit1 = (temp >> 1) & 0x01;
  @sysvar::SysVar_PROXI::pByte34Bit2 = (temp >> 2) & 0x01;
  @sysvar::SysVar_PROXI::pByte34Bit3 = (temp >> 3) & 0x01;
  @sysvar::SysVar_PROXI::pByte34Bit4 = (temp >> 4) & 0x01;
  @sysvar::SysVar_PROXI::pByte34Bit5 = (temp >> 5) & 0x01;
  @sysvar::SysVar_PROXI::pByte34Bit6 = (temp >> 6) & 0x01;
  @sysvar::SysVar_PROXI::pByte34Bit7 = (temp >> 7) & 0x01;
  
  /******************************************************
  *                 EOL Configuration                   *
  ******************************************************/
  temp = PROXI_bDataBuffer[41];
  @sysvar::SysVar_PROXI::pByte42Bit0 = temp & 0x01;
  @sysvar::SysVar_PROXI::pByte42Bit1 = (temp >> 1) & 0x01;
  @sysvar::SysVar_PROXI::pByte42Bit2 = (temp >> 2) & 0x01;
  @sysvar::SysVar_PROXI::pByte42Bit3 = (temp >> 3) & 0x01;
  @sysvar::SysVar_PROXI::pByte42Bit4 = (temp >> 4) & 0x01;
  @sysvar::SysVar_PROXI::pByte42Bit5 = (temp >> 5) & 0x01;
  @sysvar::SysVar_PROXI::pByte42Bit6 = (temp >> 6) & 0x01;
  @sysvar::SysVar_PROXI::pByte42Bit7 = (temp >> 7) & 0x01;
  
  temp = PROXI_bDataBuffer[42];
  @sysvar::SysVar_PROXI::pByte43Bit0 = temp & 0x01;
  @sysvar::SysVar_PROXI::pByte43Bit1 = (temp >> 1) & 0x01;
  @sysvar::SysVar_PROXI::pByte43Bit2 = (temp >> 2) & 0x01;
  @sysvar::SysVar_PROXI::pByte43Bit3 = (temp >> 3) & 0x01;
  @sysvar::SysVar_PROXI::pByte43Bit4 = (temp >> 4) & 0x01;
  @sysvar::SysVar_PROXI::pByte43Bit5 = (temp >> 5) & 0x01;
  @sysvar::SysVar_PROXI::pByte43Bit6 = (temp >> 6) & 0x01;
  @sysvar::SysVar_PROXI::pByte43Bit7 = (temp >> 7) & 0x01;

  temp = PROXI_bDataBuffer[43];
  @sysvar::SysVar_PROXI::pByte44Bit0 = temp & 0x01;
  @sysvar::SysVar_PROXI::pByte44Bit1 = (temp >> 1) & 0x01;
  @sysvar::SysVar_PROXI::pByte44Bit2 = (temp >> 2) & 0x01;
  @sysvar::SysVar_PROXI::pByte44Bit3 = (temp >> 3) & 0x01;
  @sysvar::SysVar_PROXI::pByte44Bit4 = (temp >> 4) & 0x01;
  @sysvar::SysVar_PROXI::pByte44Bit5 = (temp >> 5) & 0x01;
  @sysvar::SysVar_PROXI::pByte44Bit6 = (temp >> 6) & 0x01;
  @sysvar::SysVar_PROXI::pByte44Bit7 = (temp >> 7) & 0x01;

  temp = PROXI_bDataBuffer[44];
  @sysvar::SysVar_PROXI::pByte45Bit0 = temp & 0x01;
  @sysvar::SysVar_PROXI::pByte45Bit1 = (temp >> 1) & 0x01;
  @sysvar::SysVar_PROXI::pByte45Bit2 = (temp >> 2) & 0x01;
  @sysvar::SysVar_PROXI::pByte45Bit3 = (temp >> 3) & 0x01;
  @sysvar::SysVar_PROXI::pByte45Bit4 = (temp >> 4) & 0x01;
  @sysvar::SysVar_PROXI::pByte45Bit5 = (temp >> 5) & 0x01;
  @sysvar::SysVar_PROXI::pByte45Bit6 = (temp >> 6) & 0x01;
  @sysvar::SysVar_PROXI::pByte45Bit7 = (temp >> 7) & 0x01;

  temp = PROXI_bDataBuffer[45];
  @sysvar::SysVar_PROXI::pByte46Bit0 = temp & 0x01;
  @sysvar::SysVar_PROXI::pByte46Bit1 = (temp >> 1) & 0x01;
  @sysvar::SysVar_PROXI::pByte46Bit2 = (temp >> 2) & 0x01;
  @sysvar::SysVar_PROXI::pByte46Bit3 = (temp >> 3) & 0x01;
  @sysvar::SysVar_PROXI::pByte46Bit4 = (temp >> 4) & 0x01;
  @sysvar::SysVar_PROXI::pByte46Bit5 = (temp >> 5) & 0x01;
  @sysvar::SysVar_PROXI::pByte46Bit6 = (temp >> 6) & 0x01;
  @sysvar::SysVar_PROXI::pByte46Bit7 = (temp >> 7) & 0x01;

  temp = PROXI_bDataBuffer[46];
  @sysvar::SysVar_PROXI::pByte47Bit0 = temp & 0x01;
  @sysvar::SysVar_PROXI::pByte47Bit1 = (temp >> 1) & 0x01;
  @sysvar::SysVar_PROXI::pByte47Bit2 = (temp >> 2) & 0x01;
  @sysvar::SysVar_PROXI::pByte47Bit3 = (temp >> 3) & 0x01;
  @sysvar::SysVar_PROXI::pByte47Bit4 = (temp >> 4) & 0x01;
  @sysvar::SysVar_PROXI::pByte47Bit5 = (temp >> 5) & 0x01;
  @sysvar::SysVar_PROXI::pByte47Bit6 = (temp >> 6) & 0x01;
  @sysvar::SysVar_PROXI::pByte47Bit7 = (temp >> 7) & 0x01;
  
  temp = PROXI_bDataBuffer[47];
  @sysvar::SysVar_PROXI::pByte48Bit0 = temp & 0x01;
  @sysvar::SysVar_PROXI::pByte48Bit1 = (temp >> 1) & 0x01;
  @sysvar::SysVar_PROXI::pByte48Bit2 = (temp >> 2) & 0x01;
  @sysvar::SysVar_PROXI::pByte48Bit3 = (temp >> 3) & 0x01;
  @sysvar::SysVar_PROXI::pByte48Bit4 = (temp >> 4) & 0x01;
  @sysvar::SysVar_PROXI::pByte48Bit5 = (temp >> 5) & 0x01;
  @sysvar::SysVar_PROXI::pByte48Bit6 = (temp >> 6) & 0x01;
  @sysvar::SysVar_PROXI::pByte48Bit7 = (temp >> 7) & 0x01;
  
  temp = PROXI_bDataBuffer[48];
  @sysvar::SysVar_PROXI::pByte49Bit0 = temp & 0x01;
  @sysvar::SysVar_PROXI::pByte49Bit1 = (temp >> 1) & 0x01;
  @sysvar::SysVar_PROXI::pByte49Bit2 = (temp >> 2) & 0x01;
  @sysvar::SysVar_PROXI::pByte49Bit3 = (temp >> 3) & 0x01;
  @sysvar::SysVar_PROXI::pByte49Bit4 = (temp >> 4) & 0x01;
  @sysvar::SysVar_PROXI::pByte49Bit5 = (temp >> 5) & 0x01;
  @sysvar::SysVar_PROXI::pByte49Bit6 = (temp >> 6) & 0x01;
  @sysvar::SysVar_PROXI::pByte49Bit7 = (temp >> 7) & 0x01;
  
  temp = PROXI_bDataBuffer[49];
  @sysvar::SysVar_PROXI::pByte50Bit0 = temp & 0x01;
  @sysvar::SysVar_PROXI::pByte50Bit1 = (temp >> 1) & 0x01;
  @sysvar::SysVar_PROXI::pByte50Bit2 = (temp >> 2) & 0x01;
  @sysvar::SysVar_PROXI::pByte50Bit3 = (temp >> 3) & 0x01;
  @sysvar::SysVar_PROXI::pByte50Bit4 = (temp >> 4) & 0x01;
  @sysvar::SysVar_PROXI::pByte50Bit5 = (temp >> 5) & 0x01;
  @sysvar::SysVar_PROXI::pByte50Bit6 = (temp >> 6) & 0x01;
  @sysvar::SysVar_PROXI::pByte50Bit7 = (temp >> 7) & 0x01;
  
  /******************************************************
  *                     EOL                            *
  ******************************************************/
  temp = PROXI_bDataBuffer[57];
  @sysvar::SysVar_PROXI::pByte58Bit0 =  temp     & 0x01;
  @sysvar::SysVar_PROXI::pByte58Bit1 = (temp >> 1) & 0x01;
  @sysvar::SysVar_PROXI::pByte58Bit2 = (temp >> 2) & 0x01;
  @sysvar::SysVar_PROXI::pByte58Bit3 = (temp >> 3) & 0x01;
  @sysvar::SysVar_PROXI::pByte58Bit4 = (temp >> 4) & 0x01;
  @sysvar::SysVar_PROXI::pByte58Bit5 = (temp >> 5) & 0x01;
  @sysvar::SysVar_PROXI::pByte58Bit6 = (temp >> 6) & 0x01;
  @sysvar::SysVar_PROXI::pByte58Bit7 = (temp >> 7) & 0x01;
  
  temp = PROXI_bDataBuffer[58];
  @sysvar::SysVar_PROXI::pByte59Bit0 =  temp     & 0x01;
  @sysvar::SysVar_PROXI::pByte59Bit1 = (temp >> 1) & 0x01;
  @sysvar::SysVar_PROXI::pByte59Bit2 = (temp >> 2) & 0x01;
  @sysvar::SysVar_PROXI::pByte59Bit3 = (temp >> 3) & 0x01;
  @sysvar::SysVar_PROXI::pByte59Bit4 = (temp >> 4) & 0x01;
  @sysvar::SysVar_PROXI::pByte59Bit5 = (temp >> 5) & 0x01;
  @sysvar::SysVar_PROXI::pByte59Bit6 = (temp >> 6) & 0x01;
  @sysvar::SysVar_PROXI::pByte59Bit7 = (temp >> 7) & 0x01;
    
  temp = PROXI_bDataBuffer[59];
  @sysvar::SysVar_PROXI::pByte60Bit0 =  temp     & 0x01;
  @sysvar::SysVar_PROXI::pByte60Bit1 = (temp >> 1) & 0x01;
  @sysvar::SysVar_PROXI::pByte60Bit2 = (temp >> 2) & 0x01;
  @sysvar::SysVar_PROXI::pByte60Bit3 = (temp >> 3) & 0x01;
  @sysvar::SysVar_PROXI::pByte60Bit4 = (temp >> 4) & 0x01;
  @sysvar::SysVar_PROXI::pByte60Bit5 = (temp >> 5) & 0x01;
  @sysvar::SysVar_PROXI::pByte60Bit6 = (temp >> 6) & 0x01;
  @sysvar::SysVar_PROXI::pByte60Bit7 = (temp >> 7) & 0x01;
      
  temp = PROXI_bDataBuffer[60];
//  @sysvar::SysVar_PROXI::pByte61Bit0 =  temp     & 0x01;
//  @sysvar::SysVar_PROXI::pByte61Bit1 = (temp >> 1) & 0x01;
//  @sysvar::SysVar_PROXI::pByte61Bit2 = (temp >> 2) & 0x01;
  @sysvar::SysVar_PROXI::pByte61Bit012 = temp & 0x07;
  @sysvar::SysVar_PROXI::pByte61Bit3 = (temp >> 3) & 0x01;
  @sysvar::SysVar_PROXI::pByte61Bit4 = (temp >> 4) & 0x01;
  @sysvar::SysVar_PROXI::pByte61Bit5 = (temp >> 5) & 0x01;
  @sysvar::SysVar_PROXI::pByte61Bit6 = (temp >> 6) & 0x01;
  @sysvar::SysVar_PROXI::pByte61Bit7 = (temp >> 7) & 0x01;
      
  temp = PROXI_bDataBuffer[61];
  @sysvar::SysVar_PROXI::pByte62Bit0 =  temp     & 0x01;
  @sysvar::SysVar_PROXI::pByte62Bit1 = (temp >> 1) & 0x01;
  @sysvar::SysVar_PROXI::pByte62Bit2 = (temp >> 2) & 0x01;
  @sysvar::SysVar_PROXI::pByte62Bit3 = (temp >> 3) & 0x01;
  @sysvar::SysVar_PROXI::pByte62Bit4 = (temp >> 4) & 0x01;
  @sysvar::SysVar_PROXI::pByte62Bit5 = (temp >> 5) & 0x01;
  @sysvar::SysVar_PROXI::pByte62Bit6 = (temp >> 6) & 0x01;
  @sysvar::SysVar_PROXI::pByte62Bit7 = (temp >> 7) & 0x01;
      
  temp = PROXI_bDataBuffer[62];
  @sysvar::SysVar_PROXI::pByte63Bit0 =  temp     & 0x01;
  @sysvar::SysVar_PROXI::pByte63Bit1 = (temp >> 1) & 0x01;
  @sysvar::SysVar_PROXI::pByte63Bit2 = (temp >> 2) & 0x01;
  @sysvar::SysVar_PROXI::pByte63Bit3 = (temp >> 3) & 0x01;
//  @sysvar::SysVar_PROXI::pByte63Bit4 = (temp >> 4) & 0x01;
//  @sysvar::SysVar_PROXI::pByte63Bit5 = (temp >> 5) & 0x01;
//  @sysvar::SysVar_PROXI::pByte63Bit6 = (temp >> 6) & 0x01;
  @sysvar::SysVar_PROXI::pByte63bit456 = (temp >> 4) & 0x07;
  @sysvar::SysVar_PROXI::pByte63Bit7 = (temp >> 7) & 0x01;
      
  temp = PROXI_bDataBuffer[63];
  @sysvar::SysVar_PROXI::pByte64Bit0 =  temp     & 0x01;
  @sysvar::SysVar_PROXI::pByte64Bit1 = (temp >> 1) & 0x01;
  @sysvar::SysVar_PROXI::pByte64Bit2 = (temp >> 2) & 0x01;
  @sysvar::SysVar_PROXI::pByte64Bit3 = (temp >> 3) & 0x01;
  @sysvar::SysVar_PROXI::pByte64Bit4 = (temp >> 4) & 0x01;
  @sysvar::SysVar_PROXI::pByte64Bit5 = (temp >> 5) & 0x01;
  @sysvar::SysVar_PROXI::pByte64Bit6 = (temp >> 6) & 0x01;
  @sysvar::SysVar_PROXI::pByte64Bit7 = (temp >> 7) & 0x01;
      
  temp = PROXI_bDataBuffer[64];
  @sysvar::SysVar_PROXI::pByte65Bit0 =  temp     & 0x01;
  @sysvar::SysVar_PROXI::pByte65Bit1 = (temp >> 1) & 0x01;
  @sysvar::SysVar_PROXI::pByte65Bit2 = (temp >> 2) & 0x01;
  @sysvar::SysVar_PROXI::pByte65Bit3 = (temp >> 3) & 0x01;
  @sysvar::SysVar_PROXI::pByte65Bit4 = (temp >> 4) & 0x01;
  @sysvar::SysVar_PROXI::pByte65Bit5 = (temp >> 5) & 0x01;
  @sysvar::SysVar_PROXI::pByte65Bit6 = (temp >> 6) & 0x01;
  @sysvar::SysVar_PROXI::pByte65Bit7 = (temp >> 7) & 0x01;
      
  temp = PROXI_bDataBuffer[65];
  @sysvar::SysVar_PROXI::pByte66Bit0 =  temp     & 0x01;
  @sysvar::SysVar_PROXI::pByte66Bit1 = (temp >> 1) & 0x01;
  @sysvar::SysVar_PROXI::pByte66Bit2 = (temp >> 2) & 0x01;
  @sysvar::SysVar_PROXI::pByte66Bit3 = (temp >> 3) & 0x01;
//  @sysvar::SysVar_PROXI::pByte66Bit4 = (temp >> 4) & 0x01;
//  @sysvar::SysVar_PROXI::pByte66Bit5 = (temp >> 5) & 0x01;
//  @sysvar::SysVar_PROXI::pByte66Bit6 = (temp >> 6) & 0x01;
//  @sysvar::SysVar_PROXI::pByte66Bit7 = (temp >> 7) & 0x01;
  @sysvar::SysVar_PROXI::pByte66Bit4567 = (temp >> 4) & 0x0F;
      
  temp = PROXI_bDataBuffer[66];
  @sysvar::SysVar_PROXI::pByte67Bit0 =  temp     & 0x01;
  @sysvar::SysVar_PROXI::pByte67Bit1 = (temp >> 1) & 0x01;
  @sysvar::SysVar_PROXI::pByte67Bit2 = (temp >> 2) & 0x01;
  @sysvar::SysVar_PROXI::pByte67Bit3 = (temp >> 3) & 0x01;
  @sysvar::SysVar_PROXI::pByte67Bit4 = (temp >> 4) & 0x01;
  @sysvar::SysVar_PROXI::pByte67Bit5 = (temp >> 5) & 0x01;
  @sysvar::SysVar_PROXI::pByte67Bit6 = (temp >> 6) & 0x01;
  @sysvar::SysVar_PROXI::pByte67Bit7 = (temp >> 7) & 0x01;
  @sysvar::SysVar_PROXI::pByte67 = temp;
  @sysvar::SysVar_PROXI::pByte67A = @sysvar::SysVar_PROXI::pByte67 + 9 ;
  
  temp = PROXI_bDataBuffer[67];
//  @sysvar::SysVar_PROXI::pByte68Bit0 =  temp     & 0x01;
//  @sysvar::SysVar_PROXI::pByte68Bit1 = (temp >> 1) & 0x01;
//  @sysvar::SysVar_PROXI::pByte68Bit2 = (temp >> 2) & 0x01;
//  @sysvar::SysVar_PROXI::pByte68Bit3 = (temp >> 3) & 0x01;
//  @sysvar::SysVar_PROXI::pByte68Bit4 = (temp >> 4) & 0x01;
  @sysvar::SysVar_PROXI::pByte68Bit01234= temp & 0x1F;
  @sysvar::SysVar_PROXI::pByte68Bit5 = (temp >> 5) & 0x01;
  @sysvar::SysVar_PROXI::pByte68Bit6 = (temp >> 6) & 0x01;
  @sysvar::SysVar_PROXI::pByte68Bit7 = (temp >> 7) & 0x01;
      
  temp = PROXI_bDataBuffer[68];
//@sysvar::SysVar_PROXI::pByte69Bit0  =  temp       & 0x01;
//@sysvar::SysVar_PROXI::pByte69Bit1  = (temp >> 1) & 0x01;
  @sysvar::SysVar_PROXI::pByte69Bit01 =  temp       & 0x03;
  @sysvar::SysVar_PROXI::pByte69Bit2  = (temp >> 2) & 0x01;
//@sysvar::SysVar_PROXI::pByte69Bit3  = (temp >> 3) & 0x01;
//@sysvar::SysVar_PROXI::pByte69Bit4  = (temp >> 4) & 0x01;
  @sysvar::SysVar_PROXI::pByte69Bit34 = (temp >> 3) & 0x03;
  @sysvar::SysVar_PROXI::pByte69Bit5  = (temp >> 5) & 0x01;
  @sysvar::SysVar_PROXI::pByte69Bit6  = (temp >> 6) & 0x01;
  @sysvar::SysVar_PROXI::pByte69Bit7  = (temp >> 7) & 0x01;
      
  temp = PROXI_bDataBuffer[69];
  @sysvar::SysVar_PROXI::pByte70Bit0 =  temp     & 0x01;
  @sysvar::SysVar_PROXI::pByte70Bit1 = (temp >> 1) & 0x01;
//  @sysvar::SysVar_PROXI::pByte70Bit2 = (temp >> 2) & 0x01;
//  @sysvar::SysVar_PROXI::pByte70Bit3 = (temp >> 3) & 0x01;
  @sysvar::SysVar_PROXI::pByte70Bit23 = (temp >> 2) & 0x03;
  @sysvar::SysVar_PROXI::pByte70Bit4 = (temp >> 4) & 0x01;
  @sysvar::SysVar_PROXI::pByte70Bit5 = (temp >> 5) & 0x01;
  @sysvar::SysVar_PROXI::pByte70Bit6 = (temp >> 6) & 0x01;
  @sysvar::SysVar_PROXI::pByte70Bit7 = (temp >> 7) & 0x01;
      
  temp = PROXI_bDataBuffer[70];
  @sysvar::SysVar_PROXI::pByte71Bit0 =  temp     & 0x01;
  @sysvar::SysVar_PROXI::pByte71Bit1 = (temp >> 1) & 0x01;
  @sysvar::SysVar_PROXI::pByte71Bit2 = (temp >> 2) & 0x01;
  @sysvar::SysVar_PROXI::pByte71Bit3 = (temp >> 3) & 0x01;
  @sysvar::SysVar_PROXI::pByte71Bit4 = (temp >> 4) & 0x01;
  @sysvar::SysVar_PROXI::pByte71Bit5 = (temp >> 5) & 0x01;
  @sysvar::SysVar_PROXI::pByte71Bit6 = (temp >> 6) & 0x01;
  @sysvar::SysVar_PROXI::pByte71Bit7 = (temp >> 7) & 0x01;
      
  temp = PROXI_bDataBuffer[71];
  @sysvar::SysVar_PROXI::pByte72Bit0 =  temp     & 0x01;
  @sysvar::SysVar_PROXI::pByte72Bit1 = (temp >> 1) & 0x01;
  @sysvar::SysVar_PROXI::pByte72Bit2 = (temp >> 2) & 0x01;
  @sysvar::SysVar_PROXI::pByte72Bit3 = (temp >> 3) & 0x01;
  @sysvar::SysVar_PROXI::pByte72Bit4 = (temp >> 4) & 0x01;
  @sysvar::SysVar_PROXI::pByte72Bit5 = (temp >> 5) & 0x01;
  @sysvar::SysVar_PROXI::pByte72Bit6 = (temp >> 6) & 0x01;
  @sysvar::SysVar_PROXI::pByte72Bit7 = (temp >> 7) & 0x01;
      
  temp = PROXI_bDataBuffer[72];
//  @sysvar::SysVar_PROXI::pByte73Bit0 =  temp     & 0x01;
//  @sysvar::SysVar_PROXI::pByte73Bit1 = (temp >> 1) & 0x01;
//  @sysvar::SysVar_PROXI::pByte73Bit2 = (temp >> 2) & 0x01;
//  @sysvar::SysVar_PROXI::pByte73Bit3 = (temp >> 3) & 0x01;
//  @sysvar::SysVar_PROXI::pByte73Bit4 = (temp >> 4) & 0x01;
//  @sysvar::SysVar_PROXI::pByte73Bit5 = (temp >> 5) & 0x01;
//  @sysvar::SysVar_PROXI::pByte73Bit6 = (temp >> 6) & 0x01;
//  @sysvar::SysVar_PROXI::pByte73Bit7 = (temp >> 7) & 0x01;
    @sysvar::SysVar_PROXI::pByte73 = temp;
  
  temp = PROXI_bDataBuffer[73];
  @sysvar::SysVar_PROXI::pByte74Bit0 =  temp     & 0x01;
  @sysvar::SysVar_PROXI::pByte74Bit1 = (temp >> 1) & 0x01;
  @sysvar::SysVar_PROXI::pByte74Bit2 = (temp >> 2) & 0x01;
  @sysvar::SysVar_PROXI::pByte74Bit3 = (temp >> 3) & 0x01;
//  @sysvar::SysVar_PROXI::pByte74Bit4 = (temp >> 4) & 0x01;
//  @sysvar::SysVar_PROXI::pByte74Bit5 = (temp >> 5) & 0x01;
//  @sysvar::SysVar_PROXI::pByte74Bit6 = (temp >> 6) & 0x01;
//  @sysvar::SysVar_PROXI::pByte74Bit7 = (temp >> 7) & 0x01;
  @sysvar::SysVar_PROXI::pByte74Bit4567 = (temp >> 4) & 0x0F;
  
      
  temp = PROXI_bDataBuffer[74];
  @sysvar::SysVar_PROXI::pByte75Bit0 =  temp     & 0x01;
  @sysvar::SysVar_PROXI::pByte75Bit1 = (temp >> 1) & 0x01;
  @sysvar::SysVar_PROXI::pByte75Bit2 = (temp >> 2) & 0x01;
  @sysvar::SysVar_PROXI::pByte75Bit3 = (temp >> 3) & 0x01;
  @sysvar::SysVar_PROXI::pByte75Bit4 = (temp >> 4) & 0x01;
  @sysvar::SysVar_PROXI::pByte75Bit5 = (temp >> 5) & 0x01;
  @sysvar::SysVar_PROXI::pByte75Bit6 = (temp >> 6) & 0x01;
  @sysvar::SysVar_PROXI::pByte75Bit7 = (temp >> 7) & 0x01;
  @sysvar::SysVar_PROXI::pByte75 = temp;
      
  temp = PROXI_bDataBuffer[75];
  @sysvar::SysVar_PROXI::pByte76Bit0 =  temp     & 0x01;
  @sysvar::SysVar_PROXI::pByte76Bit1 = (temp >> 1) & 0x01;
  @sysvar::SysVar_PROXI::pByte76Bit2 = (temp >> 2) & 0x01;
  @sysvar::SysVar_PROXI::pByte76Bit3 = (temp >> 3) & 0x01;
//  @sysvar::SysVar_PROXI::pByte76Bit4 = (temp >> 4) & 0x01;
//  @sysvar::SysVar_PROXI::pByte76Bit5 = (temp >> 5) & 0x01;
//  @sysvar::SysVar_PROXI::pByte76Bit6 = (temp >> 6) & 0x01;
//  @sysvar::SysVar_PROXI::pByte76Bit7 = (temp >> 7) & 0x01;
  @sysvar::SysVar_PROXI::pByte76Bit4567 = (temp >> 4) & 0x0F;
  @sysvar::SysVar_PROXI::pByte76Bit4567_327 = @sysvar::SysVar_PROXI::pByte76Bit4567;
      
  temp = PROXI_bDataBuffer[76];
  @sysvar::SysVar_PROXI::pByte77Bit0 =  temp     & 0x01;
  @sysvar::SysVar_PROXI::pByte77Bit1 = (temp >> 1) & 0x01;
  @sysvar::SysVar_PROXI::pByte77Bit2 = (temp >> 2) & 0x01;
  @sysvar::SysVar_PROXI::pByte77Bit3 = (temp >> 3) & 0x01;
  @sysvar::SysVar_PROXI::pByte77Bit4 = (temp >> 4) & 0x01;
  @sysvar::SysVar_PROXI::pByte77Bit5 = (temp >> 5) & 0x01;
  @sysvar::SysVar_PROXI::pByte77Bit6 = (temp >> 6) & 0x01;
  @sysvar::SysVar_PROXI::pByte77Bit7 = (temp >> 7) & 0x01;
      
  temp = PROXI_bDataBuffer[77];
  @sysvar::SysVar_PROXI::pByte78Bit0 =  temp     & 0x01;
  @sysvar::SysVar_PROXI::pByte78Bit1 = (temp >> 1) & 0x01;
  @sysvar::SysVar_PROXI::pByte78Bit2 = (temp >> 2) & 0x01;
//  @sysvar::SysVar_PROXI::pByte78Bit3 = (temp >> 3) & 0x01;
//  @sysvar::SysVar_PROXI::pByte78Bit4 = (temp >> 4) & 0x01;
  @sysvar::SysVar_PROXI::pByte78Bit34 = (temp >> 3) & 0x03;
  @sysvar::SysVar_PROXI::pByte78Bit5 = (temp >> 5) & 0x01;
  @sysvar::SysVar_PROXI::pByte78Bit6 = (temp >> 6) & 0x01;
  @sysvar::SysVar_PROXI::pByte78Bit7 = (temp >> 7) & 0x01;
      
  temp = PROXI_bDataBuffer[78];
  @sysvar::SysVar_PROXI::pByte79Bit0 =  temp     & 0x01;
  @sysvar::SysVar_PROXI::pByte79Bit1 = (temp >> 1) & 0x01;
//  @sysvar::SysVar_PROXI::pByte79Bit2 = (temp >> 2) & 0x01;
//  @sysvar::SysVar_PROXI::pByte79Bit3 = (temp >> 3) & 0x01;
  @sysvar::SysVar_PROXI::pByte79Bit23 = (temp >> 2) & 0x03;
  @sysvar::SysVar_PROXI::pByte79Bit4 = (temp >> 4) & 0x01;
  @sysvar::SysVar_PROXI::pByte79Bit5 = (temp >> 5) & 0x01;
  @sysvar::SysVar_PROXI::pByte79Bit6 = (temp >> 6) & 0x01;
  @sysvar::SysVar_PROXI::pByte79Bit7 = (temp >> 7) & 0x01;
      
  temp = PROXI_bDataBuffer[79];
  @sysvar::SysVar_PROXI::pByte80Bit0 =  temp     & 0x01;
  @sysvar::SysVar_PROXI::pByte80Bit1 = (temp >> 1) & 0x01;
  @sysvar::SysVar_PROXI::pByte80Bit2 = (temp >> 2) & 0x01;
  @sysvar::SysVar_PROXI::pByte80Bit3 = (temp >> 3) & 0x01;
  @sysvar::SysVar_PROXI::pByte80Bit4 = (temp >> 4) & 0x01;
  @sysvar::SysVar_PROXI::pByte80Bit5 = (temp >> 5) & 0x01;
  @sysvar::SysVar_PROXI::pByte80Bit6 = (temp >> 6) & 0x01;
  @sysvar::SysVar_PROXI::pByte80Bit7 = (temp >> 7) & 0x01;
      
  temp = PROXI_bDataBuffer[80];
  @sysvar::SysVar_PROXI::pByte81Bit0 =  temp     & 0x01;
  @sysvar::SysVar_PROXI::pByte81Bit1 = (temp >> 1) & 0x01;
  @sysvar::SysVar_PROXI::pByte81Bit2 = (temp >> 2) & 0x01;
  @sysvar::SysVar_PROXI::pByte81Bit3 = (temp >> 3) & 0x01;
  @sysvar::SysVar_PROXI::pByte81Bit4 = (temp >> 4) & 0x01;
  @sysvar::SysVar_PROXI::pByte81Bit5 = (temp >> 5) & 0x01;
  @sysvar::SysVar_PROXI::pByte81Bit6 = (temp >> 6) & 0x01;
  @sysvar::SysVar_PROXI::pByte81Bit7 = (temp >> 7) & 0x01;
      
  temp = PROXI_bDataBuffer[81];
  @sysvar::SysVar_PROXI::pByte82Bit0 =  temp     & 0x01;
  @sysvar::SysVar_PROXI::pByte82Bit1 = (temp >> 1) & 0x01;
  @sysvar::SysVar_PROXI::pByte82Bit2 = (temp >> 2) & 0x01;
  @sysvar::SysVar_PROXI::pByte82Bit3 = (temp >> 3) & 0x01;
  @sysvar::SysVar_PROXI::pByte82Bit4 = (temp >> 4) & 0x01;
  @sysvar::SysVar_PROXI::pByte82Bit5 = (temp >> 5) & 0x01;
  @sysvar::SysVar_PROXI::pByte82Bit6 = (temp >> 6) & 0x01;
  @sysvar::SysVar_PROXI::pByte82Bit7 = (temp >> 7) & 0x01;
      
  temp = PROXI_bDataBuffer[82];
  @sysvar::SysVar_PROXI::pByte83Bit0 =  temp     & 0x01;
  @sysvar::SysVar_PROXI::pByte83Bit1 = (temp >> 1) & 0x01;
  @sysvar::SysVar_PROXI::pByte83Bit2 = (temp >> 2) & 0x01;
  @sysvar::SysVar_PROXI::pByte83Bit3 = (temp >> 3) & 0x01;
  @sysvar::SysVar_PROXI::pByte83Bit4 = (temp >> 4) & 0x01;
  @sysvar::SysVar_PROXI::pByte83Bit5 = (temp >> 5) & 0x01;
  @sysvar::SysVar_PROXI::pByte83Bit6 = (temp >> 6) & 0x01;
  @sysvar::SysVar_PROXI::pByte83Bit7 = (temp >> 7) & 0x01;
    
  temp = PROXI_bDataBuffer[83];
  @sysvar::SysVar_PROXI::pByte84Bit0 =  temp     & 0x01;
  @sysvar::SysVar_PROXI::pByte84Bit1 = (temp >> 1) & 0x01;
  @sysvar::SysVar_PROXI::pByte84Bit2 = (temp >> 2) & 0x01;
  @sysvar::SysVar_PROXI::pByte84Bit3 = (temp >> 3) & 0x01;
  @sysvar::SysVar_PROXI::pByte84Bit4 = (temp >> 4) & 0x01;
  @sysvar::SysVar_PROXI::pByte84Bit5 = (temp >> 5) & 0x01;
  @sysvar::SysVar_PROXI::pByte84Bit6 = (temp >> 6) & 0x01;
  @sysvar::SysVar_PROXI::pByte84Bit7 = (temp >> 7) & 0x01;
    
  temp = PROXI_bDataBuffer[84];
  @sysvar::SysVar_PROXI::pByte85Bit0 =  temp     & 0x01;
  @sysvar::SysVar_PROXI::pByte85Bit1 = (temp >> 1) & 0x01;
  @sysvar::SysVar_PROXI::pByte85Bit2 = (temp >> 2) & 0x01;
  @sysvar::SysVar_PROXI::pByte85Bit3 = (temp >> 3) & 0x01;
  @sysvar::SysVar_PROXI::pByte85Bit4 = (temp >> 4) & 0x01;
  @sysvar::SysVar_PROXI::pByte85Bit5 = (temp >> 5) & 0x01;
  @sysvar::SysVar_PROXI::pByte85Bit6 = (temp >> 6) & 0x01;
  @sysvar::SysVar_PROXI::pByte85Bit7 = (temp >> 7) & 0x01;
      
  temp = PROXI_bDataBuffer[85];
  @sysvar::SysVar_PROXI::pByte86Bit0 =  temp     & 0x01;
//  @sysvar::SysVar_PROXI::pByte86Bit1 = (temp >> 1) & 0x01;
//  @sysvar::SysVar_PROXI::pByte86Bit2 = (temp >> 2) & 0x01;
  @sysvar::SysVar_PROXI::pByte86Bit12 = (temp >> 1) & 0x03;
//  @sysvar::SysVar_PROXI::pByte86Bit3 = (temp >> 3) & 0x01;
//  @sysvar::SysVar_PROXI::pByte86Bit4 = (temp >> 4) & 0x01;
  @sysvar::SysVar_PROXI::pByte86Bit34 = (temp >> 3) & 0x03;
  @sysvar::SysVar_PROXI::pByte86Bit5 = (temp >> 5) & 0x01;
  @sysvar::SysVar_PROXI::pByte86Bit6 = (temp >> 6) & 0x01;
  @sysvar::SysVar_PROXI::pByte86Bit7 = (temp >> 7) & 0x01;
      
  temp = PROXI_bDataBuffer[86];
//  @sysvar::SysVar_PROXI::pByte87Bit0 =  temp     & 0x01;
//  @sysvar::SysVar_PROXI::pByte87Bit1 = (temp >> 1) & 0x01;
//  @sysvar::SysVar_PROXI::pByte87Bit2 = (temp >> 2) & 0x01;
  @sysvar::SysVar_PROXI::pByte87Bit012 = temp & 0x03;  
  @sysvar::SysVar_PROXI::pByte87Bit3 = (temp >> 3) & 0x01;
  @sysvar::SysVar_PROXI::pByte87Bit4 = (temp >> 4) & 0x01;
  @sysvar::SysVar_PROXI::pByte87Bit5 = (temp >> 5) & 0x01;
  @sysvar::SysVar_PROXI::pByte87Bit6 = (temp >> 6) & 0x01;
  @sysvar::SysVar_PROXI::pByte87Bit7 = (temp >> 7) & 0x01;
      
  temp = PROXI_bDataBuffer[87];
//  @sysvar::SysVar_PROXI::pByte88Bit0 =  temp     & 0x01;
//  @sysvar::SysVar_PROXI::pByte88Bit1 = (temp >> 1) & 0x01;
  @sysvar::SysVar_PROXI::pByte88Bit01 = temp & 0x03;
  @sysvar::SysVar_PROXI::pByte88Bit2 = (temp >> 2) & 0x01;
  @sysvar::SysVar_PROXI::pByte88Bit3 = (temp >> 3) & 0x01;
  @sysvar::SysVar_PROXI::pByte88Bit4 = (temp >> 4) & 0x01;
//  @sysvar::SysVar_PROXI::pByte88Bit5 = (temp >> 5) & 0x01;
//  @sysvar::SysVar_PROXI::pByte88Bit6 = (temp >> 6) & 0x01;
  @sysvar::SysVar_PROXI::pByte88Bit56 = (temp >> 5) & 0x03;
  @sysvar::SysVar_PROXI::pByte88Bit7 = (temp >> 7) & 0x01;
      
  temp = PROXI_bDataBuffer[88];
  @sysvar::SysVar_PROXI::pByte89Bit0 =  temp     & 0x01;
  @sysvar::SysVar_PROXI::pByte89Bit1 = (temp >> 1) & 0x01;
  @sysvar::SysVar_PROXI::pByte89Bit2 = (temp >> 2) & 0x01;
  @sysvar::SysVar_PROXI::pByte89Bit3 = (temp >> 3) & 0x01;
  @sysvar::SysVar_PROXI::pByte89Bit4 = (temp >> 4) & 0x01;
  @sysvar::SysVar_PROXI::pByte89Bit5 = (temp >> 5) & 0x01;
  @sysvar::SysVar_PROXI::pByte89Bit6 = (temp >> 6) & 0x01;
  @sysvar::SysVar_PROXI::pByte89Bit7 = (temp >> 7) & 0x01;
      
  temp = PROXI_bDataBuffer[89];
  @sysvar::SysVar_PROXI::pByte90Bit0 =  temp     & 0x01;
  @sysvar::SysVar_PROXI::pByte90Bit1 = (temp >> 1) & 0x01;
  @sysvar::SysVar_PROXI::pByte90Bit2 = (temp >> 2) & 0x01;
  @sysvar::SysVar_PROXI::pByte90Bit3 = (temp >> 3) & 0x01;
  @sysvar::SysVar_PROXI::pByte90Bit4 = (temp >> 4) & 0x01;
  @sysvar::SysVar_PROXI::pByte90Bit5 = (temp >> 5) & 0x01;
  @sysvar::SysVar_PROXI::pByte90Bit6 = (temp >> 6) & 0x01;
  @sysvar::SysVar_PROXI::pByte90Bit7 = (temp >> 7) & 0x01;
    
  temp = PROXI_bDataBuffer[90];
  @sysvar::SysVar_PROXI::pByte91Bit0 =  temp     & 0x01;
  @sysvar::SysVar_PROXI::pByte91Bit1 = (temp >> 1) & 0x01;
  @sysvar::SysVar_PROXI::pByte91Bit2 = (temp >> 2) & 0x01;
  @sysvar::SysVar_PROXI::pByte91Bit3 = (temp >> 3) & 0x01;
  @sysvar::SysVar_PROXI::pByte91Bit4 = (temp >> 4) & 0x01;
//  @sysvar::SysVar_PROXI::pByte91Bit5 = (temp >> 5) & 0x01;
//  @sysvar::SysVar_PROXI::pByte91Bit6 = (temp >> 6) & 0x01;
//  @sysvar::SysVar_PROXI::pByte91Bit7 = (temp >> 7) & 0x01;
  @sysvar::SysVar_PROXI::pByte91Bit567 = (temp >> 5) & 0x07;
      
  temp = PROXI_bDataBuffer[91];
  @sysvar::SysVar_PROXI::pByte92Bit0 =  temp     & 0x01;
  @sysvar::SysVar_PROXI::pByte92Bit1 = (temp >> 1) & 0x01;
  @sysvar::SysVar_PROXI::pByte92Bit2 = (temp >> 2) & 0x01;
  @sysvar::SysVar_PROXI::pByte92Bit3 = (temp >> 3) & 0x01;
  @sysvar::SysVar_PROXI::pByte92Bit4 = (temp >> 4) & 0x01;
  @sysvar::SysVar_PROXI::pByte92Bit5 = (temp >> 5) & 0x01;
  @sysvar::SysVar_PROXI::pByte92Bit6 = (temp >> 6) & 0x01;
  @sysvar::SysVar_PROXI::pByte92Bit7 = (temp >> 7) & 0x01;
      
  temp = PROXI_bDataBuffer[92];
  @sysvar::SysVar_PROXI::pByte93Bit0 =  temp     & 0x01;
  @sysvar::SysVar_PROXI::pByte93Bit1 = (temp >> 1) & 0x01;
  @sysvar::SysVar_PROXI::pByte93Bit2 = (temp >> 2) & 0x01;
  @sysvar::SysVar_PROXI::pByte93Bit3 = (temp >> 3) & 0x01;
  @sysvar::SysVar_PROXI::pByte93Bit4 = (temp >> 4) & 0x01;
  @sysvar::SysVar_PROXI::pByte93Bit5 = (temp >> 5) & 0x01;
  @sysvar::SysVar_PROXI::pByte93Bit6 = (temp >> 6) & 0x01;
  @sysvar::SysVar_PROXI::pByte93Bit7 = (temp >> 7) & 0x01;
      
  temp = PROXI_bDataBuffer[93];
  @sysvar::SysVar_PROXI::pByte94Bit0 =  temp     & 0x01;
  @sysvar::SysVar_PROXI::pByte94Bit1 = (temp >> 1) & 0x01;
  @sysvar::SysVar_PROXI::pByte94Bit2 = (temp >> 2) & 0x01;
  @sysvar::SysVar_PROXI::pByte94Bit3 = (temp >> 3) & 0x01;
  @sysvar::SysVar_PROXI::pByte94Bit4 = (temp >> 4) & 0x01;
  @sysvar::SysVar_PROXI::pByte94Bit5 = (temp >> 5) & 0x01;
  @sysvar::SysVar_PROXI::pByte94Bit6 = (temp >> 6) & 0x01;
  @sysvar::SysVar_PROXI::pByte94Bit7 = (temp >> 7) & 0x01;
      
  temp = PROXI_bDataBuffer[94];
//  @sysvar::SysVar_PROXI::pByte95Bit0 =  temp     & 0x01;
//  @sysvar::SysVar_PROXI::pByte95Bit1 = (temp >> 1) & 0x01;
//  @sysvar::SysVar_PROXI::pByte95Bit2 = (temp >> 2) & 0x01;
//  @sysvar::SysVar_PROXI::pByte95Bit3 = (temp >> 3) & 0x01;
//  @sysvar::SysVar_PROXI::pByte95Bit4 = (temp >> 4) & 0x01;
  @sysvar::SysVar_PROXI::pByte95Bit01234 = temp & 0x07;
  @sysvar::SysVar_PROXI::pByte95Bit5 = (temp >> 5) & 0x01;
  @sysvar::SysVar_PROXI::pByte95Bit6 = (temp >> 6) & 0x01;
  @sysvar::SysVar_PROXI::pByte95Bit7 = (temp >> 7) & 0x01;
      
  temp = PROXI_bDataBuffer[95];
  @sysvar::SysVar_PROXI::pByte96Bit0 =  temp     & 0x01;
  @sysvar::SysVar_PROXI::pByte96Bit1 = (temp >> 1) & 0x01;
  @sysvar::SysVar_PROXI::pByte96Bit2 = (temp >> 2) & 0x01;
  @sysvar::SysVar_PROXI::pByte96Bit3 = (temp >> 3) & 0x01;
  @sysvar::SysVar_PROXI::pByte96Bit4 = (temp >> 4) & 0x01;
  @sysvar::SysVar_PROXI::pByte96Bit5 = (temp >> 5) & 0x01;
  @sysvar::SysVar_PROXI::pByte96Bit6 = (temp >> 6) & 0x01;
  @sysvar::SysVar_PROXI::pByte96Bit7 = (temp >> 7) & 0x01;
      
  temp = PROXI_bDataBuffer[96];
  @sysvar::SysVar_PROXI::pByte97Bit0 =  temp     & 0x01;
  @sysvar::SysVar_PROXI::pByte97Bit1 = (temp >> 1) & 0x01;
  @sysvar::SysVar_PROXI::pByte97Bit2 = (temp >> 2) & 0x01;
  @sysvar::SysVar_PROXI::pByte97Bit3 = (temp >> 3) & 0x01;
  @sysvar::SysVar_PROXI::pByte97Bit4 = (temp >> 4) & 0x01;
  @sysvar::SysVar_PROXI::pByte97Bit5 = (temp >> 5) & 0x01;
  @sysvar::SysVar_PROXI::pByte97Bit6 = (temp >> 6) & 0x01;
  @sysvar::SysVar_PROXI::pByte97Bit7 = (temp >> 7) & 0x01;
      
  temp = PROXI_bDataBuffer[97];
  @sysvar::SysVar_PROXI::pByte98Bit0 =  temp     & 0x01;
  @sysvar::SysVar_PROXI::pByte98Bit1 = (temp >> 1) & 0x01;
  @sysvar::SysVar_PROXI::pByte98Bit2 = (temp >> 2) & 0x01;
  @sysvar::SysVar_PROXI::pByte98Bit3 = (temp >> 3) & 0x01;
  @sysvar::SysVar_PROXI::pByte98Bit4 = (temp >> 4) & 0x01;
  @sysvar::SysVar_PROXI::pByte98Bit5 = (temp >> 5) & 0x01;
  @sysvar::SysVar_PROXI::pByte98Bit6 = (temp >> 6) & 0x01;
  @sysvar::SysVar_PROXI::pByte98Bit7 = (temp >> 7) & 0x01;
      
  temp = PROXI_bDataBuffer[98];
  @sysvar::SysVar_PROXI::pByte99Bit0 =  temp     & 0x01;
  @sysvar::SysVar_PROXI::pByte99Bit1 = (temp >> 1) & 0x01;
  @sysvar::SysVar_PROXI::pByte99Bit2 = (temp >> 2) & 0x01;
  @sysvar::SysVar_PROXI::pByte99Bit3 = (temp >> 3) & 0x01;
  @sysvar::SysVar_PROXI::pByte99Bit4 = (temp >> 4) & 0x01;
  @sysvar::SysVar_PROXI::pByte99Bit5 = (temp >> 5) & 0x01;
  @sysvar::SysVar_PROXI::pByte99Bit6 = (temp >> 6) & 0x01;
  @sysvar::SysVar_PROXI::pByte99Bit7 = (temp >> 7) & 0x01;
      
  temp = PROXI_bDataBuffer[99];
  @sysvar::SysVar_PROXI::pByte100Bit0 =  temp     & 0x01;
  @sysvar::SysVar_PROXI::pByte100Bit1 = (temp >> 1) & 0x01;
  @sysvar::SysVar_PROXI::pByte100Bit2 = (temp >> 2) & 0x01;
//  @sysvar::SysVar_PROXI::pByte100Bit3 = (temp >> 3) & 0x01;
//  @sysvar::SysVar_PROXI::pByte100Bit4 = (temp >> 4) & 0x01;
//  @sysvar::SysVar_PROXI::pByte100Bit5 = (temp >> 5) & 0x01;
//  @sysvar::SysVar_PROXI::pByte100Bit6 = (temp >> 6) & 0x01;
//  @sysvar::SysVar_PROXI::pByte100Bit7 = (temp >> 7) & 0x01;
  @sysvar::SysVar_PROXI::pByte100Bit34567 = (temp >> 3) & 0x07;
    
  temp = PROXI_bDataBuffer[100];
//  @sysvar::SysVar_PROXI::pByte101Bit0 =  temp     & 0x01;
//  @sysvar::SysVar_PROXI::pByte101Bit1 = (temp >> 1) & 0x01;
//  @sysvar::SysVar_PROXI::pByte101Bit2 = (temp >> 2) & 0x01;
  @sysvar::SysVar_PROXI::pByte101Bit012 = temp & 0x07;  
//  @sysvar::SysVar_PROXI::pByte101Bit3 = (temp >> 3) & 0x01;
//  @sysvar::SysVar_PROXI::pByte101Bit4 = (temp >> 4) & 0x01;
  @sysvar::SysVar_PROXI::pByte101Bit34 = (temp >> 3) & 0x03;
  @sysvar::SysVar_PROXI::pByte101Bit5 = (temp >> 5) & 0x01;
  @sysvar::SysVar_PROXI::pByte101Bit6 = (temp >> 6) & 0x01;
  @sysvar::SysVar_PROXI::pByte101Bit7 = (temp >> 7) & 0x01;
      
  temp = PROXI_bDataBuffer[101];
  @sysvar::SysVar_PROXI::pByte102Bit0 =  temp     & 0x01;
  @sysvar::SysVar_PROXI::pByte102Bit1 = (temp >> 1) & 0x01;
  @sysvar::SysVar_PROXI::pByte102Bit2 = (temp >> 2) & 0x01;
  @sysvar::SysVar_PROXI::pByte102Bit3 = (temp >> 3) & 0x01;
  @sysvar::SysVar_PROXI::pByte102Bit4 = (temp >> 4) & 0x01;
  @sysvar::SysVar_PROXI::pByte102Bit5 = (temp >> 5) & 0x01;
  @sysvar::SysVar_PROXI::pByte102Bit6 = (temp >> 6) & 0x01;
  @sysvar::SysVar_PROXI::pByte102Bit7 = (temp >> 7) & 0x01;
      
  temp = PROXI_bDataBuffer[102];
  @sysvar::SysVar_PROXI::pByte103Bit0 =  temp     & 0x01;
  @sysvar::SysVar_PROXI::pByte103Bit1 = (temp >> 1) & 0x01;
  @sysvar::SysVar_PROXI::pByte103Bit2 = (temp >> 2) & 0x01;
  @sysvar::SysVar_PROXI::pByte103Bit3 = (temp >> 3) & 0x01;
  @sysvar::SysVar_PROXI::pByte103Bit4 = (temp >> 4) & 0x01;
  @sysvar::SysVar_PROXI::pByte103Bit5 = (temp >> 5) & 0x01;
  @sysvar::SysVar_PROXI::pByte103Bit6 = (temp >> 6) & 0x01;
  @sysvar::SysVar_PROXI::pByte103Bit7 = (temp >> 7) & 0x01;
      
  temp = PROXI_bDataBuffer[103];
  @sysvar::SysVar_PROXI::pByte104Bit0 =  temp     & 0x01;
  @sysvar::SysVar_PROXI::pByte104Bit1 = (temp >> 1) & 0x01;
  @sysvar::SysVar_PROXI::pByte104Bit2 = (temp >> 2) & 0x01;
  @sysvar::SysVar_PROXI::pByte104Bit3 = (temp >> 3) & 0x01;
  @sysvar::SysVar_PROXI::pByte104Bit4 = (temp >> 4) & 0x01;
  @sysvar::SysVar_PROXI::pByte104Bit5 = (temp >> 5) & 0x01;
  @sysvar::SysVar_PROXI::pByte104Bit6 = (temp >> 6) & 0x01;
  @sysvar::SysVar_PROXI::pByte104Bit7 = (temp >> 7) & 0x01;
      
  temp = PROXI_bDataBuffer[104];
//  @sysvar::SysVar_PROXI::pByte105Bit0 =  temp     & 0x01;
//  @sysvar::SysVar_PROXI::pByte105Bit1 = (temp >> 1) & 0x01;
//  @sysvar::SysVar_PROXI::pByte105Bit2 = (temp >> 2) & 0x01;
//  @sysvar::SysVar_PROXI::pByte105Bit3 = (temp >> 3) & 0x01;
//  @sysvar::SysVar_PROXI::pByte105Bit4 = (temp >> 4) & 0x01;
//  @sysvar::SysVar_PROXI::pByte105Bit5 = (temp >> 5) & 0x01;
//  @sysvar::SysVar_PROXI::pByte105Bit6 = (temp >> 6) & 0x01;
//  @sysvar::SysVar_PROXI::pByte105Bit7 = (temp >> 7) & 0x01;
  @sysvar::SysVar_PROXI::pByte105 = temp;
      
  temp = PROXI_bDataBuffer[105];
//  @sysvar::SysVar_PROXI::pByte106Bit0 =  temp     & 0x01;
//  @sysvar::SysVar_PROXI::pByte106Bit1 = (temp >> 1) & 0x01;
//  @sysvar::SysVar_PROXI::pByte106Bit2 = (temp >> 2) & 0x01;
//  @sysvar::SysVar_PROXI::pByte106Bit3 = (temp >> 3) & 0x01;
//  @sysvar::SysVar_PROXI::pByte106Bit4 = (temp >> 4) & 0x01;
//  @sysvar::SysVar_PROXI::pByte106Bit5 = (temp >> 5) & 0x01;
//  @sysvar::SysVar_PROXI::pByte106Bit6 = (temp >> 6) & 0x01;
//  @sysvar::SysVar_PROXI::pByte106Bit7 = (temp >> 7) & 0x01;
  @sysvar::SysVar_PROXI::pByte106 = temp;

        
  temp = PROXI_bDataBuffer[106];
//  @sysvar::SysVar_PROXI::pByte107Bit0 =  temp     & 0x01;
//  @sysvar::SysVar_PROXI::pByte107Bit1 = (temp >> 1) & 0x01;
//  @sysvar::SysVar_PROXI::pByte107Bit2 = (temp >> 2) & 0x01;
//  @sysvar::SysVar_PROXI::pByte107Bit3 = (temp >> 3) & 0x01;
//  @sysvar::SysVar_PROXI::pByte107Bit4 = (temp >> 4) & 0x01;
//  @sysvar::SysVar_PROXI::pByte107Bit5 = (temp >> 5) & 0x01;
//  @sysvar::SysVar_PROXI::pByte107Bit6 = (temp >> 6) & 0x01;
//  @sysvar::SysVar_PROXI::pByte107Bit7 = (temp >> 7) & 0x01;
  @sysvar::SysVar_PROXI::pByte107 = temp;
      
  temp = PROXI_bDataBuffer[107];
  @sysvar::SysVar_PROXI::pByte108Bit0 =  temp     & 0x01;
  @sysvar::SysVar_PROXI::pByte108Bit1 = (temp >> 1) & 0x01;
  @sysvar::SysVar_PROXI::pByte108Bit2 = (temp >> 2) & 0x01;
  @sysvar::SysVar_PROXI::pByte108Bit3 = (temp >> 3) & 0x01;
  @sysvar::SysVar_PROXI::pByte108Bit4 = (temp >> 4) & 0x01;
  @sysvar::SysVar_PROXI::pByte108Bit5 = (temp >> 5) & 0x01;
  @sysvar::SysVar_PROXI::pByte108Bit6 = (temp >> 6) & 0x01;
  @sysvar::SysVar_PROXI::pByte108Bit7 = (temp >> 7) & 0x01;
      
  temp = PROXI_bDataBuffer[108];
  @sysvar::SysVar_PROXI::pByte109Bit0 =  temp     & 0x01;
  @sysvar::SysVar_PROXI::pByte109Bit1 = (temp >> 1) & 0x01;
  @sysvar::SysVar_PROXI::pByte109Bit2 = (temp >> 2) & 0x01;
  @sysvar::SysVar_PROXI::pByte109Bit3 = (temp >> 3) & 0x01;
  @sysvar::SysVar_PROXI::pByte109Bit4 = (temp >> 4) & 0x01;
  @sysvar::SysVar_PROXI::pByte109Bit5 = (temp >> 5) & 0x01;
  @sysvar::SysVar_PROXI::pByte109Bit6 = (temp >> 6) & 0x01;
  @sysvar::SysVar_PROXI::pByte109Bit7 = (temp >> 7) & 0x01;
      
  temp = PROXI_bDataBuffer[109];
  @sysvar::SysVar_PROXI::pByte110Bit0 =  temp     & 0x01;
  @sysvar::SysVar_PROXI::pByte110Bit1 = (temp >> 1) & 0x01;
  @sysvar::SysVar_PROXI::pByte110Bit2 = (temp >> 2) & 0x01;
  @sysvar::SysVar_PROXI::pByte110Bit3 = (temp >> 3) & 0x01;
  @sysvar::SysVar_PROXI::pByte110Bit4 = (temp >> 4) & 0x01;
  @sysvar::SysVar_PROXI::pByte110Bit5 = (temp >> 5) & 0x01;
  @sysvar::SysVar_PROXI::pByte110Bit6 = (temp >> 6) & 0x01;
  @sysvar::SysVar_PROXI::pByte110Bit7 = (temp >> 7) & 0x01;
      
  temp = PROXI_bDataBuffer[110];
//  @sysvar::SysVar_PROXI::pByte111Bit0 =  temp     & 0x01;
//  @sysvar::SysVar_PROXI::pByte111Bit1 = (temp >> 1) & 0x01;
//  @sysvar::SysVar_PROXI::pByte111Bit2 = (temp >> 2) & 0x01;
//  @sysvar::SysVar_PROXI::pByte111Bit3 = (temp >> 3) & 0x01;
  @sysvar::SysVar_PROXI::pByte111Bit0123 = temp & 0x0F;
//  @sysvar::SysVar_PROXI::pByte111Bit4 = (temp >> 4) & 0x01;
//  @sysvar::SysVar_PROXI::pByte111Bit5 = (temp >> 5) & 0x01;
//  @sysvar::SysVar_PROXI::pByte111Bit6 = (temp >> 6) & 0x01;
  @sysvar::SysVar_PROXI::pByte111Bit456 = (temp >> 4) & 0x07;
  @sysvar::SysVar_PROXI::pByte111Bit7 = (temp >> 7) & 0x01;
      
  temp = PROXI_bDataBuffer[111];
  @sysvar::SysVar_PROXI::pByte112Bit0 =  temp     & 0x01;
  @sysvar::SysVar_PROXI::pByte112Bit1 = (temp >> 1) & 0x01;
  @sysvar::SysVar_PROXI::pByte112Bit2 = (temp >> 2) & 0x01;
  @sysvar::SysVar_PROXI::pByte112Bit3 = (temp >> 3) & 0x01;
//  @sysvar::SysVar_PROXI::pByte112Bit4 = (temp >> 4) & 0x01;
//  @sysvar::SysVar_PROXI::pByte112Bit5 = (temp >> 5) & 0x01;
//  @sysvar::SysVar_PROXI::pByte112Bit6 = (temp >> 6) & 0x01;
  @sysvar::SysVar_PROXI::pByte112Bit456 = (temp >> 4) & 0x07;
  @sysvar::SysVar_PROXI::pByte112Bit7 = (temp >> 7) & 0x01;
      
  temp = PROXI_bDataBuffer[112];
  @sysvar::SysVar_PROXI::pByte113Bit0 =  temp     & 0x01;
  @sysvar::SysVar_PROXI::pByte113Bit1 = (temp >> 1) & 0x01;
  @sysvar::SysVar_PROXI::pByte113Bit2 = (temp >> 2) & 0x01;
  @sysvar::SysVar_PROXI::pByte113Bit3 = (temp >> 3) & 0x01;
  @sysvar::SysVar_PROXI::pByte113Bit4 = (temp >> 4) & 0x01;
  @sysvar::SysVar_PROXI::pByte113Bit5 = (temp >> 5) & 0x01;
  @sysvar::SysVar_PROXI::pByte113Bit6 = (temp >> 6) & 0x01;
  @sysvar::SysVar_PROXI::pByte113Bit7 = (temp >> 7) & 0x01;
      
  temp = PROXI_bDataBuffer[113];
  @sysvar::SysVar_PROXI::pByte114Bit0 =  temp     & 0x01;
  @sysvar::SysVar_PROXI::pByte114Bit1 = (temp >> 1) & 0x01;
  @sysvar::SysVar_PROXI::pByte114Bit2 = (temp >> 2) & 0x01;
  @sysvar::SysVar_PROXI::pByte114Bit3 = (temp >> 3) & 0x01;
  @sysvar::SysVar_PROXI::pByte114Bit4 = (temp >> 4) & 0x01;
  @sysvar::SysVar_PROXI::pByte114Bit5 = (temp >> 5) & 0x01;
  @sysvar::SysVar_PROXI::pByte114Bit6 = (temp >> 6) & 0x01;
  @sysvar::SysVar_PROXI::pByte114Bit7 = (temp >> 7) & 0x01;
      
  temp = PROXI_bDataBuffer[114];
  @sysvar::SysVar_PROXI::pByte115Bit0 =  temp     & 0x01;
  @sysvar::SysVar_PROXI::pByte115Bit1 = (temp >> 1) & 0x01;
  @sysvar::SysVar_PROXI::pByte115Bit2 = (temp >> 2) & 0x01;
  @sysvar::SysVar_PROXI::pByte115Bit3 = (temp >> 3) & 0x01;
  @sysvar::SysVar_PROXI::pByte115Bit4 = (temp >> 4) & 0x01;
  @sysvar::SysVar_PROXI::pByte115Bit5 = (temp >> 5) & 0x01;
  @sysvar::SysVar_PROXI::pByte115Bit6 = (temp >> 6) & 0x01;
  @sysvar::SysVar_PROXI::pByte115Bit7 = (temp >> 7) & 0x01;
      
  temp = PROXI_bDataBuffer[115];
  @sysvar::SysVar_PROXI::pByte116Bit0 =  temp     & 0x01;
  @sysvar::SysVar_PROXI::pByte116Bit1 = (temp >> 1) & 0x01;
  @sysvar::SysVar_PROXI::pByte116Bit2 = (temp >> 2) & 0x01;
  @sysvar::SysVar_PROXI::pByte116Bit3 = (temp >> 3) & 0x01;
  @sysvar::SysVar_PROXI::pByte116Bit4 = (temp >> 4) & 0x01;
  @sysvar::SysVar_PROXI::pByte116Bit5 = (temp >> 5) & 0x01;
  @sysvar::SysVar_PROXI::pByte116Bit6 = (temp >> 6) & 0x01;
  @sysvar::SysVar_PROXI::pByte116Bit7 = (temp >> 7) & 0x01;
      
  temp = PROXI_bDataBuffer[116];
  @sysvar::SysVar_PROXI::pByte117Bit0 =  temp     & 0x01;
  @sysvar::SysVar_PROXI::pByte117Bit1 = (temp >> 1) & 0x01;
  @sysvar::SysVar_PROXI::pByte117Bit2 = (temp >> 2) & 0x01;
  @sysvar::SysVar_PROXI::pByte117Bit3 = (temp >> 3) & 0x01;
//  @sysvar::SysVar_PROXI::pByte117Bit4 = (temp >> 4) & 0x01;
//  @sysvar::SysVar_PROXI::pByte117Bit5 = (temp >> 5) & 0x01;
//  @sysvar::SysVar_PROXI::pByte117Bit6 = (temp >> 6) & 0x01;
  @sysvar::SysVar_PROXI::pByte117Bit456 = (temp >> 4) & 0x07;
  @sysvar::SysVar_PROXI::pByte117Bit7 = (temp >> 7) & 0x01;
//  @sysvar::SysVar_PROXI::pByte117Bit456A = @sysvar::SysVar_PROXI::pByte117Bit456 ;
      
  temp = PROXI_bDataBuffer[117];
  @sysvar::SysVar_PROXI::pByte118Bit0 =  temp     & 0x01;
  @sysvar::SysVar_PROXI::pByte118Bit1 = (temp >> 1) & 0x01;
  @sysvar::SysVar_PROXI::pByte118Bit2 = (temp >> 2) & 0x01;
  @sysvar::SysVar_PROXI::pByte118Bit3 = (temp >> 3) & 0x01;
//  @sysvar::SysVar_PROXI::pByte118Bit4 = (temp >> 4) & 0x01;
//  @sysvar::SysVar_PROXI::pByte118Bit5 = (temp >> 5) & 0x01;
  @sysvar::SysVar_PROXI::pByte118Bit45 = (temp >> 4) & 0x03;
  @sysvar::SysVar_PROXI::pByte118Bit6 = (temp >> 6) & 0x01;
  @sysvar::SysVar_PROXI::pByte118Bit7 = (temp >> 7) & 0x01;
      
  temp = PROXI_bDataBuffer[118];
  @sysvar::SysVar_PROXI::pByte119Bit0 =  temp     & 0x01;
  @sysvar::SysVar_PROXI::pByte119Bit1 = (temp >> 1) & 0x01;
  @sysvar::SysVar_PROXI::pByte119Bit2 = (temp >> 2) & 0x01;
  @sysvar::SysVar_PROXI::pByte119Bit3 = (temp >> 3) & 0x01;
  @sysvar::SysVar_PROXI::pByte119Bit4 = (temp >> 4) & 0x01;
  @sysvar::SysVar_PROXI::pByte119Bit5 = (temp >> 5) & 0x01;
  @sysvar::SysVar_PROXI::pByte119Bit6 = (temp >> 6) & 0x01;
  @sysvar::SysVar_PROXI::pByte119Bit7 = (temp >> 7) & 0x01;
        
  temp = PROXI_bDataBuffer[119];
//  @sysvar::SysVar_PROXI::pByte120Bit0 =  temp     & 0x01;
//  @sysvar::SysVar_PROXI::pByte120Bit1 = (temp >> 1) & 0x01;
//  @sysvar::SysVar_PROXI::pByte120Bit2 = (temp >> 2) & 0x01;
//  @sysvar::SysVar_PROXI::pByte120Bit3 = (temp >> 3) & 0x01;
//  @sysvar::SysVar_PROXI::pByte120Bit4 = (temp >> 4) & 0x01;
//  @sysvar::SysVar_PROXI::pByte120Bit5 = (temp >> 5) & 0x01;
//  @sysvar::SysVar_PROXI::pByte120Bit6 = (temp >> 6) & 0x01;
//  @sysvar::SysVar_PROXI::pByte120Bit7 = (temp >> 7) & 0x01;
  @sysvar::SysVar_PROXI::pByte120 = temp;
        
  temp = PROXI_bDataBuffer[120];
//  @sysvar::SysVar_PROXI::pByte121Bit0 =  temp     & 0x01;
//  @sysvar::SysVar_PROXI::pByte121Bit1 = (temp >> 1) & 0x01;
  @sysvar::SysVar_PROXI::pByte121Bit01 = temp & 0x03;
  @sysvar::SysVar_PROXI::pByte121Bit2 = (temp >> 2) & 0x01;
  @sysvar::SysVar_PROXI::pByte121Bit3 = (temp >> 3) & 0x01;
  @sysvar::SysVar_PROXI::pByte121Bit4 = (temp >> 4) & 0x01;
  @sysvar::SysVar_PROXI::pByte121Bit5 = (temp >> 5) & 0x01;
  @sysvar::SysVar_PROXI::pByte121Bit6 = (temp >> 6) & 0x01;
  @sysvar::SysVar_PROXI::pByte121Bit7 = (temp >> 7) & 0x01;
        
  temp = PROXI_bDataBuffer[121];
  @sysvar::SysVar_PROXI::pByte122Bit0 =  temp     & 0x01;
  @sysvar::SysVar_PROXI::pByte122Bit1 = (temp >> 1) & 0x01;
  @sysvar::SysVar_PROXI::pByte122Bit2 = (temp >> 2) & 0x01;
  @sysvar::SysVar_PROXI::pByte122Bit3 = (temp >> 3) & 0x01;
  @sysvar::SysVar_PROXI::pByte122Bit4 = (temp >> 4) & 0x01;
  @sysvar::SysVar_PROXI::pByte122Bit5 = (temp >> 5) & 0x01;
  @sysvar::SysVar_PROXI::pByte122Bit6 = (temp >> 6) & 0x01;
  @sysvar::SysVar_PROXI::pByte122Bit7 = (temp >> 7) & 0x01;
      
  temp = PROXI_bDataBuffer[122];
  @sysvar::SysVar_PROXI::pByte123Bit0 =  temp     & 0x01;
  @sysvar::SysVar_PROXI::pByte123Bit1 = (temp >> 1) & 0x01;
  @sysvar::SysVar_PROXI::pByte123Bit2 = (temp >> 2) & 0x01;
  @sysvar::SysVar_PROXI::pByte123Bit3 = (temp >> 3) & 0x01;
  @sysvar::SysVar_PROXI::pByte123Bit4 = (temp >> 4) & 0x01;
  @sysvar::SysVar_PROXI::pByte123Bit5 = (temp >> 5) & 0x01;
  @sysvar::SysVar_PROXI::pByte123Bit6 = (temp >> 6) & 0x01;
  @sysvar::SysVar_PROXI::pByte123Bit7 = (temp >> 7) & 0x01;
      
  temp = PROXI_bDataBuffer[123];
  @sysvar::SysVar_PROXI::pByte124Bit0 =  temp     & 0x01;
  @sysvar::SysVar_PROXI::pByte124Bit1 = (temp >> 1) & 0x01;
  @sysvar::SysVar_PROXI::pByte124Bit2 = (temp >> 2) & 0x01;
  @sysvar::SysVar_PROXI::pByte124Bit3 = (temp >> 3) & 0x01;
  @sysvar::SysVar_PROXI::pByte124Bit4 = (temp >> 4) & 0x01;
  @sysvar::SysVar_PROXI::pByte124Bit5 = (temp >> 5) & 0x01;
  @sysvar::SysVar_PROXI::pByte124Bit6 = (temp >> 6) & 0x01;
  @sysvar::SysVar_PROXI::pByte124Bit7 = (temp >> 7) & 0x01;
      
  temp = PROXI_bDataBuffer[124];
//  @sysvar::SysVar_PROXI::pByte125Bit0 =  temp     & 0x01;
//  @sysvar::SysVar_PROXI::pByte125Bit1 = (temp >> 1) & 0x01;
//  @sysvar::SysVar_PROXI::pByte125Bit2 = (temp >> 2) & 0x01;
//  @sysvar::SysVar_PROXI::pByte125Bit3 = (temp >> 3) & 0x01;
//  @sysvar::SysVar_PROXI::pByte125Bit4 = (temp >> 4) & 0x01;
//  @sysvar::SysVar_PROXI::pByte125Bit5 = (temp >> 5) & 0x01;
//  @sysvar::SysVar_PROXI::pByte125Bit6 = (temp >> 6) & 0x01;
//  @sysvar::SysVar_PROXI::pByte125Bit7 = (temp >> 7) & 0x01;
  @sysvar::SysVar_PROXI::pByte125 = temp;
      
  temp = PROXI_bDataBuffer[125];
  @sysvar::SysVar_PROXI::pByte126Bit0 =  temp     & 0x01;
  @sysvar::SysVar_PROXI::pByte126Bit1 = (temp >> 1) & 0x01;
  @sysvar::SysVar_PROXI::pByte126Bit2 = (temp >> 2) & 0x01;
  @sysvar::SysVar_PROXI::pByte126Bit12 = (temp >> 1) & 0x03;
  @sysvar::SysVar_PROXI::pByte126Bit3 = (temp >> 3) & 0x01;
  @sysvar::SysVar_PROXI::pByte126Bit4 = (temp >> 4) & 0x01;
  @sysvar::SysVar_PROXI::pByte126Bit34 = (temp >> 3) & 0x03;
  @sysvar::SysVar_PROXI::pByte126Bit5 = (temp >> 5) & 0x01;
  @sysvar::SysVar_PROXI::pByte126Bit6 = (temp >> 6) & 0x01;
  @sysvar::SysVar_PROXI::pByte126Bit7 = (temp >> 7) & 0x01;
      
  temp = PROXI_bDataBuffer[126];
  @sysvar::SysVar_PROXI::pByte127Bit0 =  temp     & 0x01;
  @sysvar::SysVar_PROXI::pByte127Bit1 = (temp >> 1) & 0x01;
  @sysvar::SysVar_PROXI::pByte127Bit2 = (temp >> 2) & 0x01;
  @sysvar::SysVar_PROXI::pByte127Bit3 = (temp >> 3) & 0x01;
  @sysvar::SysVar_PROXI::pByte127Bit4 = (temp >> 4) & 0x01;
  @sysvar::SysVar_PROXI::pByte127Bit5 = (temp >> 5) & 0x01;
  @sysvar::SysVar_PROXI::pByte127Bit6 = (temp >> 6) & 0x01;
  @sysvar::SysVar_PROXI::pByte127Bit7 = (temp >> 7) & 0x01;
      
  temp = PROXI_bDataBuffer[127];
  @sysvar::SysVar_PROXI::pByte128Bit0 =  temp     & 0x01;
  @sysvar::SysVar_PROXI::pByte128Bit1 = (temp >> 1) & 0x01;
  @sysvar::SysVar_PROXI::pByte128Bit2 = (temp >> 2) & 0x01;
  @sysvar::SysVar_PROXI::pByte128Bit3 = (temp >> 3) & 0x01;
  @sysvar::SysVar_PROXI::pByte128Bit4 = (temp >> 4) & 0x01;
  @sysvar::SysVar_PROXI::pByte128Bit5 = (temp >> 5) & 0x01;
  @sysvar::SysVar_PROXI::pByte128Bit6 = (temp >> 6) & 0x01;
  @sysvar::SysVar_PROXI::pByte128Bit7 = (temp >> 7) & 0x01;
  @sysvar::SysVar_PROXI::pByte128 = temp;
      
  temp = PROXI_bDataBuffer[128];
  @sysvar::SysVar_PROXI::pByte129Bit0 =  temp     & 0x01;
  @sysvar::SysVar_PROXI::pByte129Bit1 = (temp >> 1) & 0x01;
  @sysvar::SysVar_PROXI::pByte129Bit2 = (temp >> 2) & 0x01;
  @sysvar::SysVar_PROXI::pByte129Bit3 = (temp >> 3) & 0x01;
  @sysvar::SysVar_PROXI::pByte129Bit4 = (temp >> 4) & 0x01;
  @sysvar::SysVar_PROXI::pByte129Bit5 = (temp >> 5) & 0x01;
  @sysvar::SysVar_PROXI::pByte129Bit6 = (temp >> 6) & 0x01;
  @sysvar::SysVar_PROXI::pByte129Bit7 = (temp >> 7) & 0x01;
        
  temp = PROXI_bDataBuffer[129];
  @sysvar::SysVar_PROXI::pByte130Bit0 =  temp     & 0x01;
  @sysvar::SysVar_PROXI::pByte130Bit1 = (temp >> 1) & 0x01;
  @sysvar::SysVar_PROXI::pByte130Bit2 = (temp >> 2) & 0x01;
  @sysvar::SysVar_PROXI::pByte130Bit3 = (temp >> 3) & 0x01;
  @sysvar::SysVar_PROXI::pByte130Bit4 = (temp >> 4) & 0x01;
  @sysvar::SysVar_PROXI::pByte130Bit5 = (temp >> 5) & 0x01;
 // @sysvar::SysVar_PROXI::pByte130Bit6 = (temp >> 6) & 0x01;
 // @sysvar::SysVar_PROXI::pByte130Bit7 = (temp >> 7) & 0x01;
  @sysvar::SysVar_PROXI::pByte130Bit67 = (temp >> 6) & 0x03;
        
  temp = PROXI_bDataBuffer[130];
  @sysvar::SysVar_PROXI::pByte131Bit0 =  temp     & 0x01;
  @sysvar::SysVar_PROXI::pByte131Bit1 = (temp >> 1) & 0x01;
  @sysvar::SysVar_PROXI::pByte131Bit2 = (temp >> 2) & 0x01;
  @sysvar::SysVar_PROXI::pByte131Bit3 = (temp >> 3) & 0x01;
  @sysvar::SysVar_PROXI::pByte131Bit4 = (temp >> 4) & 0x01;
  @sysvar::SysVar_PROXI::pByte131Bit5 = (temp >> 5) & 0x01;
  @sysvar::SysVar_PROXI::pByte131Bit6 = (temp >> 6) & 0x01;
  @sysvar::SysVar_PROXI::pByte131Bit7 = (temp >> 7) & 0x01; 
  
  temp = PROXI_bDataBuffer[131];
  @sysvar::SysVar_PROXI::pByte132Bit0 =  temp     & 0x01;
  @sysvar::SysVar_PROXI::pByte132Bit1 = (temp >> 1) & 0x01;
  @sysvar::SysVar_PROXI::pByte132Bit2 = (temp >> 2) & 0x01;
  @sysvar::SysVar_PROXI::pByte132Bit3 = (temp >> 3) & 0x01;
  @sysvar::SysVar_PROXI::pByte132Bit4 = (temp >> 4) & 0x01;
  @sysvar::SysVar_PROXI::pByte132Bit5 = (temp >> 5) & 0x01;
  @sysvar::SysVar_PROXI::pByte132Bit6 = (temp >> 6) & 0x01;
  @sysvar::SysVar_PROXI::pByte132Bit7 = (temp >> 7) & 0x01;
      
  temp = PROXI_bDataBuffer[132];
  @sysvar::SysVar_PROXI::pByte133Bit0 =  temp     & 0x01;
  @sysvar::SysVar_PROXI::pByte133Bit1 = (temp >> 1) & 0x01;
  @sysvar::SysVar_PROXI::pByte133Bit2 = (temp >> 2) & 0x01;
  @sysvar::SysVar_PROXI::pByte133Bit3 = (temp >> 3) & 0x01;
  @sysvar::SysVar_PROXI::pByte133Bit4 = (temp >> 4) & 0x01;
//  @sysvar::SysVar_PROXI::pByte133Bit5 = (temp >> 5) & 0x01;
//  @sysvar::SysVar_PROXI::pByte133Bit6 = (temp >> 6) & 0x01;
  @sysvar::SysVar_PROXI::pByte133Bit56 = (temp >> 5) & 0x03;
  @sysvar::SysVar_PROXI::pByte133Bit7 = (temp >> 7) & 0x01;
      
  temp = PROXI_bDataBuffer[133];
//  @sysvar::SysVar_PROXI::pByte134Bit0 =  temp     & 0x01;
//  @sysvar::SysVar_PROXI::pByte134Bit1 = (temp >> 1) & 0x01;
  @sysvar::SysVar_PROXI::pByte134Bit01 = temp & 0x03;
  @sysvar::SysVar_PROXI::pByte134Bit2 = (temp >> 2) & 0x01;
  @sysvar::SysVar_PROXI::pByte134Bit3 = (temp >> 3) & 0x01;
  @sysvar::SysVar_PROXI::pByte134Bit4 = (temp >> 4) & 0x01;
  @sysvar::SysVar_PROXI::pByte134Bit5 = (temp >> 5) & 0x01;
  @sysvar::SysVar_PROXI::pByte134Bit6 = (temp >> 6) & 0x01;
  @sysvar::SysVar_PROXI::pByte134Bit7 = (temp >> 7) & 0x01;
      
  temp = PROXI_bDataBuffer[134];
  @sysvar::SysVar_PROXI::pByte135Bit0 =  temp     & 0x01;
  @sysvar::SysVar_PROXI::pByte135Bit1 = (temp >> 1) & 0x01;
  @sysvar::SysVar_PROXI::pByte135Bit2 = (temp >> 2) & 0x01;
  @sysvar::SysVar_PROXI::pByte135Bit3 = (temp >> 3) & 0x01;
  @sysvar::SysVar_PROXI::pByte135Bit4 = (temp >> 4) & 0x01;
  @sysvar::SysVar_PROXI::pByte135Bit5 = (temp >> 5) & 0x01;
  @sysvar::SysVar_PROXI::pByte135Bit6 = (temp >> 6) & 0x01;
  @sysvar::SysVar_PROXI::pByte135Bit7 = (temp >> 7) & 0x01;
      
  temp = PROXI_bDataBuffer[135];
  @sysvar::SysVar_PROXI::pByte136Bit0 =  temp     & 0x01;
  @sysvar::SysVar_PROXI::pByte136Bit1 = (temp >> 1) & 0x01;
  @sysvar::SysVar_PROXI::pByte136Bit2 = (temp >> 2) & 0x01;
  @sysvar::SysVar_PROXI::pByte136Bit3 = (temp >> 3) & 0x01;
  @sysvar::SysVar_PROXI::pByte136Bit4 = (temp >> 4) & 0x01;
  @sysvar::SysVar_PROXI::pByte136Bit5 = (temp >> 5) & 0x01;
  @sysvar::SysVar_PROXI::pByte136Bit6 = (temp >> 6) & 0x01;
  @sysvar::SysVar_PROXI::pByte136Bit7 = (temp >> 7) & 0x01;
      
  temp = PROXI_bDataBuffer[136];
  @sysvar::SysVar_PROXI::pByte137Bit0 =  temp     & 0x01;
  @sysvar::SysVar_PROXI::pByte137Bit1 = (temp >> 1) & 0x01;
  @sysvar::SysVar_PROXI::pByte137Bit2 = (temp >> 2) & 0x01;
//  @sysvar::SysVar_PROXI::pByte137Bit3 = (temp >> 3) & 0x01;
//  @sysvar::SysVar_PROXI::pByte137Bit4 = (temp >> 4) & 0x01;
//  @sysvar::SysVar_PROXI::pByte137Bit5 = (temp >> 5) & 0x01;
//  @sysvar::SysVar_PROXI::pByte137Bit6 = (temp >> 6) & 0x01;
//  @sysvar::SysVar_PROXI::pByte137Bit7 = (temp >> 7) & 0x01;
  @sysvar::SysVar_PROXI::pByte137Bit34567 = ((((temp >> 3) & 0x05)*50)+700);
//  @sysvar::SysVar_PROXI::pByte137 = temp;
      
  temp = PROXI_bDataBuffer[137];
  @sysvar::SysVar_PROXI::pByte138Bit0 =  temp     & 0x01;
  @sysvar::SysVar_PROXI::pByte138Bit1 = (temp >> 1) & 0x01;
  @sysvar::SysVar_PROXI::pByte138Bit2 = (temp >> 2) & 0x01;
  @sysvar::SysVar_PROXI::pByte138Bit3 = (temp >> 3) & 0x01;
  @sysvar::SysVar_PROXI::pByte138Bit4 = (temp >> 4) & 0x01;
  @sysvar::SysVar_PROXI::pByte138Bit5 = (temp >> 5) & 0x01;
  @sysvar::SysVar_PROXI::pByte138Bit6 = (temp >> 6) & 0x01;
  @sysvar::SysVar_PROXI::pByte138Bit7 = (temp >> 7) & 0x01;
      
  temp = PROXI_bDataBuffer[138];
//  @sysvar::SysVar_PROXI::pByte139Bit0 =  temp     & 0x01;
//  @sysvar::SysVar_PROXI::pByte139Bit1 = (temp >> 1) & 0x01;
//  @sysvar::SysVar_PROXI::pByte139Bit2 = (temp >> 2) & 0x01;
//  @sysvar::SysVar_PROXI::pByte139Bit3 = (temp >> 3) & 0x01;
//  @sysvar::SysVar_PROXI::pByte139Bit4 = (temp >> 4) & 0x01;
//  @sysvar::SysVar_PROXI::pByte139Bit5 = (temp >> 5) & 0x01;
//  @sysvar::SysVar_PROXI::pByte139Bit6 = (temp >> 6) & 0x01;
  @sysvar::SysVar_PROXI::pByte139Bit0123456 = (temp & 0x07)*10;
  @sysvar::SysVar_PROXI::pByte139Bit7 = (temp >> 7) & 0x01;
        
  temp = PROXI_bDataBuffer[139];
  @sysvar::SysVar_PROXI::pByte140Bit0 =  temp     & 0x01;
  @sysvar::SysVar_PROXI::pByte140Bit1 = (temp >> 1) & 0x01;
  @sysvar::SysVar_PROXI::pByte140Bit2 = (temp >> 2) & 0x01;
  @sysvar::SysVar_PROXI::pByte140Bit3 = (temp >> 3) & 0x01;
  @sysvar::SysVar_PROXI::pByte140Bit4 = (temp >> 4) & 0x01;
  @sysvar::SysVar_PROXI::pByte140Bit5 = (temp >> 5) & 0x01;
  @sysvar::SysVar_PROXI::pByte140Bit6 = (temp >> 6) & 0x01;
  @sysvar::SysVar_PROXI::pByte140Bit7 = (temp >> 7) & 0x01;
        
  temp = PROXI_bDataBuffer[140];
  @sysvar::SysVar_PROXI::pByte141Bit0 =  temp     & 0x01;
  @sysvar::SysVar_PROXI::pByte141Bit1 = (temp >> 1) & 0x01;
  @sysvar::SysVar_PROXI::pByte141Bit2 = (temp >> 2) & 0x01;
  @sysvar::SysVar_PROXI::pByte141Bit3 = (temp >> 3) & 0x01;
  @sysvar::SysVar_PROXI::pByte141Bit4 = (temp >> 4) & 0x01;
//  @sysvar::SysVar_PROXI::pByte141Bit5 = (temp >> 5) & 0x01;
//  @sysvar::SysVar_PROXI::pByte141Bit6 = (temp >> 6) & 0x01;
//  @sysvar::SysVar_PROXI::pByte141Bit7 = (temp >> 7) & 0x01;  
  @sysvar::SysVar_PROXI::pByte141Bit567 = (temp >> 5) & 0x07;
  
  temp = PROXI_bDataBuffer[141];
  @sysvar::SysVar_PROXI::pByte142Bit0 =  temp     & 0x01;
  @sysvar::SysVar_PROXI::pByte142Bit1 = (temp >> 1) & 0x01;
  @sysvar::SysVar_PROXI::pByte142Bit2 = (temp >> 2) & 0x01;
  @sysvar::SysVar_PROXI::pByte142Bit3 = (temp >> 3) & 0x01;
  @sysvar::SysVar_PROXI::pByte142Bit4 = (temp >> 4) & 0x01;
  @sysvar::SysVar_PROXI::pByte142Bit5 = (temp >> 5) & 0x01;
  @sysvar::SysVar_PROXI::pByte142Bit6 = (temp >> 6) & 0x01;
  @sysvar::SysVar_PROXI::pByte142Bit7 = (temp >> 7) & 0x01;
      
  temp = PROXI_bDataBuffer[142];
  @sysvar::SysVar_PROXI::pByte143Bit0 =  temp     & 0x01;
  @sysvar::SysVar_PROXI::pByte143Bit1 = (temp >> 1) & 0x01;
  @sysvar::SysVar_PROXI::pByte143Bit2 = (temp >> 2) & 0x01;
  @sysvar::SysVar_PROXI::pByte143Bit3 = (temp >> 3) & 0x01;
  @sysvar::SysVar_PROXI::pByte143Bit4 = (temp >> 4) & 0x01;
  @sysvar::SysVar_PROXI::pByte143Bit5 = (temp >> 5) & 0x01;
  @sysvar::SysVar_PROXI::pByte143Bit6 = (temp >> 6) & 0x01;
  @sysvar::SysVar_PROXI::pByte143Bit7 = (temp >> 7) & 0x01;
      
  temp = PROXI_bDataBuffer[143];
  @sysvar::SysVar_PROXI::pByte144Bit0 =  temp     & 0x01;
  @sysvar::SysVar_PROXI::pByte144Bit1 = (temp >> 1) & 0x01;
  @sysvar::SysVar_PROXI::pByte144Bit2 = (temp >> 2) & 0x01;
//  @sysvar::SysVar_PROXI::pByte144Bit3 = (temp >> 3) & 0x01;
//  @sysvar::SysVar_PROXI::pByte144Bit4 = (temp >> 4) & 0x01;
//  @sysvar::SysVar_PROXI::pByte144Bit5 = (temp >> 5) & 0x01;
  @sysvar::SysVar_PROXI::pByte144Bit345 = (temp >> 3) & 0x07;
  @sysvar::SysVar_PROXI::pByte144Bit6 = (temp >> 6) & 0x01;
  @sysvar::SysVar_PROXI::pByte144Bit7 = (temp >> 7) & 0x01;
      
  temp = PROXI_bDataBuffer[144];
  @sysvar::SysVar_PROXI::pByte145Bit012 =  temp     & 0x01;
//  @sysvar::SysVar_PROXI::pByte145Bit1 = (temp >> 1) & 0x01;
//  @sysvar::SysVar_PROXI::pByte145Bit2 = (temp >> 2) & 0x01;
  @sysvar::SysVar_PROXI::pByte145Bit3 = (temp >> 3) & 0x01;
  @sysvar::SysVar_PROXI::pByte145Bit4 = (temp >> 4) & 0x01;
  @sysvar::SysVar_PROXI::pByte145Bit5 = (temp >> 5) & 0x01;
//  @sysvar::SysVar_PROXI::pByte145Bit6 = (temp >> 6) & 0x01;
//  @sysvar::SysVar_PROXI::pByte145Bit7 = (temp >> 7) & 0x01;
  @sysvar::SysVar_PROXI::pByte145Bit67 = (temp >> 6) & 0x03;
      
  temp = PROXI_bDataBuffer[145];
  @sysvar::SysVar_PROXI::pByte146Bit0 =  temp     & 0x01;
  @sysvar::SysVar_PROXI::pByte146Bit1 = (temp >> 1) & 0x01;
  @sysvar::SysVar_PROXI::pByte146Bit2 = (temp >> 2) & 0x01;
  @sysvar::SysVar_PROXI::pByte146Bit3 = (temp >> 3) & 0x01;
  @sysvar::SysVar_PROXI::pByte146Bit4 = (temp >> 4) & 0x01;
  @sysvar::SysVar_PROXI::pByte146Bit5 = (temp >> 5) & 0x01;
  @sysvar::SysVar_PROXI::pByte146Bit6 = (temp >> 6) & 0x01;
  @sysvar::SysVar_PROXI::pByte146Bit7 = (temp >> 7) & 0x01;
      
  temp = PROXI_bDataBuffer[146];
  @sysvar::SysVar_PROXI::pByte147Bit0 =  temp     & 0x01;
  @sysvar::SysVar_PROXI::pByte147Bit1 = (temp >> 1) & 0x01;
  @sysvar::SysVar_PROXI::pByte147Bit2 = (temp >> 2) & 0x01;
  @sysvar::SysVar_PROXI::pByte147Bit3 = (temp >> 3) & 0x01;
  @sysvar::SysVar_PROXI::pByte147Bit4 = (temp >> 4) & 0x01;
  @sysvar::SysVar_PROXI::pByte147Bit5 = (temp >> 5) & 0x01;
  @sysvar::SysVar_PROXI::pByte147Bit6 = (temp >> 6) & 0x01;
  @sysvar::SysVar_PROXI::pByte147Bit7 = (temp >> 7) & 0x01;
      
  temp = PROXI_bDataBuffer[147];
  @sysvar::SysVar_PROXI::pByte148Bit0 =  temp     & 0x01;
  @sysvar::SysVar_PROXI::pByte148Bit1 = (temp >> 1) & 0x01;
  @sysvar::SysVar_PROXI::pByte148Bit2 = (temp >> 2) & 0x01;
  @sysvar::SysVar_PROXI::pByte148Bit3 = (temp >> 3) & 0x01;
  @sysvar::SysVar_PROXI::pByte148Bit4 = (temp >> 4) & 0x01;
  @sysvar::SysVar_PROXI::pByte148Bit5 = (temp >> 5) & 0x01;
  @sysvar::SysVar_PROXI::pByte148Bit6 = (temp >> 6) & 0x01;
  @sysvar::SysVar_PROXI::pByte148Bit7 = (temp >> 7) & 0x01;
      
  temp = PROXI_bDataBuffer[148];
  @sysvar::SysVar_PROXI::pByte149Bit0 =  temp     & 0x01;
  @sysvar::SysVar_PROXI::pByte149Bit1 = (temp >> 1) & 0x01;
  @sysvar::SysVar_PROXI::pByte149Bit2 = (temp >> 2) & 0x01;
  @sysvar::SysVar_PROXI::pByte149Bit3 = (temp >> 3) & 0x01;
  @sysvar::SysVar_PROXI::pByte149Bit4 = (temp >> 4) & 0x01;
  @sysvar::SysVar_PROXI::pByte149Bit5 = (temp >> 5) & 0x01;
  @sysvar::SysVar_PROXI::pByte149Bit6 = (temp >> 6) & 0x01;
  @sysvar::SysVar_PROXI::pByte149Bit7 = (temp >> 7) & 0x01;
        
  temp = PROXI_bDataBuffer[149];
  @sysvar::SysVar_PROXI::pByte150Bit0 =  temp     & 0x01;
  @sysvar::SysVar_PROXI::pByte150Bit1 = (temp >> 1) & 0x01;
  @sysvar::SysVar_PROXI::pByte150Bit2 = (temp >> 2) & 0x01;
  @sysvar::SysVar_PROXI::pByte150Bit3 = (temp >> 3) & 0x01;
  @sysvar::SysVar_PROXI::pByte150Bit4 = (temp >> 4) & 0x01;
  @sysvar::SysVar_PROXI::pByte150Bit5 = (temp >> 5) & 0x01;
  @sysvar::SysVar_PROXI::pByte150Bit6 = (temp >> 6) & 0x01;
  @sysvar::SysVar_PROXI::pByte150Bit7 = (temp >> 7) & 0x01;
        
  temp = PROXI_bDataBuffer[150];
  @sysvar::SysVar_PROXI::pByte151Bit0 =  temp     & 0x01;
  @sysvar::SysVar_PROXI::pByte151Bit1 = (temp >> 1) & 0x01;
  @sysvar::SysVar_PROXI::pByte151Bit2 = (temp >> 2) & 0x01;
  @sysvar::SysVar_PROXI::pByte151Bit3 = (temp >> 3) & 0x01;
  @sysvar::SysVar_PROXI::pByte151Bit4 = (temp >> 4) & 0x01;
  @sysvar::SysVar_PROXI::pByte151Bit5 = (temp >> 5) & 0x01;
  @sysvar::SysVar_PROXI::pByte151Bit6 = (temp >> 6) & 0x01;
  @sysvar::SysVar_PROXI::pByte151Bit7 = (temp >> 7) & 0x01;
  
  temp = PROXI_bDataBuffer[151];
  @sysvar::SysVar_PROXI::pByte152Bit0 =  temp     & 0x01;
  @sysvar::SysVar_PROXI::pByte152Bit1 = (temp >> 1) & 0x01;
  @sysvar::SysVar_PROXI::pByte152Bit2 = (temp >> 2) & 0x01;
  @sysvar::SysVar_PROXI::pByte152Bit3 = (temp >> 3) & 0x01;
  @sysvar::SysVar_PROXI::pByte152Bit4 = (temp >> 4) & 0x01;
  @sysvar::SysVar_PROXI::pByte152Bit5 = (temp >> 5) & 0x01;
  @sysvar::SysVar_PROXI::pByte152Bit6 = (temp >> 6) & 0x01;
  @sysvar::SysVar_PROXI::pByte152Bit7 = (temp >> 7) & 0x01;
      
  temp = PROXI_bDataBuffer[152];
  @sysvar::SysVar_PROXI::pByte153Bit0 =  temp     & 0x01;
  @sysvar::SysVar_PROXI::pByte153Bit1 = (temp >> 1) & 0x01;
  @sysvar::SysVar_PROXI::pByte153Bit2 = (temp >> 2) & 0x01;
  @sysvar::SysVar_PROXI::pByte153Bit3 = (temp >> 3) & 0x01;
  @sysvar::SysVar_PROXI::pByte153Bit4 = (temp >> 4) & 0x01;
  @sysvar::SysVar_PROXI::pByte153Bit5 = (temp >> 5) & 0x01;
  @sysvar::SysVar_PROXI::pByte153Bit6 = (temp >> 6) & 0x01;
  @sysvar::SysVar_PROXI::pByte153Bit7 = (temp >> 7) & 0x01;
      
  temp = PROXI_bDataBuffer[153];
  @sysvar::SysVar_PROXI::pByte154Bit0 =  temp     & 0x01;
  @sysvar::SysVar_PROXI::pByte154Bit1 = (temp >> 1) & 0x01;
  @sysvar::SysVar_PROXI::pByte154Bit2 = (temp >> 2) & 0x01;
  @sysvar::SysVar_PROXI::pByte154Bit3 = (temp >> 3) & 0x01;
  @sysvar::SysVar_PROXI::pByte154Bit4 = (temp >> 4) & 0x01;
  @sysvar::SysVar_PROXI::pByte154Bit5 = (temp >> 5) & 0x01;
  @sysvar::SysVar_PROXI::pByte154Bit6 = (temp >> 6) & 0x01;
  @sysvar::SysVar_PROXI::pByte154Bit7 = (temp >> 7) & 0x01;
      
  temp = PROXI_bDataBuffer[154];
  @sysvar::SysVar_PROXI::pByte155Bit0 =  temp     & 0x01;
  @sysvar::SysVar_PROXI::pByte155Bit1 = (temp >> 1) & 0x01;
  @sysvar::SysVar_PROXI::pByte155Bit2 = (temp >> 2) & 0x01;
  @sysvar::SysVar_PROXI::pByte155Bit3 = (temp >> 3) & 0x01;
  @sysvar::SysVar_PROXI::pByte155Bit4 = (temp >> 4) & 0x01;
  @sysvar::SysVar_PROXI::pByte155Bit5 = (temp >> 5) & 0x01;
  @sysvar::SysVar_PROXI::pByte155Bit6 = (temp >> 6) & 0x01;
  @sysvar::SysVar_PROXI::pByte155Bit7 = (temp >> 7) & 0x01;
      
  temp = PROXI_bDataBuffer[155];
  @sysvar::SysVar_PROXI::pByte156Bit0 =  temp     & 0x01;
  @sysvar::SysVar_PROXI::pByte156Bit1 = (temp >> 1) & 0x01;
  @sysvar::SysVar_PROXI::pByte156Bit2 = (temp >> 2) & 0x01;
  @sysvar::SysVar_PROXI::pByte156Bit3 = (temp >> 3) & 0x01;
  @sysvar::SysVar_PROXI::pByte156Bit4 = (temp >> 4) & 0x01;
  @sysvar::SysVar_PROXI::pByte156Bit5 = (temp >> 5) & 0x01;
  @sysvar::SysVar_PROXI::pByte156Bit6 = (temp >> 6) & 0x01;
  @sysvar::SysVar_PROXI::pByte156Bit7 = (temp >> 7) & 0x01;
      
  temp = PROXI_bDataBuffer[156];
  @sysvar::SysVar_PROXI::pByte157Bit0 =  temp     & 0x01;
  @sysvar::SysVar_PROXI::pByte157Bit1 = (temp >> 1) & 0x01;
  @sysvar::SysVar_PROXI::pByte157Bit2 = (temp >> 2) & 0x01;
  @sysvar::SysVar_PROXI::pByte157Bit3 = (temp >> 3) & 0x01;
  @sysvar::SysVar_PROXI::pByte157Bit4 = (temp >> 4) & 0x01;
  @sysvar::SysVar_PROXI::pByte157Bit5 = (temp >> 5) & 0x01;
  @sysvar::SysVar_PROXI::pByte157Bit6 = (temp >> 6) & 0x01;
  @sysvar::SysVar_PROXI::pByte157Bit7 = (temp >> 7) & 0x01;
      
  temp = PROXI_bDataBuffer[157];
  @sysvar::SysVar_PROXI::pByte158Bit0 =  temp     & 0x01;
  @sysvar::SysVar_PROXI::pByte158Bit1 = (temp >> 1) & 0x01;
  @sysvar::SysVar_PROXI::pByte158Bit2 = (temp >> 2) & 0x01;
  @sysvar::SysVar_PROXI::pByte158Bit3 = (temp >> 3) & 0x01;
  @sysvar::SysVar_PROXI::pByte158Bit4 = (temp >> 4) & 0x01;
  @sysvar::SysVar_PROXI::pByte158Bit5 = (temp >> 5) & 0x01;
  @sysvar::SysVar_PROXI::pByte158Bit6 = (temp >> 6) & 0x01;
  @sysvar::SysVar_PROXI::pByte158Bit7 = (temp >> 7) & 0x01;
      
  temp = PROXI_bDataBuffer[158];
//  @sysvar::SysVar_PROXI::pByte159Bit0 =  temp     & 0x01;
//  @sysvar::SysVar_PROXI::pByte159Bit1 = (temp >> 1) & 0x01;
//  @sysvar::SysVar_PROXI::pByte159Bit2 = (temp >> 2) & 0x01;
//  @sysvar::SysVar_PROXI::pByte159Bit3 = (temp >> 3) & 0x01;
//  @sysvar::SysVar_PROXI::pByte159Bit4 = (temp >> 4) & 0x01;
  @sysvar::SysVar_PROXI::pByte159Bit01234 = temp & 0x07;
  @sysvar::SysVar_PROXI::pByte159Bit5 = (temp >> 5) & 0x01;
  @sysvar::SysVar_PROXI::pByte159Bit6 = (temp >> 6) & 0x01;
  @sysvar::SysVar_PROXI::pByte159Bit7 = (temp >> 7) & 0x01;
        
  temp = PROXI_bDataBuffer[159];
//@sysvar::SysVar_PROXI::pByte160Bit0   =  temp       & 0x01;
//@sysvar::SysVar_PROXI::pByte160Bit1   = (temp >> 1) & 0x01;
//@sysvar::SysVar_PROXI::pByte160Bit2   = (temp >> 2) & 0x01;
  @sysvar::SysVar_PROXI::pByte160Bit012 =  temp       & 0x07;
  @sysvar::SysVar_PROXI::pByte160Bit3   = (temp >> 3) & 0x01;
  @sysvar::SysVar_PROXI::pByte160Bit4   = (temp >> 4) & 0x01;
  @sysvar::SysVar_PROXI::pByte160Bit5   = (temp >> 5) & 0x01;
  @sysvar::SysVar_PROXI::pByte160Bit6   = (temp >> 6) & 0x01;
  @sysvar::SysVar_PROXI::pByte160Bit7   = (temp >> 7) & 0x01;
  
  temp = PROXI_bDataBuffer[160];
  @sysvar::SysVar_PROXI::pByte161Bit0 =  temp     & 0x01;
  @sysvar::SysVar_PROXI::pByte161Bit1 = (temp >> 1) & 0x01;
  @sysvar::SysVar_PROXI::pByte161Bit2 = (temp >> 2) & 0x01;
  @sysvar::SysVar_PROXI::pByte161Bit3 = (temp >> 3) & 0x01;
  @sysvar::SysVar_PROXI::pByte161Bit4 = (temp >> 4) & 0x01;
  @sysvar::SysVar_PROXI::pByte161Bit5 = (temp >> 5) & 0x01;
  @sysvar::SysVar_PROXI::pByte161Bit6 = (temp >> 6) & 0x01;
  @sysvar::SysVar_PROXI::pByte161Bit7 = (temp >> 7) & 0x01;
  
  temp = PROXI_bDataBuffer[161];
 // @sysvar::SysVar_PROXI::pByte162Bit0 =  temp     & 0x01;
 // @sysvar::SysVar_PROXI::pByte162Bit1 = (temp >> 1) & 0x01;
 // @sysvar::SysVar_PROXI::pByte162Bit2 = (temp >> 2) & 0x01;
  @sysvar::SysVar_PROXI::pByte162Bit012 = temp      & 0x07;
  @sysvar::SysVar_PROXI::pByte162Bit3 = (temp >> 3) & 0x01;
  @sysvar::SysVar_PROXI::pByte162Bit4 = (temp >> 4) & 0x01;
  @sysvar::SysVar_PROXI::pByte162Bit5 = (temp >> 5) & 0x01;
  @sysvar::SysVar_PROXI::pByte162Bit6 = (temp >> 6) & 0x01;
  @sysvar::SysVar_PROXI::pByte162Bit7 = (temp >> 7) & 0x01;
  
  temp = PROXI_bDataBuffer[162];
  @sysvar::SysVar_PROXI::pByte163Bit0 =  temp       & 0x01;
  @sysvar::SysVar_PROXI::pByte163Bit1 = (temp >> 1) & 0x01;
  @sysvar::SysVar_PROXI::pByte163Bit2 = (temp >> 2) & 0x01;
  @sysvar::SysVar_PROXI::pByte163Bit3 = (temp >> 3) & 0x01;
  @sysvar::SysVar_PROXI::pByte163Bit4 = (temp >> 4) & 0x01;
  @sysvar::SysVar_PROXI::pByte163Bit5 = (temp >> 5) & 0x01;
  @sysvar::SysVar_PROXI::pByte163Bit6 = (temp >> 6) & 0x01;
  @sysvar::SysVar_PROXI::pByte163Bit7 = (temp >> 7) & 0x01;
  
  temp = PROXI_bDataBuffer[163];
  @sysvar::SysVar_PROXI::pByte164Bit0 =  temp       & 0x01;
  @sysvar::SysVar_PROXI::pByte164Bit1 = (temp >> 1) & 0x01;
  @sysvar::SysVar_PROXI::pByte164Bit2 = (temp >> 2) & 0x01;
  @sysvar::SysVar_PROXI::pByte164Bit3 = (temp >> 3) & 0x01;
  @sysvar::SysVar_PROXI::pByte164Bit4 = (temp >> 4) & 0x01;
  @sysvar::SysVar_PROXI::pByte164Bit5 = (temp >> 5) & 0x01;
  @sysvar::SysVar_PROXI::pByte164Bit6 = (temp >> 6) & 0x01;
  @sysvar::SysVar_PROXI::pByte164Bit7 = (temp >> 7) & 0x01;
  
  temp = PROXI_bDataBuffer[164];
  @sysvar::SysVar_PROXI::pByte165Bit0 =  temp       & 0x01;
  @sysvar::SysVar_PROXI::pByte165Bit1 = (temp >> 1) & 0x01;
  @sysvar::SysVar_PROXI::pByte165Bit2 = (temp >> 2) & 0x01;
  @sysvar::SysVar_PROXI::pByte165Bit3 = (temp >> 3) & 0x01;
  @sysvar::SysVar_PROXI::pByte165Bit4 = (temp >> 4) & 0x01;
  @sysvar::SysVar_PROXI::pByte165Bit5 = (temp >> 5) & 0x01;
  @sysvar::SysVar_PROXI::pByte165Bit6 = (temp >> 6) & 0x01;
  @sysvar::SysVar_PROXI::pByte165Bit7 = (temp >> 7) & 0x01;
  
  temp = PROXI_bDataBuffer[165];
//@sysvar::SysVar_PROXI::pByte166Bit0  =  temp       & 0x01;
//@sysvar::SysVar_PROXI::pByte166Bit1  = (temp >> 1) & 0x01;
  @sysvar::SysVar_PROXI::pByte166Bit01 =  temp       & 0x03;
  @sysvar::SysVar_PROXI::pByte166Bit2  = (temp >> 2) & 0x01;
  @sysvar::SysVar_PROXI::pByte166Bit3  = (temp >> 3) & 0x01;
//@sysvar::SysVar_PROXI::pByte166Bit4  = (temp >> 4) & 0x01;
//@sysvar::SysVar_PROXI::pByte166Bit5  = (temp >> 5) & 0x01;
  @sysvar::SysVar_PROXI::pByte166Bit45 = (temp >> 4) & 0x03;
  @sysvar::SysVar_PROXI::pByte166Bit6  = (temp >> 6) & 0x01;
  @sysvar::SysVar_PROXI::pByte166Bit7  = (temp >> 7) & 0x01;
  
  temp = PROXI_bDataBuffer[166];
//@sysvar::SysVar_PROXI::pByte167Bit0 =  temp     & 0x01;
//@sysvar::SysVar_PROXI::pByte167Bit1 = (temp >> 1) & 0x01;
  @sysvar::SysVar_PROXI::pByte167Bit01 =  temp      & 0x03;
  @sysvar::SysVar_PROXI::pByte167Bit2 = (temp >> 2) & 0x01;
  @sysvar::SysVar_PROXI::pByte167Bit3 = (temp >> 3) & 0x01;
  @sysvar::SysVar_PROXI::pByte167Bit4 = (temp >> 4) & 0x01;
  @sysvar::SysVar_PROXI::pByte167Bit5 = (temp >> 5) & 0x01;
  @sysvar::SysVar_PROXI::pByte167Bit6 = (temp >> 6) & 0x01;
  @sysvar::SysVar_PROXI::pByte167Bit7 = (temp >> 7) & 0x01;
  
  temp = PROXI_bDataBuffer[167];
  @sysvar::SysVar_PROXI::pByte168Bit0 =  temp     & 0x01;
  @sysvar::SysVar_PROXI::pByte168Bit1 = (temp >> 1) & 0x01;
  @sysvar::SysVar_PROXI::pByte168Bit2 = (temp >> 2) & 0x01;
  @sysvar::SysVar_PROXI::pByte168Bit3 = (temp >> 3) & 0x01;
  @sysvar::SysVar_PROXI::pByte168Bit4 = (temp >> 4) & 0x01;
  @sysvar::SysVar_PROXI::pByte168Bit5 = (temp >> 5) & 0x01;
  @sysvar::SysVar_PROXI::pByte168Bit6 = (temp >> 6) & 0x01;
  @sysvar::SysVar_PROXI::pByte168Bit7 = (temp >> 7) & 0x01;
  
  temp = PROXI_bDataBuffer[168];
  @sysvar::SysVar_PROXI::pByte169Bit0 =  temp     & 0x01;
  @sysvar::SysVar_PROXI::pByte169Bit1 = (temp >> 1) & 0x01;
  @sysvar::SysVar_PROXI::pByte169Bit2 = (temp >> 2) & 0x01;
  @sysvar::SysVar_PROXI::pByte169Bit3 = (temp >> 3) & 0x01;
  @sysvar::SysVar_PROXI::pByte169Bit4 = (temp >> 4) & 0x01;
  @sysvar::SysVar_PROXI::pByte169Bit5 = (temp >> 5) & 0x01;
  @sysvar::SysVar_PROXI::pByte169Bit6 = (temp >> 6) & 0x01;
  @sysvar::SysVar_PROXI::pByte169Bit7 = (temp >> 7) & 0x01;
  
  temp = PROXI_bDataBuffer[169];
  @sysvar::SysVar_PROXI::pByte170Bit0 =  temp     & 0x01;
  @sysvar::SysVar_PROXI::pByte170Bit1 = (temp >> 1) & 0x01;
  @sysvar::SysVar_PROXI::pByte170Bit2 = (temp >> 2) & 0x01;
  @sysvar::SysVar_PROXI::pByte170Bit3 = (temp >> 3) & 0x01;
  @sysvar::SysVar_PROXI::pByte170Bit4 = (temp >> 4) & 0x01;
  @sysvar::SysVar_PROXI::pByte170Bit5 = (temp >> 5) & 0x01;
  @sysvar::SysVar_PROXI::pByte170Bit6 = (temp >> 6) & 0x01;
  @sysvar::SysVar_PROXI::pByte170Bit7 = (temp >> 7) & 0x01;
  
  temp = PROXI_bDataBuffer[170];
  @sysvar::SysVar_PROXI::pByte171Bit0 =  temp     & 0x01;
  @sysvar::SysVar_PROXI::pByte171Bit1 = (temp >> 1) & 0x01;
  @sysvar::SysVar_PROXI::pByte171Bit2 = (temp >> 2) & 0x01;
  @sysvar::SysVar_PROXI::pByte171Bit3 = (temp >> 3) & 0x01;
  @sysvar::SysVar_PROXI::pByte171Bit4 = (temp >> 4) & 0x01;
  @sysvar::SysVar_PROXI::pByte171Bit5 = (temp >> 5) & 0x01;
  @sysvar::SysVar_PROXI::pByte171Bit6 = (temp >> 6) & 0x01;
  @sysvar::SysVar_PROXI::pByte171Bit7 = (temp >> 7) & 0x01;
  
  temp = PROXI_bDataBuffer[171];
  @sysvar::SysVar_PROXI::pByte172Bit0 =  temp     & 0x01;
  @sysvar::SysVar_PROXI::pByte172Bit1 = (temp >> 1) & 0x01;
  @sysvar::SysVar_PROXI::pByte172Bit2 = (temp >> 2) & 0x01;
  @sysvar::SysVar_PROXI::pByte172Bit3 = (temp >> 3) & 0x01;
  @sysvar::SysVar_PROXI::pByte172Bit4 = (temp >> 4) & 0x01;
  @sysvar::SysVar_PROXI::pByte172Bit5 = (temp >> 5) & 0x01;
  @sysvar::SysVar_PROXI::pByte172Bit6 = (temp >> 6) & 0x01;
  @sysvar::SysVar_PROXI::pByte172Bit7 = (temp >> 7) & 0x01;
  
  temp = PROXI_bDataBuffer[172];
  @sysvar::SysVar_PROXI::pByte173Bit0 =  temp     & 0x01;
  @sysvar::SysVar_PROXI::pByte173Bit1 = (temp >> 1) & 0x01;
  @sysvar::SysVar_PROXI::pByte173Bit2 = (temp >> 2) & 0x01;
  @sysvar::SysVar_PROXI::pByte173Bit3 = (temp >> 3) & 0x01;
  @sysvar::SysVar_PROXI::pByte173Bit4 = (temp >> 4) & 0x01;
  @sysvar::SysVar_PROXI::pByte173Bit5 = (temp >> 5) & 0x01;
  @sysvar::SysVar_PROXI::pByte173Bit6 = (temp >> 6) & 0x01;
  @sysvar::SysVar_PROXI::pByte173Bit7 = (temp >> 7) & 0x01;
  
  temp = PROXI_bDataBuffer[173];
  @sysvar::SysVar_PROXI::pByte174Bit0 =  temp     & 0x01;
  @sysvar::SysVar_PROXI::pByte174Bit1 = (temp >> 1) & 0x01;
  @sysvar::SysVar_PROXI::pByte174Bit2 = (temp >> 2) & 0x01;
  @sysvar::SysVar_PROXI::pByte174Bit3 = (temp >> 3) & 0x01;
  @sysvar::SysVar_PROXI::pByte174Bit4 = (temp >> 4) & 0x01;
  @sysvar::SysVar_PROXI::pByte174Bit5 = (temp >> 5) & 0x01;
  @sysvar::SysVar_PROXI::pByte174Bit6 = (temp >> 6) & 0x01;
  @sysvar::SysVar_PROXI::pByte174Bit7 = (temp >> 7) & 0x01;
  
  temp = PROXI_bDataBuffer[174];
  @sysvar::SysVar_PROXI::pByte175Bit0 =  temp     & 0x01;
  @sysvar::SysVar_PROXI::pByte175Bit1 = (temp >> 1) & 0x01;
  @sysvar::SysVar_PROXI::pByte175Bit2 = (temp >> 2) & 0x01;
  @sysvar::SysVar_PROXI::pByte175Bit3 = (temp >> 3) & 0x01;
  @sysvar::SysVar_PROXI::pByte175Bit4 = (temp >> 4) & 0x01;
  @sysvar::SysVar_PROXI::pByte175Bit5 = (temp >> 5) & 0x01;
  @sysvar::SysVar_PROXI::pByte175Bit6 = (temp >> 6) & 0x01;
  @sysvar::SysVar_PROXI::pByte175Bit7 = (temp >> 7) & 0x01;
  
  temp = PROXI_bDataBuffer[175];
  @sysvar::SysVar_PROXI::pByte176Bit0 =  temp     & 0x01;
  @sysvar::SysVar_PROXI::pByte176Bit1 = (temp >> 1) & 0x01;
  @sysvar::SysVar_PROXI::pByte176Bit2 = (temp >> 2) & 0x01;
  @sysvar::SysVar_PROXI::pByte176Bit3 = (temp >> 3) & 0x01;
  @sysvar::SysVar_PROXI::pByte176Bit4 = (temp >> 4) & 0x01;
  @sysvar::SysVar_PROXI::pByte176Bit5 = (temp >> 5) & 0x01;
  @sysvar::SysVar_PROXI::pByte176Bit6 = (temp >> 6) & 0x01;
  @sysvar::SysVar_PROXI::pByte176Bit7 = (temp >> 7) & 0x01;
  
  temp = PROXI_bDataBuffer[176];
  @sysvar::SysVar_PROXI::pByte177Bit0   =  temp       & 0x01;
  @sysvar::SysVar_PROXI::pByte177Bit1   = (temp >> 1) & 0x01;
//@sysvar::SysVar_PROXI::pByte177Bit2   = (temp >> 2) & 0x01;
//@sysvar::SysVar_PROXI::pByte177Bit3   = (temp >> 3) & 0x01;
//@sysvar::SysVar_PROXI::pByte177Bit4   = (temp >> 4) & 0x01;
  @sysvar::SysVar_PROXI::pByte177Bit234 = (temp >> 2) & 0x07;
  @sysvar::SysVar_PROXI::pByte177Bit5   = (temp >> 5) & 0x01;
  @sysvar::SysVar_PROXI::pByte177Bit6   = (temp >> 6) & 0x01;
  @sysvar::SysVar_PROXI::pByte177Bit7   = (temp >> 7) & 0x01;
  
  temp = PROXI_bDataBuffer[177];
  @sysvar::SysVar_PROXI::pByte178Bit0 =  temp     & 0x01;
  @sysvar::SysVar_PROXI::pByte178Bit1 = (temp >> 1) & 0x01;
  @sysvar::SysVar_PROXI::pByte178Bit2 = (temp >> 2) & 0x01;
  @sysvar::SysVar_PROXI::pByte178Bit3 = (temp >> 3) & 0x01;
  @sysvar::SysVar_PROXI::pByte178Bit4 = (temp >> 4) & 0x01;
  @sysvar::SysVar_PROXI::pByte178Bit5 = (temp >> 5) & 0x01;
  @sysvar::SysVar_PROXI::pByte178Bit6 = (temp >> 6) & 0x01;
  @sysvar::SysVar_PROXI::pByte178Bit7 = (temp >> 7) & 0x01;
  
  temp = PROXI_bDataBuffer[178];
//@sysvar::SysVar_PROXI::pByte179Bit0   =  temp       & 0x01;
//@sysvar::SysVar_PROXI::pByte179Bit1   = (temp >> 1) & 0x01;
//@sysvar::SysVar_PROXI::pByte179Bit2   = (temp >> 2) & 0x01;
  @sysvar::SysVar_PROXI::pByte179Bit012 =  temp       & 0x07;
  @sysvar::SysVar_PROXI::pByte179Bit3   = (temp >> 3) & 0x01;
  @sysvar::SysVar_PROXI::pByte179Bit4   = (temp >> 4) & 0x01;
  @sysvar::SysVar_PROXI::pByte179Bit5   = (temp >> 5) & 0x01;
  @sysvar::SysVar_PROXI::pByte179Bit6   = (temp >> 6) & 0x01;
  @sysvar::SysVar_PROXI::pByte179Bit7   = (temp >> 7) & 0x01;
  
  temp = PROXI_bDataBuffer[179];
  @sysvar::SysVar_PROXI::pByte180Bit0 =  temp     & 0x01;
  @sysvar::SysVar_PROXI::pByte180Bit1 = (temp >> 1) & 0x01;
  @sysvar::SysVar_PROXI::pByte180Bit2 = (temp >> 2) & 0x01;
  @sysvar::SysVar_PROXI::pByte180Bit3 = (temp >> 3) & 0x01;
  @sysvar::SysVar_PROXI::pByte180Bit4 = (temp >> 4) & 0x01;
  @sysvar::SysVar_PROXI::pByte180Bit5 = (temp >> 5) & 0x01;
  @sysvar::SysVar_PROXI::pByte180Bit6 = (temp >> 6) & 0x01;
  @sysvar::SysVar_PROXI::pByte180Bit7 = (temp >> 7) & 0x01;
  
  temp = PROXI_bDataBuffer[180];
  @sysvar::SysVar_PROXI::pByte181Bit0 =  temp     & 0x01;
  @sysvar::SysVar_PROXI::pByte181Bit1 = (temp >> 1) & 0x01;
  @sysvar::SysVar_PROXI::pByte181Bit2 = (temp >> 2) & 0x01;
  @sysvar::SysVar_PROXI::pByte181Bit3 = (temp >> 3) & 0x01;
  @sysvar::SysVar_PROXI::pByte181Bit4 = (temp >> 4) & 0x01;
  @sysvar::SysVar_PROXI::pByte181Bit5 = (temp >> 5) & 0x01;
  @sysvar::SysVar_PROXI::pByte181Bit6 = (temp >> 6) & 0x01;
  @sysvar::SysVar_PROXI::pByte181Bit7 = (temp >> 7) & 0x01;
  
  temp = PROXI_bDataBuffer[181];
  @sysvar::SysVar_PROXI::pByte182Bit0 =  temp     & 0x01;
  @sysvar::SysVar_PROXI::pByte182Bit1 = (temp >> 1) & 0x01;
  @sysvar::SysVar_PROXI::pByte182Bit2 = (temp >> 2) & 0x01;
  @sysvar::SysVar_PROXI::pByte182Bit3 = (temp >> 3) & 0x01;
  @sysvar::SysVar_PROXI::pByte182Bit4 = (temp >> 4) & 0x01;
  @sysvar::SysVar_PROXI::pByte182Bit5 = (temp >> 5) & 0x01;
  @sysvar::SysVar_PROXI::pByte182Bit6 = (temp >> 6) & 0x01;
  @sysvar::SysVar_PROXI::pByte182Bit7 = (temp >> 7) & 0x01;
  
  temp = PROXI_bDataBuffer[182];
  @sysvar::SysVar_PROXI::pByte183Bit0 =  temp     & 0x01;
  @sysvar::SysVar_PROXI::pByte183Bit1 = (temp >> 1) & 0x01;
  @sysvar::SysVar_PROXI::pByte183Bit2 = (temp >> 2) & 0x01;
  @sysvar::SysVar_PROXI::pByte183Bit3 = (temp >> 3) & 0x01;
  @sysvar::SysVar_PROXI::pByte183Bit4 = (temp >> 4) & 0x01;
  @sysvar::SysVar_PROXI::pByte183Bit5 = (temp >> 5) & 0x01;
  @sysvar::SysVar_PROXI::pByte183Bit6 = (temp >> 6) & 0x01;
  @sysvar::SysVar_PROXI::pByte183Bit7 = (temp >> 7) & 0x01;
  
  temp = PROXI_bDataBuffer[183];
  @sysvar::SysVar_PROXI::pByte184Bit0 =  temp     & 0x01;
  @sysvar::SysVar_PROXI::pByte184Bit1 = (temp >> 1) & 0x01;
  @sysvar::SysVar_PROXI::pByte184Bit2 = (temp >> 2) & 0x01;
  @sysvar::SysVar_PROXI::pByte184Bit3 = (temp >> 3) & 0x01;
  @sysvar::SysVar_PROXI::pByte184Bit4 = (temp >> 4) & 0x01;
  @sysvar::SysVar_PROXI::pByte184Bit5 = (temp >> 5) & 0x01;
  @sysvar::SysVar_PROXI::pByte184Bit6 = (temp >> 6) & 0x01;
  @sysvar::SysVar_PROXI::pByte184Bit7 = (temp >> 7) & 0x01;
  
  temp = PROXI_bDataBuffer[184];
  @sysvar::SysVar_PROXI::pByte185Bit0 =  temp     & 0x01;
  @sysvar::SysVar_PROXI::pByte185Bit1 = (temp >> 1) & 0x01;
  @sysvar::SysVar_PROXI::pByte185Bit2 = (temp >> 2) & 0x01;
  @sysvar::SysVar_PROXI::pByte185Bit3 = (temp >> 3) & 0x01;
  @sysvar::SysVar_PROXI::pByte185Bit4 = (temp >> 4) & 0x01;
  @sysvar::SysVar_PROXI::pByte185Bit5 = (temp >> 5) & 0x01;
  @sysvar::SysVar_PROXI::pByte185Bit6 = (temp >> 6) & 0x01;
  @sysvar::SysVar_PROXI::pByte185Bit7 = (temp >> 7) & 0x01;
  
  temp = PROXI_bDataBuffer[185];
  @sysvar::SysVar_PROXI::pByte186Bit0 =  temp     & 0x01;
  @sysvar::SysVar_PROXI::pByte186Bit1 = (temp >> 1) & 0x01;
  @sysvar::SysVar_PROXI::pByte186Bit2 = (temp >> 2) & 0x01;
  @sysvar::SysVar_PROXI::pByte186Bit3 = (temp >> 3) & 0x01;
  @sysvar::SysVar_PROXI::pByte186Bit4 = (temp >> 4) & 0x01;
  @sysvar::SysVar_PROXI::pByte186Bit5 = (temp >> 5) & 0x01;
  @sysvar::SysVar_PROXI::pByte186Bit6 = (temp >> 6) & 0x01;
  @sysvar::SysVar_PROXI::pByte186Bit7 = (temp >> 7) & 0x01;
  
  temp = PROXI_bDataBuffer[186];
  @sysvar::SysVar_PROXI::pByte187Bit0 =  temp     & 0x01;
  @sysvar::SysVar_PROXI::pByte187Bit1 = (temp >> 1) & 0x01;
  @sysvar::SysVar_PROXI::pByte187Bit2 = (temp >> 2) & 0x01;
  @sysvar::SysVar_PROXI::pByte187Bit3 = (temp >> 3) & 0x01;
  @sysvar::SysVar_PROXI::pByte187Bit4 = (temp >> 4) & 0x01;
  @sysvar::SysVar_PROXI::pByte187Bit5 = (temp >> 5) & 0x01;
  @sysvar::SysVar_PROXI::pByte187Bit6 = (temp >> 6) & 0x01;
  @sysvar::SysVar_PROXI::pByte187Bit7 = (temp >> 7) & 0x01;
  
  temp = PROXI_bDataBuffer[187];
  @sysvar::SysVar_PROXI::pByte188Bit0 =  temp     & 0x01;
  @sysvar::SysVar_PROXI::pByte188Bit1 = (temp >> 1) & 0x01;
  @sysvar::SysVar_PROXI::pByte188Bit2 = (temp >> 2) & 0x01;
  @sysvar::SysVar_PROXI::pByte188Bit3 = (temp >> 3) & 0x01;
  @sysvar::SysVar_PROXI::pByte188Bit4 = (temp >> 4) & 0x01;
  @sysvar::SysVar_PROXI::pByte188Bit5 = (temp >> 5) & 0x01;
  @sysvar::SysVar_PROXI::pByte188Bit6 = (temp >> 6) & 0x01;
  @sysvar::SysVar_PROXI::pByte188Bit7 = (temp >> 7) & 0x01;
  
  temp = PROXI_bDataBuffer[188];
  @sysvar::SysVar_PROXI::pByte189Bit0 =  temp     & 0x01;
  @sysvar::SysVar_PROXI::pByte189Bit1 = (temp >> 1) & 0x01;
  @sysvar::SysVar_PROXI::pByte189Bit2 = (temp >> 2) & 0x01;
  @sysvar::SysVar_PROXI::pByte189Bit3 = (temp >> 3) & 0x01;
  @sysvar::SysVar_PROXI::pByte189Bit4 = (temp >> 4) & 0x01;
  @sysvar::SysVar_PROXI::pByte189Bit5 = (temp >> 5) & 0x01;
  @sysvar::SysVar_PROXI::pByte189Bit6 = (temp >> 6) & 0x01;
  @sysvar::SysVar_PROXI::pByte189Bit7 = (temp >> 7) & 0x01;
  
  temp = PROXI_bDataBuffer[189];
  @sysvar::SysVar_PROXI::pByte190Bit0 =  temp     & 0x01;
  @sysvar::SysVar_PROXI::pByte190Bit1 = (temp >> 1) & 0x01;
  @sysvar::SysVar_PROXI::pByte190Bit2 = (temp >> 2) & 0x01;
  @sysvar::SysVar_PROXI::pByte190Bit3 = (temp >> 3) & 0x01;
  @sysvar::SysVar_PROXI::pByte190Bit4 = (temp >> 4) & 0x01;
  @sysvar::SysVar_PROXI::pByte190Bit5 = (temp >> 5) & 0x01;
  @sysvar::SysVar_PROXI::pByte190Bit6 = (temp >> 6) & 0x01;
  @sysvar::SysVar_PROXI::pByte190Bit7 = (temp >> 7) & 0x01;
  
  temp = PROXI_bDataBuffer[190];
  @sysvar::SysVar_PROXI::pByte191Bit0 =  temp     & 0x01;
  @sysvar::SysVar_PROXI::pByte191Bit1 = (temp >> 1) & 0x01;
  @sysvar::SysVar_PROXI::pByte191Bit2 = (temp >> 2) & 0x01;
  @sysvar::SysVar_PROXI::pByte191Bit3 = (temp >> 3) & 0x01;
  @sysvar::SysVar_PROXI::pByte191Bit4 = (temp >> 4) & 0x01;
  @sysvar::SysVar_PROXI::pByte191Bit5 = (temp >> 5) & 0x01;
  @sysvar::SysVar_PROXI::pByte191Bit6 = (temp >> 6) & 0x01;
  @sysvar::SysVar_PROXI::pByte191Bit7 = (temp >> 7) & 0x01;
  
  temp = PROXI_bDataBuffer[191];
  @sysvar::SysVar_PROXI::pByte192Bit0 =  temp     & 0x01;
  @sysvar::SysVar_PROXI::pByte192Bit1 = (temp >> 1) & 0x01;
  @sysvar::SysVar_PROXI::pByte192Bit2 = (temp >> 2) & 0x01;
  @sysvar::SysVar_PROXI::pByte192Bit3 = (temp >> 3) & 0x01;
  @sysvar::SysVar_PROXI::pByte192Bit4 = (temp >> 4) & 0x01;
  @sysvar::SysVar_PROXI::pByte192Bit5 = (temp >> 5) & 0x01;
  @sysvar::SysVar_PROXI::pByte192Bit6 = (temp >> 6) & 0x01;
  @sysvar::SysVar_PROXI::pByte192Bit7 = (temp >> 7) & 0x01;
  
  temp = PROXI_bDataBuffer[192];
  @sysvar::SysVar_PROXI::pByte193Bit0 =  temp     & 0x01;
  @sysvar::SysVar_PROXI::pByte193Bit1 = (temp >> 1) & 0x01;
  @sysvar::SysVar_PROXI::pByte193Bit2 = (temp >> 2) & 0x01;
  @sysvar::SysVar_PROXI::pByte193Bit3 = (temp >> 3) & 0x01;
  @sysvar::SysVar_PROXI::pByte193Bit4 = (temp >> 4) & 0x01;
  @sysvar::SysVar_PROXI::pByte193Bit5 = (temp >> 5) & 0x01;
  @sysvar::SysVar_PROXI::pByte193Bit6 = (temp >> 6) & 0x01;
  @sysvar::SysVar_PROXI::pByte193Bit7 = (temp >> 7) & 0x01;
  
  temp = PROXI_bDataBuffer[193];
  @sysvar::SysVar_PROXI::pByte194Bit0 =  temp     & 0x01;
  @sysvar::SysVar_PROXI::pByte194Bit1 = (temp >> 1) & 0x01;
  @sysvar::SysVar_PROXI::pByte194Bit2 = (temp >> 2) & 0x01;
  @sysvar::SysVar_PROXI::pByte194Bit3 = (temp >> 3) & 0x01;
  @sysvar::SysVar_PROXI::pByte194Bit4 = (temp >> 4) & 0x01;
  @sysvar::SysVar_PROXI::pByte194Bit5 = (temp >> 5) & 0x01;
  @sysvar::SysVar_PROXI::pByte194Bit6 = (temp >> 6) & 0x01;
  @sysvar::SysVar_PROXI::pByte194Bit7 = (temp >> 7) & 0x01;
  
  temp = PROXI_bDataBuffer[194];
  @sysvar::SysVar_PROXI::pByte195Bit0 =  temp     & 0x01;
  @sysvar::SysVar_PROXI::pByte195Bit1 = (temp >> 1) & 0x01;
  @sysvar::SysVar_PROXI::pByte195Bit2 = (temp >> 2) & 0x01;
  @sysvar::SysVar_PROXI::pByte195Bit3 = (temp >> 3) & 0x01;
  @sysvar::SysVar_PROXI::pByte195Bit4 = (temp >> 4) & 0x01;
  @sysvar::SysVar_PROXI::pByte195Bit5 = (temp >> 5) & 0x01;
  @sysvar::SysVar_PROXI::pByte195Bit6 = (temp >> 6) & 0x01;
  @sysvar::SysVar_PROXI::pByte195Bit7 = (temp >> 7) & 0x01;
  
  temp = PROXI_bDataBuffer[195];
  @sysvar::SysVar_PROXI::pByte196Bit0 =  temp     & 0x01;
  @sysvar::SysVar_PROXI::pByte196Bit1 = (temp >> 1) & 0x01;
  @sysvar::SysVar_PROXI::pByte196Bit2 = (temp >> 2) & 0x01;
  @sysvar::SysVar_PROXI::pByte196Bit3 = (temp >> 3) & 0x01;
  @sysvar::SysVar_PROXI::pByte196Bit4 = (temp >> 4) & 0x01;
  @sysvar::SysVar_PROXI::pByte196Bit5 = (temp >> 5) & 0x01;
  @sysvar::SysVar_PROXI::pByte196Bit6 = (temp >> 6) & 0x01;
  @sysvar::SysVar_PROXI::pByte196Bit7 = (temp >> 7) & 0x01;
  
  temp = PROXI_bDataBuffer[196];
  @sysvar::SysVar_PROXI::pByte197Bit0 =  temp     & 0x01;
  @sysvar::SysVar_PROXI::pByte197Bit1 = (temp >> 1) & 0x01;
  @sysvar::SysVar_PROXI::pByte197Bit2 = (temp >> 2) & 0x01;
  @sysvar::SysVar_PROXI::pByte197Bit3 = (temp >> 3) & 0x01;
  @sysvar::SysVar_PROXI::pByte197Bit4 = (temp >> 4) & 0x01;
  @sysvar::SysVar_PROXI::pByte197Bit5 = (temp >> 5) & 0x01;
  @sysvar::SysVar_PROXI::pByte197Bit6 = (temp >> 6) & 0x01;
  @sysvar::SysVar_PROXI::pByte197Bit7 = (temp >> 7) & 0x01;
  
  temp = PROXI_bDataBuffer[197];
  @sysvar::SysVar_PROXI::pByte198Bit01 =   temp      & 0x03;
  //@sysvar::SysVar_PROXI::pByte198Bit0 =  temp     & 0x01;
  //@sysvar::SysVar_PROXI::pByte198Bit1 = (temp >> 1) & 0x01;
  @sysvar::SysVar_PROXI::pByte198Bit2 = (temp >> 2) & 0x01;
  @sysvar::SysVar_PROXI::pByte198Bit3 = (temp >> 3) & 0x01;
  @sysvar::SysVar_PROXI::pByte198Bit4 = (temp >> 4) & 0x01;
  @sysvar::SysVar_PROXI::pByte198Bit5 = (temp >> 5) & 0x01;
  @sysvar::SysVar_PROXI::pByte198Bit6 = (temp >> 6) & 0x01;
  @sysvar::SysVar_PROXI::pByte198Bit7 = (temp >> 7) & 0x01;
  
  temp = PROXI_bDataBuffer[198];
  @sysvar::SysVar_PROXI::pByte199Bit0 =  temp     & 0x01;
  @sysvar::SysVar_PROXI::pByte199Bit1 = (temp >> 1) & 0x01;
  @sysvar::SysVar_PROXI::pByte199Bit2 = (temp >> 2) & 0x01;
  @sysvar::SysVar_PROXI::pByte199Bit3 = (temp >> 3) & 0x01;
  @sysvar::SysVar_PROXI::pByte199Bit4 = (temp >> 4) & 0x01;
  @sysvar::SysVar_PROXI::pByte199Bit5 = (temp >> 5) & 0x01;
  @sysvar::SysVar_PROXI::pByte199Bit6 = (temp >> 6) & 0x01;
  @sysvar::SysVar_PROXI::pByte199Bit7 = (temp >> 7) & 0x01;
  
  temp = PROXI_bDataBuffer[199];
  @sysvar::SysVar_PROXI::pByte200Bit0 =  temp     & 0x01;
  @sysvar::SysVar_PROXI::pByte200Bit1 = (temp >> 1) & 0x01;
  @sysvar::SysVar_PROXI::pByte200Bit2 = (temp >> 2) & 0x01;
  @sysvar::SysVar_PROXI::pByte200Bit3 = (temp >> 3) & 0x01;
  @sysvar::SysVar_PROXI::pByte200Bit4 = (temp >> 4) & 0x01;
  @sysvar::SysVar_PROXI::pByte200Bit5 = (temp >> 5) & 0x01;
  @sysvar::SysVar_PROXI::pByte200Bit6 = (temp >> 6) & 0x01;
  @sysvar::SysVar_PROXI::pByte200Bit7 = (temp >> 7) & 0x01;
  
  temp = PROXI_bDataBuffer[216];
  @sysvar::SysVar_PROXI::pByte217Bit0 =  temp     & 0x01;
  @sysvar::SysVar_PROXI::pByte217Bit1 = (temp >> 1) & 0x01;
  @sysvar::SysVar_PROXI::pByte217Bit2 = (temp >> 2) & 0x01;
//  @sysvar::SysVar_PROXI::pByte217Bit3 = (temp >> 3) & 0x01;
//  @sysvar::SysVar_PROXI::pByte217Bit4 = (temp >> 4) & 0x01;
//  @sysvar::SysVar_PROXI::pByte217Bit5 = (temp >> 5) & 0x01;
//  @sysvar::SysVar_PROXI::pByte217Bit6 = (temp >> 6) & 0x01;
  @sysvar::SysVar_PROXI::pByte217Bit3456 = (temp >> 3) & 0x0F;
  @sysvar::SysVar_PROXI::pByte217Bit7 = (temp >> 7) & 0x01;
}

on SysVar sysvar::SysVar_PROXI::DIAG_eRead_WriteCounter
{
  if(@this)
  {
    PROXI_boIsTimeout = 0;
    @sysvar::SysVar_PROXI::PROXI_bProxiWriteCounterRqst = 1;
    sysSetVariableString(sysvar::SysVar_PROXI::DIAG_ePROXI_StatusBar, "WriteCounter Request");
    sysSetVariableData(sysvar::SysVar_PROXI::TPL_eTxDataBuffer, DIAG__abProxiWriteCounterRead, __PROXIDataRead_size);
    @sysvar::SysVar_PROXI::TPL_eTxNrOfBytes = __PROXIDataRead_size;
    @sysvar::SysVar_PROXI::TPL_eTxRequest = 0;
    @sysvar::SysVar_PROXI::TPL_eTxRequest = 1;
    setTimer(PROXI_tNoResponse, PROXI_iNoResponse);
  }    
}

on SysVar sysvar::SysVar_PROXI::DIAG_eSendProxi
{
  if(@this == 0)
  {
    sysSetVariableInt(sysvar::SysVar_PROXI::DIAG_eCalculate_CRC,1);
    sysSetVariableInt(sysvar::SysVar_PROXI::DIAG_eCalculate_CRC,0);
    sysSetVariableInt(sysvar::SysVar_PROXI::DIAG_ProxiRaus,1);
    sysSetVariableInt(sysvar::SysVar_PROXI::DIAG_ProxiRaus,0);
  }
}

on SysVar sysvar::SysVar_PROXI::DIAG_eLoadAll
{
  if(@this == 0)
  {
    sysSetVariableInt(sysvar::SysVar_PROXI::DIAG_ProductionDate_load,1);
    sysSetVariableInt(sysvar::SysVar_PROXI::DIAG_ProductionDate_load,0);
    
    setTimerCyclic(delay_DIAG_eLoadAll,200);
  }
}

on timer delay_DIAG_eLoadAll
{
  int i = 0;
  i = i+1;

  if(i == 1)
  {
    sysSetVariableInt(sysvar::SysVar_PROXI::DIAG_eCANnode_load,1);
    sysSetVariableInt(sysvar::SysVar_PROXI::DIAG_eCANnode_load,0);
  }
  if(i == 2)
  {
    sysSetVariableInt(sysvar::SysVar_PROXI::DIAG_eEOLnode_load,1);
    sysSetVariableInt(sysvar::SysVar_PROXI::DIAG_eEOLnode_load,0);
  }
  if(i == 3)
  {
    sysSetVariableInt(sysvar::SysVar_PROXI::DIAG_eConfigCode_load,1);
    sysSetVariableInt(sysvar::SysVar_PROXI::DIAG_eConfigCode_load,0);
  }
  if(i == 4)
  {
    sysSetVariableInt(sysvar::SysVar_PROXI::DIAG_eTesterCode_load,1);
    sysSetVariableInt(sysvar::SysVar_PROXI::DIAG_eTesterCode_load,0);
  }
  if(i == 5)
  {
    sysSetVariableInt(sysvar::SysVar_PROXI::DIAG_eIPC_load,1);
    sysSetVariableInt(sysvar::SysVar_PROXI::DIAG_eIPC_load,0);
  }
    if(i == 6)
  {
    sysSetVariableString(sysvar::SysVar_PROXI::DIAG_ePROXI_StatusBar, "");
    sysSetVariableString(sysvar::SysVar_PROXI::DIAG_ePROXI_StatusBar, "Loading PROXI Successful - All PROXI");
    
    i=0;
    cancelTimer(delay_DIAG_eLoadAll);
  }
}

on SysVar sysvar::SysVar_PROXI::ClosePanelProxi
{
  closePanel("PROXI520");
  closePanel("PROXI327");
}

void PROXI_vUpdateProxiWriteCounterPanel(void)
{
  @sysvar::SysVar_PROXI::DIAG_ePROXIWriteCounter = PROXI_bDataBuffer[3];
}

on timer TPL__tTimeoutFC
{
	sysSetVariableString(sysvar::SysVar_PROXI::DIAG_PTSStatusBar,"ERROR: TRANSPORT LAYER (FLOW CONTROL TIMEOUT");
}

on timer TPL__tTxNextCF
{
	TPL__vTransmitNextCF();
}

on SysVar sysvar::SysVar_PROXI::TPL_eTxRequest
{
	if(sysGetVariableInt(this) == 1)
	{
		TPL__iTxNumberOfBytes = sysGetVariableInt(sysvar::SysVar_PROXI::TPL_eTxNrOfBytes);
		/* Transfer env.var. into local buffer */
    sysGetVariableData(sysvar::SysVar_PROXI::TPL_eTxDataBuffer, TPL__pbTxDataBuffer,copiedbytes);
//    write ("copiedbytes %d",copiedbytes);
//    write ("TPL__iTxNumberOfBytes %d",TPL__iTxNumberOfBytes);
		if(copiedbytes == TPL__iTxNumberOfBytes) //read all bytes from environment variable
		{
//			sysGetVariableInt(sysvar::SysVar_PROXI::TPL_eTxDataBuffer, TPL__pbTxDataBuffer);
			sysSetVariableInt(sysvar::SysVar_PROXI::TPL_eTxBufferInUse, 0);//reset transmit flag
			TPL__vSendData ();
			sysSetVariableInt(sysvar::SysVar_PROXI::TPL_eTxRequest, 0);	//reset transmit flag
		}
		else //fail to read all bytes from env.var.
		{
			sysSetVariableInt(sysvar::SysVar_PROXI::TPL_eTxBufferInUse, 0);//reset transmit flag
			sysSetVariableInt(sysvar::SysVar_PROXI::TPL_eTxRequest, 0);	//reset transmit flag
		}

	}
}

void TPL__vClearRxBuffer (void)
{
	int i;
//  byte bBuffer[DIAG_BUFFER_SIZE];
	for(i=0; i<DIAG_BUFFER_SIZE; i++)
	{
//	TST__pbRxDataBuffer[i] = 0x00;
		TPL__pbRxDataBuffer[i] = 0x00;
	}
	sysSetVariableData(sysvar::SysVar_PROXI::TPL_eRxDataBuffer, TPL__pbRxDataBuffer,copiedbytes);
}

void TPL__vSendFlowControl (void)
{
	Message DIAGNOSTIC_REQUEST_IPC msg;
	int i;
	i = 0;
//  msg.id=0x18DA60F4x; /*F1=520 and F4=327*/
  msg.dlc = 8;
	msg.byte(0) = 0x30;
	msg.byte(1) = TP_BS;
	msg.byte(2) = TP_STMIN;
	output(msg);
}

void TPL__vDataInd (int iNumberOfBytes)
{
	/* Copy receive buffer into corresponding environment variable	*/
	/* Set the receive flag											*/
  if(@sysvar::SysVar_PROXI::PROXI_bCheckEOLRqst == 1)
  {
    sysSetVariableData(sysvar::SysVar_PROXI::PROXI_eCheckEOL, TPL__pbRxDataBuffer,(long)iNumberOfBytes);
  }
  else if(@sysvar::SysVar_PROXI::PROXI_bReadRqst == 1)
  {
    sysSetVariableData(sysvar::SysVar_PROXI::DIAG_eProxiDataBuffer, TPL__pbRxDataBuffer, (long)iNumberOfBytes);
  }
  else
  {
    sysSetVariableData(sysvar::SysVar_PROXI::TPL_eRxDataBuffer, TPL__pbRxDataBuffer, (long)iNumberOfBytes);
  }
  sysSetVariableInt(sysvar::SysVar_PROXI::TPL_eRxNrOfBytes, iNumberOfBytes);
	sysSetVariableInt(sysvar::SysVar_PROXI::TPL_eRxIndication, 0);
	sysSetVariableInt(sysvar::SysVar_PROXI::TPL_eRxIndication, 1);
}

void TPL__vSendData (void)
{
	Message DIAGNOSTIC_REQUEST_IPC msg;
	int i;
//  write("TPL__iTxNumberOfBytes = %d",TPL__iTxNumberOfBytes);
	if(TPL__iTxNumberOfBytes > 0x07)
	{
  //  msg.id=0x18DA60F4x; /*F1=520 and F4=327*/
		/* Multiple Frame */
		TPL_bCFRequest = 0;
		TPL__iNextByteToSend = 0;
		msg.byte(0) = 0x10;
		msg.byte(1) = TPL__iTxNumberOfBytes;
		TPL__iMissingBytes = TPL__iTxNumberOfBytes;
		TPL__iSendNextCF = 0x01;   // SN-Number starts with 1 not 0
		for (i = 2; i < 8; i++)
		{
			msg.byte(i) = TPL__pbTxDataBuffer[TPL__iNextByteToSend];
			TPL__iMissingBytes--;
			TPL__iNextByteToSend++;
		}
		output(msg);
		cancelTimer(TPL__tTimeoutFC);
		setTimer(TPL__tTimeoutFC,TPL__iTimeoutFC);
	}
	else
	{
  //  msg.id=0x18DA60F4x; /*F1=520 and F4=327*/
		msg.dlc = TPL__iTxNumberOfBytes +1;
    /* Single Frame */
		msg.byte(0) = TPL__iTxNumberOfBytes;
		for (i = 1; i < (TPL__iTxNumberOfBytes + 1); i++)
		{
			msg.byte(i) = TPL__pbTxDataBuffer[i-1];
		}
		output(msg);
	}
	//setTimer(TPL__tTesterPresent,TPL__iTstPresTimeout);
	sysSetVariableInt(sysvar::SysVar_PROXI::TPL_eTestPresTimerInterface, 1);	//set timer
}

void TPL__vTransmitNextCF(void)
{
	message DIAGNOSTIC_REQUEST_IPC msg;
	int i;
	//write("TRANSMIT NEXT CF: %d",TPL__iMissingBytes);
	if(TPL__iMissingBytes > 7)
	{
  //  msg.id=0x18DA60F4x; /*F1=520 and F4=327*/
		msg.dlc = 8;
		if(TPL__iSendNextCF > 0x0F)
		{
			TPL__iSendNextCF = 0x00;
		}
		msg.byte(0) = (0x20 | ((byte)TPL__iSendNextCF));
		for (i = 1; i < 8; i++)
		{
			//write("Next Byte: %d",TST__iTPNextByteToSend);
			msg.byte(i) = TPL__pbTxDataBuffer[TPL__iNextByteToSend];
			TPL__iMissingBytes--;
			TPL__iNextByteToSend++;
		}
		//write("%x %x %x %x %x %x %x %x",msg.byte(0),msg.byte(1),msg.byte(2),msg.byte(3),msg.byte(4),msg.byte(5),msg.byte(6),msg.byte(7));
		output(msg);
		TPL__iSendNextCF++;
		TPL_bCFRequest = 1;
		//@timing_test setTimer(TPL__tTxNextCF,TPL__iTxNextCF);
		cancelTimer(TPL__tCFTimeOut);
		setTimer(TPL__tCFTimeOut,TPL__iCFTimeOut);
	}
	else
	{
  //  msg.id=0x18DA60F4x; /*F1=520 and F4=327*/
		msg.dlc = 1+TPL__iMissingBytes;
		msg.byte(0) = (0x20 | ((byte)TPL__iSendNextCF));
		for (i = 1; i < (1+TPL__iMissingBytes); i++)
		{
		//write("Next Byte: %d",TST__iTPNextByteToSend);
			msg.byte(i) = TPL__pbTxDataBuffer[TPL__iNextByteToSend];
			TPL__iNextByteToSend++;
		}
		//write("%x %x %x %x %x %x %x %x",msg.byte(0),msg.byte(1),msg.byte(2),msg.byte(3),msg.byte(4),msg.byte(5),msg.byte(6),msg.byte(7));
		output(msg);
		TPL__iMissingBytes = 0;
		TPL_bCFRequest = 0;
		cancelTimer(TPL__tTxNextCF);
	}
}

on message DIAGNOSTIC_REQUEST_IPC
{
	int i;
	int iFirstByte;
	int iLastByte;
	if(TPL_bCFRequest == 1)
	{
		cancelTimer(TPL__tCFTimeOut);
		setTimer(TPL__tCFTimeOut,TPL__iCFTimeOut);
		cancelTimer(TPL__tTxNextCF);
		setTimer(TPL__tTxNextCF,TPL__iTxNextCF);
	}
}

on timer TPL__tCFTimeOut
{
	TPL_bCFRequest = 0;
}

on timer TPL__tDelayFC
{
  TPL__vSendFlowControl();
}

//on SysVar sysvar::SysVar_PROXI::pByte76Bit4567
//{
//  sysSetVariableInt(sysvar::SysVar_PROXI::pByte76Bit4567_327,sysGetVariableInt(sysvar::SysVar_PROXI::pByte76Bit4567));
//}

//on SysVar sysvar::SysVar_PROXI::pByte76Bit4567_327
//{
//  sysSetVariableInt(sysvar::SysVar_PROXI::pByte76Bit4567,sysGetVariableInt(sysvar::SysVar_PROXI::pByte76Bit4567_327));
//}
