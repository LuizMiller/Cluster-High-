/*@!Encoding:1252*/
variables
{

  message STATUS_LBSS STATUS_LBSS_msg;
  msTimer STATUS_LBSS_Timer;
  mstimer sleep;
  const   STATUS_LBSS_Cycle = 500;
}

on timer STATUS_LBSS_Timer
{
  output(STATUS_LBSS_msg);
  setTimer(STATUS_LBSS_Timer, STATUS_LBSS_Cycle);
}

on timer sleep
{
  int i = 0;
  i = i+1;    
  if(i == sysgetVariableInt(sysvar::RoadMap::SleepTime) && sysgetVariableInt(sysvar::RoadMap::WC_ON) == 0)
    {
      i=0;
       cancelTimer(STATUS_LBSS_Timer);
       cancelTimer(sleep);
    }  
  else if (sysgetVariableInt(sysvar::RoadMap::WC_ON)==1 || sysgetVariableInt(sysvar::RoadMap::OperationalModeSts)>= 4 
          || sysgetVariableInt(sysvar::RoadMap::NETWORK_BHCAN_Status)==1)
  {
     i=0;
     cancelTimer(sleep);
  }
}

on sysvar sysvar::RoadMap::NETWORK_BHCAN_Status
{
  if(sysGetVariableInt(sysvar::RoadMap::NETWORK_BHCAN_Status) == 1)
  {
    if(sysGetVariableInt(sysvar::RoadMap::STATUS_LBSS_ACTIVE) == 1)
    {
      setTimer(STATUS_LBSS_Timer, STATUS_LBSS_Cycle);
    } 
  }
   else
  {
    if(sysGetVariableInt(sysvar::RoadMap::SleepEnabled) == 1)
    {
      setTimerCyclic(sleep,1000);
    }
  }
}

//on sysvar sysvar::RoadMap::WC_ON
//{
//  if(sysGetVariableInt(sysvar::RoadMap::WC_ON) == 1)
//  {
//    cancelTimer(sleep);
//  }
//  else
//  {
//    if(sysGetVariableInt(sysvar::RoadMap::SleepEnabled) == 1)
//    {
//      setTimerCyclic(sleep,1000);
//    }
//  }
//}

on sysvar sysvar::RoadMap::LBSS_ACTIVE
{
  if(1 == sysGetVariableInt(sysvar::RoadMap::LBSS_ACTIVE))
  {
    sysSetVariableInt(sysvar::RoadMap::STATUS_LBSS_ACTIVE,1);
  }
  else
  {
    sysSetVariableInt(sysvar::RoadMap::STATUS_LBSS_ACTIVE,0);   
  }	
}

//  STATUS_LBSS

on sysvar sysvar::RoadMap::STATUS_LBSS_ACTIVE
{
  if(0 == sysGetVariableInt(sysvar::RoadMap::STATUS_LBSS_ACTIVE))
  {
    cancelTimer(STATUS_LBSS_Timer);
  }
  else if(1 == sysGetVariableInt(sysvar::RoadMap::STATUS_LBSS_ACTIVE) && 1 == sysGetVariableInt(sysvar::RoadMap::WC_ON))
  {
    setTimer(STATUS_LBSS_Timer,STATUS_LBSS_Cycle);
  }
}

on sysvar sysvar::RoadMap::STATUS_LBSS_DLC
{
  if(sysGetVariableInt(sysvar::RoadMap::STATUS_LBSS_DLC) == 4)
  {
    STATUS_LBSS_msg.dlc = STATUS_LBSS.dlc;
  }
  else
  {
    STATUS_LBSS_msg.dlc = sysGetVariableInt(sysvar::RoadMap::STATUS_LBSS_DLC);
  }
}

//  STATUS_LBSS_Signals

on sysvar sysvar::RoadMap::BSS_LF_Chime_RQSts
{
  STATUS_LBSS_msg.BSS_LF_Chime_RQSts = sysGetVariableInt(sysvar::RoadMap::BSS_LF_Chime_RQSts);
  if(sysGetVariableInt(sysvar::RoadMap::STATUS_LBSS_ACTIVE) == 1)
  {
    output(STATUS_LBSS_msg);
  }
}

on sysvar sysvar::RoadMap::BSS_LR_Chime_RQSts
{
  STATUS_LBSS_msg.BSS_LR_Chime_RQSts = sysGetVariableInt(sysvar::RoadMap::BSS_LR_Chime_RQSts);
  if(sysGetVariableInt(sysvar::RoadMap::STATUS_LBSS_ACTIVE) == 1)
  {
    output(STATUS_LBSS_msg);
  }
}

on sysvar sysvar::RoadMap::BSS_LT_Blind_RQSts
{
  STATUS_LBSS_msg.BSS_LT_Blind_RQSts = sysGetVariableInt(sysvar::RoadMap::BSS_LT_Blind_RQSts);
  if(sysGetVariableInt(sysvar::RoadMap::STATUS_LBSS_ACTIVE) == 1)
  {
    output(STATUS_LBSS_msg);
  }
}

on sysvar sysvar::RoadMap::BSS_LT_CFG_STATSts
{
  STATUS_LBSS_msg.BSS_LT_CFG_STATSts = sysGetVariableInt(sysvar::RoadMap::BSS_LT_CFG_STATSts);
  if(sysGetVariableInt(sysvar::RoadMap::STATUS_LBSS_ACTIVE) == 1)
  {
    output(STATUS_LBSS_msg);
  }
}

on sysvar sysvar::RoadMap::BSS_LT_Chime_TypeSts
{
  STATUS_LBSS_msg.BSS_LT_Chime_TypeSts = sysGetVariableInt(sysvar::RoadMap::BSS_LT_Chime_TypeSts);
  if(sysGetVariableInt(sysvar::RoadMap::STATUS_LBSS_ACTIVE) == 1)
  {
    output(STATUS_LBSS_msg);
  }
}

on sysvar sysvar::RoadMap::BSS_LT_OPR_StatSts
{
  STATUS_LBSS_msg.BSS_LT_OPR_StatSts = sysGetVariableInt(sysvar::RoadMap::BSS_LT_OPR_StatSts);
  if(sysGetVariableInt(sysvar::RoadMap::STATUS_LBSS_ACTIVE) == 1)
  {
    output(STATUS_LBSS_msg);
  }
}

on sysvar sysvar::RoadMap::BSS_LT_SRV_RQSts
{
  STATUS_LBSS_msg.BSS_LT_SRV_RQSts = sysGetVariableInt(sysvar::RoadMap::BSS_LT_SRV_RQSts);
  if(sysGetVariableInt(sysvar::RoadMap::STATUS_LBSS_ACTIVE) == 1)
  {
    output(STATUS_LBSS_msg);
  }
}
